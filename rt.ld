OUTPUT_ARCH(arm)

SECTIONS {    
    . = 0;
    _start = . ;
    __romPos = 0;
    
    . = 0x03000000;
    .bss . : SUBALIGN(4) {
        build/src/main.c.o(.bss);
        build/src/memory.c.o(.bss);
        build/src/code_08001360.c.o(.bss);
        build/src/palette.c.o(.bss);
        build/src/affine_param.c.o(.bss);
        build/src/audio.c.o(.bss);
        build/src/graphics_table.c.o(.bss);
        build/src/code_08002f68.c.o(.bss);
        build/src/code_08003b28.c.o(.bss);
        build/src/backdrop.c.o(.bss);
        build/src/bitmap_font.c.o(.bss);
        build/src/task_pool.c.o(.bss);
        build/src/code_08005e54.c.o(.bss);
        build/src/memory_heap.c.o(.bss);
        build/src/code_080068f8.c.o(.bss);
        build/src/code_08007468.c.o(.bss);
        build/src/code_08008dcc.c.o(.bss);
        build/src/code_080092cc.c.o(.bss);
        build/src/text_printer.c.o(.bss);
        build/src/time_keeper.c.o(.bss);
        build/src/code_0800b778.c.o(.bss);
        build/src/affine_sprite.c.o(.bss);
        build/src/code_080102d0.c.o(.bss);
        build/src/scenes/arrival.c.o(.bss);
        build/src/scenes/cafe.c.o(.bss);
        build/src/scenes/data_check.c.o(.bss);
        build/src/scenes/drum_replay.c.o(.bss);
        build/src/scenes/data_room.c.o(.bss);
        build/src/scenes/main_menu.c.o(.bss);
        build/src/scenes/game_select.c.o(.bss);
        build/src/scenes/options.c.o(.bss);
        build/src/scenes/perfect.c.o(.bss);
        build/src/scenes/gameplay.c.o(.bss);
        build/src/scenes/results_debug.c.o(.bss);
        build/src/scenes/results_rank.c.o(.bss);
        build/src/scenes/results_score.c.o(.bss);
        build/src/scenes/results.c.o(.bss);
        build/src/scenes/epilogue.c.o(.bss);
        build/src/scenes/reading.c.o(.bss);
        build/src/scenes/read_error.c.o(.bss);
        build/src/scenes/studio_warning.c.o(.bss);
        build/src/scenes/studio_songs.c.o(.bss);
        build/src/scenes/studio_drums.c.o(.bss);
        build/src/scenes/studio_options.c.o(.bss);
        build/src/scenes/studio_scene.c.o(.bss);
        build/src/scenes/studio_script.c.o(.bss);
        build/src/scenes/title.c.o(.bss);
        build/src/scenes/medal_corner.c.o(.bss);
        build/src/scenes/riq_main_scene.c.o(.bss);
        build/src/scenes/warning.c.o(.bss);
        build/src/scenes/debug_menu.c.o(.bss);
        build/src/scenes/debug_menu_table.c.o(.bss);
        build/src/scenes/debug_flash_mem.c.o(.bss);
        build/src/scenes/debug_data_clear.c.o(.bss);
        build/src/scenes/debug_asset_test.c.o(.bss);
        build/src/scenes/debug_template_scene.c.o(.bss);
        build/src/engines/sneaky_spirits.c.o(.bss);
        build/src/engines/spaceball.c.o(.bss);
        build/src/engines/bon_odori.c.o(.bss);
        build/src/engines/karate_man.c.o(.bss);
        build/src/engines/mannequin_factory.c.o(.bss);
        build/src/engines/staff_credit.c.o(.bss);
        build/src/engines/drum_intro.c.o(.bss);
        build/src/engines/drum_live.c.o(.bss);
        build/src/engines/drum_studio.c.o(.bss);
        build/src/engines/night_walk.c.o(.bss);
        build/src/engines/showtime.c.o(.bss);
        build/src/engines/bouncy_road.c.o(.bss);
        build/src/engines/rhythm_tweezers.c.o(.bss);
        build/src/engines/fireworks.c.o(.bss);
        build/src/engines/clappy_trio.c.o(.bss);
        build/src/engines/samurai_slice.c.o(.bss);
        build/src/engines/power_calligraphy.c.o(.bss);
        build/src/engines/rhythm_test.c.o(.bss);
        build/src/engines/marching_orders.c.o(.bss);
        build/src/engines/mr_upbeat.c.o(.bss);
        build/src/engines/metronome.c.o(.bss);
        build/src/engines/polyrhythm.c.o(.bss);
        build/src/engines/drum_live_menu.c.o(.bss);
        build/src/engines/quiz_show.c.o(.bss);
        build/src/engines/bunny_hop.c.o(.bss);
        build/src/engines/rap_men.c.o(.bss);
        build/src/engines/rat_race.c.o(.bss);
        build/src/engines/ninja_bodyguard.c.o(.bss);
        build/src/engines/space_dance.c.o(.bss);
        build/src/engines/tap_trial.c.o(.bss);
        build/src/engines/toss_boys.c.o(.bss);
        build/src/engines/tram_and_pauline.c.o(.bss);
        build/src/engines/mechanical_horse.c.o(.bss);
        build/src/engines/sick_beats.c.o(.bss);
        build/src/engines/rhythm_toys.c.o(.bss);
        build/src/engines/wizards_waltz.c.o(.bss);
        build/src/prologues/sneaky_spirits.c.o(.bss);
        build/src/prologues/spaceball.c.o(.bss);
        build/src/prologues/bon_odori.c.o(.bss);
        build/src/prologues/bon_dance.c.o(.bss);
        build/src/prologues/karate_man.c.o(.bss);
        build/src/prologues/cosmic_dance.c.o(.bss);
        build/src/prologues/night_walk.c.o(.bss);
        build/src/prologues/showtime.c.o(.bss);
        build/src/prologues/bouncy_road.c.o(.bss);
        build/src/prologues/rhythm_tweezers.c.o(.bss);
        build/src/prologues/fireworks.c.o(.bss);
        build/src/prologues/clappy_trio.c.o(.bss);
        build/src/prologues/snappy_trio.c.o(.bss);
        build/src/prologues/samurai_slice.c.o(.bss);
        build/src/prologues/power_calligraphy.c.o(.bss);
        build/src/prologues/marching_orders.c.o(.bss);
        build/src/prologues/marching_orders_2.c.o(.bss);
        build/src/prologues/polyrhythm.c.o(.bss);
        build/src/prologues/quiz_show.c.o(.bss);
        build/src/prologues/remix_1.c.o(.bss);
        build/src/prologues/remix_2.c.o(.bss);
        build/src/prologues/remix_3.c.o(.bss);
        build/src/prologues/remix_4.c.o(.bss);
        build/src/prologues/remix_5.c.o(.bss);
        build/src/prologues/remix_6.c.o(.bss);
        build/src/prologues/remix_7.c.o(.bss);
        build/src/prologues/remix_8.c.o(.bss);
        build/src/prologues/bunny_hop.c.o(.bss);
        build/src/prologues/rap_men.c.o(.bss);
        build/src/prologues/rap_women.c.o(.bss);
        build/src/prologues/rat_race.c.o(.bss);
        build/src/prologues/ninja_bodyguard.c.o(.bss);
        build/src/prologues/ninja_reincarnate.c.o(.bss);
        build/src/prologues/space_dance.c.o(.bss);
        build/src/prologues/tap_trial.c.o(.bss);
        build/src/prologues/tap_trial_2.c.o(.bss);
        build/src/prologues/toss_boys.c.o(.bss);
        build/src/prologues/toss_boys_2.c.o(.bss);
        build/src/prologues/tram_and_pauline.c.o(.bss);
        build/src/prologues/sick_beats.c.o(.bss);
        build/src/prologues/wizards_waltz.c.o(.bss);
        build/src/code_08047e50.c.o(.bss);
        build/asm/lib_midi.s.o(.bss);
        build/src/midi/directsound.c.o(.bss);
        build/src/midi/channel.c.o(.bss);
        build/src/midi/lfo.c.o(.bss);
        build/src/midi/random.c.o(.bss);
        build/src/midi/psg.c.o(.bss);
        build/src/midi/player.c.o(.bss);
        build/src/lib_sram.c.o(.bss);
        build/src/lib_0804ca80.c.o(.bss);
        build/src/lib_0804e564.c.o(.bss);
    }
    
    . = 0x08000000;
    .cartrom . : AT(__romPos) SUBALIGN(4) {
        build/asm/rom_header.s.o(.text);
        build/asm/boot.s.o(.text);
        build/src/main.c.o(.text);
        build/src/memory.c.o(.text);
        build/asm/code_08000a00.s.o(.text);
        build/src/code_08001360.c.o(.text);
        build/src/palette.c.o(.text);
        build/src/affine_param.c.o(.text);
        build/src/audio.c.o(.text);
        build/src/graphics_table.c.o(.text);
        build/src/code_08002f68.c.o(.text);
        build/src/code_08003b28.c.o(.text);
        build/src/backdrop.c.o(.text);
        build/src/bitmap_font.c.o(.text);
        build/src/task_pool.c.o(.text);
        build/src/code_08005e54.c.o(.text);
        build/src/memory_heap.c.o(.text);
        build/src/code_080068f8.c.o(.text);
        build/src/code_08007468.c.o(.text);
        build/src/code_08008dcc.c.o(.text);
        build/src/code_080092cc.c.o(.text);
        build/src/text_printer.c.o(.text);
        build/src/time_keeper.c.o(.text);
        build/src/code_0800b778.c.o(.text);
        build/src/affine_sprite.c.o(.text);
        build/src/code_080102d0.c.o(.text);
        build/src/scenes/arrival.c.o(.text);
        build/src/scenes/cafe.c.o(.text);
        build/src/scenes/data_check.c.o(.text);
        build/src/scenes/drum_replay.c.o(.text);
        build/src/scenes/data_room.c.o(.text);
        build/src/scenes/main_menu.c.o(.text);
        build/src/scenes/game_select.c.o(.text);
        build/src/scenes/options.c.o(.text);
        build/src/scenes/perfect.c.o(.text);
        build/src/scenes/gameplay.c.o(.text);
        build/src/scenes/results_debug.c.o(.text);
        build/src/scenes/results_rank.c.o(.text);
        build/src/scenes/results_score.c.o(.text);
        build/src/scenes/results.c.o(.text);
        build/src/scenes/epilogue.c.o(.text);
        build/src/scenes/reading.c.o(.text);
        build/src/scenes/read_error.c.o(.text);
        build/src/scenes/studio_warning.c.o(.text);
        build/src/scenes/studio_songs.c.o(.text);
        build/src/scenes/studio_drums.c.o(.text);
        build/src/scenes/studio_options.c.o(.text);
        build/src/scenes/studio_scene.c.o(.text);
        build/src/scenes/studio_script.c.o(.text);
        build/src/scenes/title.c.o(.text);
        build/src/scenes/medal_corner.c.o(.text);
        build/src/scenes/riq_main_scene.c.o(.text);
        build/src/scenes/warning.c.o(.text);
        build/src/scenes/debug_menu.c.o(.text);
        build/src/scenes/debug_menu_table.c.o(.text);
        build/src/scenes/debug_flash_mem.c.o(.text);
        build/src/scenes/debug_data_clear.c.o(.text);
        build/src/scenes/debug_asset_test.c.o(.text);
        build/src/scenes/debug_template_scene.c.o(.text);
        build/src/engines/sneaky_spirits.c.o(.text);
        build/src/engines/spaceball.c.o(.text);
        build/src/engines/bon_odori.c.o(.text);
        build/src/engines/karate_man.c.o(.text);
        build/src/engines/mannequin_factory.c.o(.text);
        build/src/engines/staff_credit.c.o(.text);
        build/src/engines/drum_intro.c.o(.text);
        build/src/engines/drum_live.c.o(.text);
        build/src/engines/drum_studio.c.o(.text);
        build/src/engines/night_walk.c.o(.text);
        build/src/engines/showtime.c.o(.text);
        build/src/engines/bouncy_road.c.o(.text);
        build/src/engines/rhythm_tweezers.c.o(.text);
        build/src/engines/fireworks.c.o(.text);
        build/src/engines/clappy_trio.c.o(.text);
        build/src/engines/samurai_slice.c.o(.text);
        build/src/engines/power_calligraphy.c.o(.text);
        build/src/engines/rhythm_test.c.o(.text);
        build/src/engines/marching_orders.c.o(.text);
        build/src/engines/mr_upbeat.c.o(.text);
        build/src/engines/metronome.c.o(.text);
        build/src/engines/polyrhythm.c.o(.text);
        build/src/engines/drum_live_menu.c.o(.text);
        build/src/engines/quiz_show.c.o(.text);
        build/src/engines/bunny_hop.c.o(.text);
        build/src/engines/rap_men.c.o(.text);
        build/src/engines/rat_race.c.o(.text);
        build/src/engines/ninja_bodyguard.c.o(.text);
        build/src/engines/space_dance.c.o(.text);
        build/src/engines/tap_trial.c.o(.text);
        build/src/engines/toss_boys.c.o(.text);
        build/src/engines/tram_and_pauline.c.o(.text);
        build/src/engines/mechanical_horse.c.o(.text);
        build/src/engines/sick_beats.c.o(.text);
        build/src/engines/rhythm_toys.c.o(.text);
        build/src/engines/wizards_waltz.c.o(.text);
        build/src/prologues/sneaky_spirits.c.o(.text);
        build/src/prologues/spaceball.c.o(.text);
        build/src/prologues/bon_dance.c.o(.text);
        build/src/prologues/bon_odori.c.o(.text);
        build/src/prologues/karate_man.c.o(.text);
        build/src/prologues/cosmic_dance.c.o(.text);
        build/src/prologues/night_walk.c.o(.text);
        build/src/prologues/showtime.c.o(.text);
        build/src/prologues/bouncy_road.c.o(.text);
        build/src/prologues/rhythm_tweezers.c.o(.text);
        build/src/prologues/fireworks.c.o(.text);
        build/src/prologues/clappy_trio.c.o(.text);
        build/src/prologues/snappy_trio.c.o(.text);
        build/src/prologues/samurai_slice.c.o(.text);
        build/src/prologues/power_calligraphy.c.o(.text);
        build/src/prologues/marching_orders.c.o(.text);
        build/src/prologues/marching_orders_2.c.o(.text);
        build/src/prologues/polyrhythm.c.o(.text);
        build/src/prologues/quiz_show.c.o(.text);
        build/src/prologues/remix_1.c.o(.text);
        build/src/prologues/remix_2.c.o(.text);
        build/src/prologues/remix_3.c.o(.text);
        build/src/prologues/remix_4.c.o(.text);
        build/src/prologues/remix_5.c.o(.text);
        build/src/prologues/remix_6.c.o(.text);
        build/src/prologues/remix_7.c.o(.text);
        build/src/prologues/remix_8.c.o(.text);
        build/src/prologues/bunny_hop.c.o(.text);
        build/src/prologues/rap_men.c.o(.text);
        build/src/prologues/rap_women.c.o(.text);
        build/src/prologues/rat_race.c.o(.text);
        build/src/prologues/ninja_bodyguard.c.o(.text);
        build/src/prologues/ninja_reincarnate.c.o(.text);
        build/src/prologues/space_dance.c.o(.text);
        build/src/prologues/tap_trial.c.o(.text);
        build/src/prologues/tap_trial_2.c.o(.text);
        build/src/prologues/toss_boys.c.o(.text);
        build/src/prologues/toss_boys_2.c.o(.text);
        build/src/prologues/tram_and_pauline.c.o(.text);
        build/src/prologues/sick_beats.c.o(.text);
        build/src/prologues/wizards_waltz.c.o(.text);
        build/src/code_08047e50.c.o(.text);
        build/asm/lib_midi.s.o(.text);
        build/src/midi/directsound.c.o(.text);
        build/src/midi/channel.c.o(.text);
        build/src/midi/lfo.c.o(.text);
        build/src/midi/random.c.o(.text);
        build/src/midi/psg.c.o(.text);
        build/src/midi/player.c.o(.text);
        build/asm/libagbsyscall.s.o(.text);
        build/src/lib_sram.c.o(.text);
        build/src/lib_0804ca80.c.o(.text);
        build/asm/lib_0804e418.s.o(.text);
        build/src/lib_0804e564.c.o(.text);
        build/asm/lib_0804e938.s.o(.text);
        *libgcc.a:_call_via_rX.o(.text);
        *libgcc.a:_divsi3.o(.text);
        *libgcc.a:_dvmd_tls.o(.text);
        *libgcc.a:_modsi3.o(.text);
        *libgcc.a:_muldi3.o(.text);
        build/src/udivdi3.c.o(.text);
        *libgcc.a:_udivsi3.o(.text);
        *libgcc.a:_umodsi3.o(.text);
        *libc.a:memcpy.o(.text);
        *libc.a:strcpy.o(.text);
        *libc.a:strlen.o(.text);

        // Some of these are likely rodata sections of src/ files
        build/asm/boot.s.o(.rodata);
        build/data/bitmap_font_data.c.o(.rodata);
        build/data/beatscript_scene_data.c.o(.rodata);
        build/src/scenes/arrival.c.o(.rodata);
        build/data/scenes/cafe/dialogue.c.o(.rodata);
        build/src/scenes/cafe.c.o(.rodata);
        build/src/scenes/data_check.c.o(.rodata);
        build/src/scenes/data_room.c.o(.rodata);
        build/src/scenes/game_select.c.o(.rodata);
        build/data/scenes/game_select/campaigns.c.o(.rodata);
        build/data/scenes/game_select/level_grid.c.o(.rodata);
        build/data/scenes/game_select/scene.c.o(.rodata);
        build/data/scenes/game_select/overlays.c.o(.rodata);
        build/data/scenes/options/data.c.o(.rodata);
        build/data/scenes/perfect/data.c.o(.rodata);
        build/src/scenes/perfect.c.o(.rodata);
        build/data/scenes/results/debug_results.c.o(.rodata);
        build/data/scenes/results/rank_results.c.o(.rodata);
        build/data/scenes/results/score_results.c.o(.rodata);
        build/src/scenes/results.c.o(.rodata);
        build/data/scenes/data_room/reading.c.o(.rodata);
        build/src/scenes/studio_warning.c.o(.rodata);
        build/src/scenes/studio_songs.c.o(.rodata);
        build/src/scenes/studio_drums.c.o(.rodata);
        build/src/scenes/studio_options.c.o(.rodata);
        build/src/scenes/studio_scene.c.o(.rodata);
        build/src/scenes/studio_script.c.o(.rodata);
        build/data/scenes/studio/data.c.o(.rodata);
        build/data/scenes/medal_corner/data.c.o(.rodata);
        build/src/scenes/riq_main_scene.c.o(.rodata);
        build/src/scenes/debug_menu.c.o(.rodata);
        build/src/scenes/debug_menu_table.c.o(.rodata);

        // Rodata section of engines. Some of these are likely rodata sections of src/ files
        build/games/sneaky_spirits/engine.c.o(.rodata);
        build/games/drum_studio/engine.c.o(.rodata);
        build/src/engines/drum_studio.c.o(.rodata);
        build/games/showtime/engine.c.o(.rodata);
        build/games/fireworks/engine.c.o(.rodata);
        build/games/samurai_slice/engine.c.o(.rodata);
        build/games/marching_orders/engine.c.o(.rodata);
        build/games/mr_upbeat/engine.c.o(.rodata);
        build/games/metronome/engine.c.o(.rodata);
        build/games/drum_live/drum_live_menu_engine.c.o(.rodata);
        build/games/bunny_hop/engine.c.o(.rodata);
        build/games/rap_men/engine.c.o(.rodata);
        build/games/rat_race/engine.c.o(.rodata);
        build/games/space_dance/engine.c.o(.rodata);
        build/games/tap_trial/engine.c.o(.rodata);
        build/games/tram_and_pauline/engine.c.o(.rodata);
        build/games/mechanical_horse/engine.c.o(.rodata);
        build/games/rhythm_toys/engine.c.o(.rodata);

        build/games/karate_man/karate_man_text.c.o(.rodata);
        build/games/clappy_trio/clappy_trio_text.c.o(.rodata);
        build/games/polyrhythm/polyrhythm_text.c.o(.rodata);
        build/games/night_walk/night_walk_text.c.o(.rodata);
        build/games/karate_man/karate_man_2_text.c.o(.rodata);
        build/games/rhythm_tweezers/rhythm_tweezers_text.c.o(.rodata);
        build/games/sick_beats/sick_beats_text.c.o(.rodata);
        build/games/bouncy_road/bouncy_road_text.c.o(.rodata);
        build/games/ninja_bodyguard/ninja_bodyguard_text.c.o(.rodata);
        build/games/sneaky_spirits/sneaky_spirits_text.c.o(.rodata);
        build/games/samurai_slice/samurai_slice_text.c.o(.rodata);
        build/games/spaceball/spaceball_text.c.o(.rodata);
        build/games/tap_trial/tap_trial_text.c.o(.rodata);
        build/games/mechanical_horse/mechanical_horse_text.c.o(.rodata);
        build/games/marching_orders/marching_orders_text.c.o(.rodata);
        build/games/wizards_waltz/wizards_waltz_text.c.o(.rodata);
        build/games/remix_1/remix_1_text.c.o(.rodata);
        build/games/bunny_hop/bunny_hop_text.c.o(.rodata);
        build/games/metronome/metronome_text.c.o(.rodata);
        build/games/fireworks/fireworks_text.c.o(.rodata);
        build/games/rat_race/rat_race_text.c.o(.rodata);
        build/games/power_calligraphy/power_calligraphy_text.c.o(.rodata);
        build/games/drum_live/drum_live_text.c.o(.rodata);
        build/games/drum_intro/drum_intro_unused_text.c.o(.rodata);
        build/games/toss_boys/toss_boys_text.c.o(.rodata);
        build/games/drum_intro/drum_intro_unused_2_text.c.o(.rodata);
        build/games/tram_and_pauline/tram_pauline_text.c.o(.rodata);
        build/games/drum_intro/tanuki_and_monkey_text.c.o(.rodata);
        build/games/drum_intro/drum_samurai_cutscene_text.c.o(.rodata);
        build/games/showtime/showtime_text.c.o(.rodata);
        build/games/space_dance/space_dance_text.c.o(.rodata);
        build/games/drum_intro/drum_intro_unused_3_text.c.o(.rodata);
        build/games/rap_men/rap_men_text.c.o(.rodata);
        build/games/quiz_show/quiz_show_text.c.o(.rodata);
        build/games/rhythm_test/rhythm_test_text.c.o(.rodata);
        build/games/drum_studio/drum_lesson_short_1.bs.o(.rodata);
        build/games/drum_studio/drum_lesson_short_4.bs.o(.rodata);
        build/games/drum_studio/drum_lesson_short_8.bs.o(.rodata);
        build/games/drum_studio/drum_lesson_short_5.bs.o(.rodata);
        build/games/drum_studio/drum_lesson_short_7.bs.o(.rodata);
        build/games/drum_studio/drum_lesson_short_9.bs.o(.rodata);
        build/games/drum_studio/drum_lesson_short_6.bs.o(.rodata);
        build/games/drum_studio/drum_lesson_basic_1.bs.o(.rodata);
        build/games/drum_studio/drum_lesson_basic_2.bs.o(.rodata);
        build/games/drum_studio/drum_lesson_short_2.bs.o(.rodata);
        build/games/drum_studio/drum_lesson_short_3.bs.o(.rodata);
        build/games/drum_studio/drum_lesson_long_4.bs.o(.rodata);
        build/games/drum_studio/drum_lesson_long_2.bs.o(.rodata);
        build/games/drum_studio/drum_lesson_long_3.bs.o(.rodata);
        build/games/drum_studio/drum_lesson_long_1.bs.o(.rodata);
        build/games/drum_studio/drum_lesson_long_5.bs.o(.rodata);
        build/games/drum_studio/drum_lesson_long_6.bs.o(.rodata);
        build/games/drum_studio/drum_lesson_hi_tech_1.bs.o(.rodata);
        build/games/drum_studio/drum_lesson_hi_tech_2.bs.o(.rodata);
        build/games/bon_odori/bon_odori_text.c.o(.rodata);
        build/games/tap_trial/tap_trial_2_text.c.o(.rodata);
        build/games/clappy_trio/snappy_trio_text.c.o(.rodata);
        build/games/rap_men/rap_women_text.c.o(.rodata);
        build/games/remix_2/remix_2_text.c.o(.rodata);
        build/games/remix_4/remix_4_text.c.o(.rodata);
        build/games/mr_upbeat/mr_upbeat_text.c.o(.rodata);
        build/games/space_dance/cosmic_dance_text.c.o(.rodata);
        build/games/quiz_show/quiz_show_endless.bs.o(.rodata);
        build/games/staff_credit/staff_credit_text.c.o(.rodata);
        build/games/remix_3/remix_3_text.c.o(.rodata);
        build/games/remix_7/remix_7_text.c.o(.rodata);
        build/games/remix_5/remix_5_text.c.o(.rodata);
        build/games/bon_odori/bon_dance_text.c.o(.rodata);
        build/games/remix_6/remix_6_text.c.o(.rodata);
        build/games/remix_8/remix_8_text.c.o(.rodata);
        
        build/audio/sample_table.json.s.o(.rodata);
        build/data/lib_sram_data.c.o(.rodata);

        build/games/sneaky_spirits/graphics/sneaky_spirits_anim.c.o(.data);
        build/games/sneaky_spirits/graphics/sneaky_spirits_pal.c.o(.data);
        build/games/spaceball/graphics/spaceball_anim.c.o(.data);
        build/games/spaceball/graphics/spaceball_pal.c.o(.data);
        build/games/drum_live/graphics/drum_samurai_band_anim.c.o(.data);
        build/games/drum_live/graphics/drum_samurai_band_pal.c.o(.data);
        build/games/bon_odori/graphics/bon_dance_anim.c.o(.data);
        build/games/bon_odori/graphics/bon_dance_pal.c.o(.data);
        build/games/bon_odori/graphics/bon_odori_anim.c.o(.data);
        build/games/bon_odori/graphics/bon_odori_pal.c.o(.data);
        build/games/karate_man/graphics/karate_man_anim.c.o(.data);
        build/games/karate_man/graphics/karate_man_pal.c.o(.data);
        build/games/sneaky_spirits/graphics/sneaky_spirits_prologue_anim.c.o(.data);
        build/games/sneaky_spirits/graphics/sneaky_spirits_prologue_pal.c.o(.data);
        build/games/spaceball/graphics/spaceball_prologue_anim.c.o(.data);
        build/games/spaceball/graphics/spaceball_prologue_pal.c.o(.data);
        build/games/bon_odori/graphics/bon_dance_prologue_anim.c.o(.data);
        build/games/bon_odori/graphics/bon_dance_prologue_pal.c.o(.data);
        build/games/bon_odori/graphics/bon_odori_prologue_anim.c.o(.data);
        build/games/bon_odori/graphics/bon_odori_prologue_pal.c.o(.data);
        build/games/karate_man/graphics/karate_man_prologue_anim.c.o(.data);
        build/games/karate_man/graphics/karate_man_prologue_pal.c.o(.data);
        build/games/space_dance/graphics/cosmic_dance_prologue_anim.c.o(.data);
        build/games/space_dance/graphics/cosmic_dance_prologue_pal.c.o(.data);
        build/games/night_walk/graphics/night_walk_prologue_anim.c.o(.data);
        build/games/night_walk/graphics/night_walk_prologue_pal.c.o(.data);
        build/games/showtime/graphics/showtime_prologue_anim.c.o(.data);
        build/games/showtime/graphics/showtime_prologue_pal.c.o(.data);
        build/games/bouncy_road/graphics/bouncy_road_prologue_anim.c.o(.data);
        build/games/bouncy_road/graphics/bouncy_road_prologue_pal.c.o(.data);
        build/games/rhythm_tweezers/graphics/rhythm_tweezers_prologue_anim.c.o(.data);
        build/games/rhythm_tweezers/graphics/rhythm_tweezers_prologue_pal.c.o(.data);
        build/games/fireworks/graphics/fireworks_prologue_anim.c.o(.data);
        build/games/fireworks/graphics/fireworks_prologue_pal.c.o(.data);
        build/games/clappy_trio/graphics/clappy_trio_prologue_anim.c.o(.data);
        build/games/clappy_trio/graphics/clappy_trio_prologue_pal.c.o(.data);
        build/games/clappy_trio/graphics/snappy_trio_prologue_anim.c.o(.data);
        build/games/clappy_trio/graphics/snappy_trio_prologue_pal.c.o(.data);
        build/games/samurai_slice/graphics/samurai_slice_prologue_anim.c.o(.data);
        build/games/samurai_slice/graphics/samurai_slice_prologue_pal.c.o(.data);
        build/games/power_calligraphy/graphics/power_calligraphy_prologue_anim.c.o(.data);
        build/games/power_calligraphy/graphics/power_calligraphy_prologue_pal.c.o(.data);
        build/games/marching_orders/graphics/marching_orders_prologue_anim.c.o(.data);
        build/games/marching_orders/graphics/marching_orders_prologue_pal.c.o(.data);
        build/games/marching_orders/graphics/marching_orders_2_prologue_anim.c.o(.data);
        build/games/marching_orders/graphics/marching_orders_2_prologue_pal.c.o(.data);
        build/games/polyrhythm/graphics/polyrhythm_prologue_anim.c.o(.data);
        build/games/polyrhythm/graphics/polyrhythm_prologue_pal.c.o(.data);
        build/games/quiz_show/graphics/quiz_show_prologue_anim.c.o(.data);
        build/games/quiz_show/graphics/quiz_show_prologue_pal.c.o(.data);
        build/games/remix_1/graphics/remix_1_prologue_anim.c.o(.data);
        build/games/remix_1/graphics/remix_1_prologue_pal.c.o(.data);
        build/games/remix_2/graphics/remix_2_prologue_anim.c.o(.data);
        build/games/remix_2/graphics/remix_2_prologue_pal.c.o(.data);
        build/games/remix_3/graphics/remix_3_prologue_anim.c.o(.data);
        build/games/remix_3/graphics/remix_3_prologue_pal.c.o(.data);
        build/games/remix_4/graphics/remix_4_prologue_anim.c.o(.data);
        build/games/remix_4/graphics/remix_4_prologue_pal.c.o(.data);
        build/games/remix_5/graphics/remix_5_prologue_anim.c.o(.data);
        build/games/remix_5/graphics/remix_5_prologue_pal.c.o(.data);
        build/games/remix_6/graphics/remix_6_prologue_anim.c.o(.data);
        build/games/remix_6/graphics/remix_6_prologue_pal.c.o(.data);
        build/games/remix_7/graphics/remix_7_prologue_anim.c.o(.data);
        build/games/remix_7/graphics/remix_7_prologue_pal.c.o(.data);
        build/games/remix_8/graphics/remix_8_prologue_anim.c.o(.data);
        build/games/remix_8/graphics/remix_8_prologue_pal.c.o(.data);
        build/games/bunny_hop/graphics/bunny_hop_prologue_anim.c.o(.data);
        build/games/bunny_hop/graphics/bunny_hop_prologue_pal.c.o(.data);
        build/games/rap_men/graphics/rap_men_prologue_anim.c.o(.data);
        build/games/rap_men/graphics/rap_men_prologue_pal.c.o(.data);
        build/games/rap_men/graphics/rap_women_prologue_anim.c.o(.data);
        build/games/rap_men/graphics/rap_women_prologue_pal.c.o(.data);
        build/games/rat_race/graphics/rat_race_prologue_anim.c.o(.data);
        build/games/rat_race/graphics/rat_race_prologue_pal.c.o(.data);
        build/games/ninja_bodyguard/graphics/ninja_bodyguard_prologue_anim.c.o(.data);
        build/games/ninja_bodyguard/graphics/ninja_bodyguard_prologue_pal.c.o(.data);
        build/games/ninja_bodyguard/graphics/ninja_reincarnate_prologue_anim.c.o(.data);
        build/games/ninja_bodyguard/graphics/ninja_reincarnate_prologue_pal.c.o(.data);
        build/games/space_dance/graphics/space_dance_prologue_anim.c.o(.data);
        build/games/space_dance/graphics/space_dance_prologue_pal.c.o(.data);
        build/games/tap_trial/graphics/tap_trial_prologue_anim.c.o(.data);
        build/games/tap_trial/graphics/tap_trial_prologue_pal.c.o(.data);
        build/games/tap_trial/graphics/tap_trial_2_prologue_anim.c.o(.data);
        build/games/tap_trial/graphics/tap_trial_2_prologue_pal.c.o(.data);
        build/games/toss_boys/graphics/toss_boys_prologue_anim.c.o(.data);
        build/games/toss_boys/graphics/toss_boys_prologue_pal.c.o(.data);
        build/games/toss_boys/graphics/toss_boys_2_prologue_anim.c.o(.data);
        build/games/toss_boys/graphics/toss_boys_2_prologue_pal.c.o(.data);
        build/games/tram_and_pauline/graphics/tram_pauline_prologue_anim.c.o(.data);
        build/games/tram_and_pauline/graphics/tram_pauline_prologue_pal.c.o(.data);
        build/games/sick_beats/graphics/sick_beats_prologue_anim.c.o(.data);
        build/games/sick_beats/graphics/sick_beats_prologue_pal.c.o(.data);
        build/games/wizards_waltz/graphics/wizards_waltz_prologue_anim.c.o(.data);
        build/games/wizards_waltz/graphics/wizards_waltz_prologue_pal.c.o(.data);
        build/graphics/placeholder_prologue/placeholder_prologue_anim.c.o(.data);
        build/graphics/placeholder_prologue/placeholder_prologue_pal.c.o(.data);
        build/games/mannequin_factory/graphics/mannequin_factory_anim.c.o(.data);
        build/games/mannequin_factory/graphics/mannequin_factory_pal.c.o(.data);
        build/games/space_dance/graphics/cosmic_dance_anim.c.o(.data);
        build/games/space_dance/graphics/cosmic_dance_pal.c.o(.data);
        build/games/staff_credit/graphics/staff_credit_pal.c.o(.data);
        build/games/drum_live/graphics/drum_boys_anim.c.o(.data);
        build/games/drum_live/graphics/drum_boys_pal.c.o(.data);
        build/games/drum_live/graphics/drum_girls_anim.c.o(.data);
        build/games/drum_live/graphics/drum_girls_pal.c.o(.data);
        build/games/drum_intro/graphics/drum_tutorial_anim.c.o(.data);
        build/games/drum_intro/graphics/drum_tutorial_pal.c.o(.data);
        build/games/drum_intro/graphics/drum_cutscene_anim.c.o(.data);
        build/games/drum_intro/graphics/drum_cutscene_pal.c.o(.data);
        build/games/drum_studio/graphics/drum_lessons_player_anim.c.o(.data);
        build/games/drum_studio/graphics/drum_lessons_unk_anim.c.o(.data);
        build/games/drum_studio/graphics/drum_lessons_teacher_anim.c.o(.data);
        build/games/drum_studio/graphics/drum_lessons_pal.c.o(.data);
        build/games/night_walk/graphics/night_walk_anim.c.o(.data);
        build/games/night_walk/graphics/night_walk_pal.c.o(.data);
        build/games/showtime/graphics/showtime_anim.c.o(.data);
        build/games/showtime/graphics/showtime_pal.c.o(.data);
        build/games/bouncy_road/graphics/bouncy_road_anim.c.o(.data);
        build/games/bouncy_road/graphics/bouncy_road_pal.c.o(.data);
        build/graphics/font/warioware_outline_large_latin_upper_glyphs.raw.4bpp.o(.rodata*);
        build/graphics/font/warioware_outline_large_latin_lower_glyphs.raw.4bpp.o(.rodata*);
        build/graphics/font/warioware_outline_large_hiragana_glyphs.raw.4bpp.o(.rodata*);
        build/graphics/font/warioware_outline_large_katakana_glyphs.raw.4bpp.o(.rodata*);
        build/graphics/font/warioware_outline_large_numeral_wide_glyphs.raw.4bpp.o(.rodata*);
        build/graphics/font/warioware_outline_large_numeral_narrow_glyphs.raw.4bpp.o(.rodata*);
        build/graphics/font/warioware_outline_large_symbol_glyphs.raw.4bpp.o(.rodata*);
        build/graphics/font/warioware_body_text_latin_upper_glyphs.raw.4bpp.o(.rodata*);
        build/graphics/font/warioware_body_text_latin_lower_glyphs.raw.4bpp.o(.rodata*);
        build/graphics/font/warioware_body_text_hiragana_glyphs.raw.4bpp.o(.rodata*);
        build/graphics/font/warioware_body_text_katakana_glyphs.raw.4bpp.o(.rodata*);
        build/graphics/font/warioware_body_text_numeral_glyphs.raw.4bpp.o(.rodata*);
        build/graphics/font/warioware_body_text_symbol_glyphs.raw.4bpp.o(.rodata*);
        build/graphics/font/warioware_outline_small_latin_upper_glyphs.raw.4bpp.o(.rodata*);
        build/graphics/font/warioware_outline_small_latin_lower_glyphs.raw.4bpp.o(.rodata*);
        build/graphics/font/warioware_outline_small_hiragana_glyphs.raw.4bpp.o(.rodata*);
        build/graphics/font/warioware_outline_small_katakana_glyphs.raw.4bpp.o(.rodata*);
        build/graphics/font/warioware_outline_small_numeral_glyphs.raw.4bpp.o(.rodata*);
        build/graphics/font/warioware_outline_small_symbol_glyphs.raw.4bpp.o(.rodata*);
        build/graphics/font/warioware_body_icon_latin_upper_glyphs.raw.4bpp.o(.rodata*);
        build/graphics/font/warioware_body_icon_numeral_glyphs.raw.4bpp.o(.rodata*);
        build/games/rhythm_tweezers/graphics/rhythm_tweezers_anim.c.o(.data);
        build/games/rhythm_tweezers/graphics/rhythm_tweezers_pal.c.o(.data);
        build/games/fireworks/graphics/fireworks_anim.c.o(.data);
        build/games/fireworks/graphics/fireworks_pal.c.o(.data);
        build/games/clappy_trio/graphics/clappy_trio_anim.c.o(.data);
        build/games/clappy_trio/graphics/clappy_trio_pal.c.o(.data);
        build/games/clappy_trio/graphics/snappy_trio_anim.c.o(.data);
        build/games/clappy_trio/graphics/snappy_trio_pal.c.o(.data);
        build/games/samurai_slice/graphics/samurai_slice_anim.c.o(.data);
        build/games/samurai_slice/graphics/samurai_slice_pal.c.o(.data);
        build/games/power_calligraphy/graphics/power_calligraphy_brush_anim.c.o(.data);
        build/games/power_calligraphy/graphics/power_calligraphy_people_anim.c.o(.data);
        build/games/power_calligraphy/graphics/power_calligraphy_pal.c.o(.data);
        build/games/rhythm_test/graphics/rhythm_test_anim.c.o(.data);
        build/games/rhythm_test/graphics/rhythm_test_pal.c.o(.data);
        build/games/marching_orders/graphics/marching_orders_anim.c.o(.data);
        build/games/marching_orders/graphics/marching_orders_pal.c.o(.data);
        build/games/marching_orders/graphics/marching_orders_2_anim.c.o(.data);
        build/games/marching_orders/graphics/marching_orders_2_pal.c.o(.data);
        build/games/metronome/graphics/metronome_anim.c.o(.data);
        build/games/metronome/graphics/metronome_pal.c.o(.data);
        build/graphics/studio/studio_bg_monitor_pal.c.o(.data);
        build/graphics/options/options_anim.c.o(.data);
        build/graphics/options/options_pal.c.o(.data);
        build/games/polyrhythm/graphics/polyrhythm_anim.c.o(.data);
        build/games/polyrhythm/graphics/polyrhythm_pal.c.o(.data);
        build/games/drum_live/graphics/drum_live_menu_anim.c.o(.data);
        build/games/drum_live/graphics/drum_live_menu_pal.c.o(.data);
        build/games/quiz_show/graphics/quiz_show_anim.c.o(.data);
        build/games/quiz_show/graphics/quiz_show_pal.c.o(.data);
        build/games/bunny_hop/graphics/bunny_hop_anim.c.o(.data);
        build/games/bunny_hop/graphics/bunny_hop_pal.c.o(.data);
        build/games/rap_men/graphics/rap_men_anim.c.o(.data);
        build/games/rap_men/graphics/rap_men_pal.c.o(.data);
        build/games/rap_men/graphics/rap_women_anim.c.o(.data);
        build/games/rap_men/graphics/rap_women_pal.c.o(.data);
        build/games/rat_race/graphics/rat_race_anim.c.o(.data);
        build/games/rat_race/graphics/rat_race_pal.c.o(.data);
        build/graphics/epilogues/epilogue_bg_pal.c.o(.data);
        build/graphics/arrival/arrival_anim.c.o(.data);
        build/graphics/arrival/arrival_pal.c.o(.data);
        build/graphics/cafe/cafe_anim.c.o(.data);
        build/graphics/cafe/cafe_pal.c.o(.data);
        build/graphics/medal_corner/endless_games_menu_anim.c.o(.data);
        build/graphics/medal_corner/endless_games_menu_pal.c.o(.data);
        build/graphics/studio/studio_memory_usage_graph_anim.c.o(.data);
        build/graphics/studio/studio_memory_usage_graph_pal.c.o(.data);
        build/graphics/medal_corner/drum_lessons_menu_anim.c.o(.data);
        build/graphics/medal_corner/drum_lessons_menu_pal.c.o(.data);
        build/graphics/data_room/data_room_menu_anim.c.o(.data);
        build/graphics/data_room/data_room_menu_pal.c.o(.data);
        build/graphics/game_select/game_select_anim.c.o(.data);
        build/graphics/game_select/game_select_pal.c.o(.data);
        build/graphics/game_select/game_select_overlay_pal.c.o(.data);
        build/graphics/game_select/icon_overlays/icon_overlay_striped_border.bin.o(.rodata*);
        build/graphics/game_select/icon_overlays/icon_overlay_closed.bin.o(.rodata*);
        build/graphics/game_select/icon_overlays/icon_overlay_normal_border.bin.o(.rodata*);
        build/graphics/game_select/icon_overlays/icon_overlay_blank1.bin.o(.rodata*);
        build/graphics/game_select/icon_overlays/icon_overlay_medal.bin.o(.rodata*);
        build/graphics/game_select/icon_overlays/icon_overlay_new_game.bin.o(.rodata*);
        build/graphics/game_select/icon_overlays/icon_overlay_blank2.bin.o(.rodata*);
        build/graphics/game_select/game_select_icon_pal.c.o(.data);
        build/graphics/game_select/game_icons/icon_karate_man_2.bin.o(.rodata*);
        build/graphics/game_select/game_icons/icon_sneaky_spirits.bin.o(.rodata*);
        build/graphics/game_select/game_icons/icon_remix6.bin.o(.rodata*);
        build/graphics/game_select/game_icons/icon_polyrhythm.bin.o(.rodata*);
        build/graphics/game_select/game_icons/icon_clappy_trio.bin.o(.rodata*);
        build/graphics/game_select/game_icons/icon_ninja_bodyguard.bin.o(.rodata*);
        build/graphics/game_select/game_icons/icon_tap_trial.bin.o(.rodata*);
        build/graphics/game_select/game_icons/icon_night_walk.bin.o(.rodata*);
        build/graphics/game_select/game_icons/icon_karate_man.bin.o(.rodata*);
        build/graphics/game_select/game_icons/icon_spaceball.bin.o(.rodata*);
        build/graphics/game_select/game_icons/icon_snappy_trio.bin.o(.rodata*);
        build/graphics/game_select/game_icons/icon_tap_trial_2.bin.o(.rodata*);
        build/graphics/game_select/game_icons/icon_bouncy_road.bin.o(.rodata*);
        build/graphics/game_select/game_icons/icon_sick_beats.bin.o(.rodata*);
        build/graphics/game_select/game_icons/icon_rhythm_tweezers.bin.o(.rodata*);
        build/graphics/game_select/game_icons/icon_rap_women.bin.o(.rodata*);
        build/graphics/game_select/game_icons/icon_cosmic_dance.bin.o(.rodata*);
        build/graphics/game_select/game_icons/icon_bon_dance.bin.o(.rodata*);
        build/graphics/game_select/game_icons/icon_samurai_slice.bin.o(.rodata*);
        build/graphics/game_select/game_icons/icon_remix7.bin.o(.rodata*);
        build/graphics/game_select/game_icons/icon_marching_orders_2.bin.o(.rodata*);
        build/graphics/game_select/game_icons/icon_marching_orders.bin.o(.rodata*);
        build/graphics/game_select/game_icons/icon_remix1.bin.o(.rodata*);
        build/graphics/game_select/game_icons/icon_wizards_waltz.bin.o(.rodata*);
        build/graphics/game_select/game_icons/icon_bunny_hop.bin.o(.rodata*);
        build/graphics/game_select/game_icons/icon_rhythm_tweezers_2.bin.o(.rodata*);
        build/graphics/game_select/game_icons/icon_fireworks.bin.o(.rodata*);
        build/graphics/game_select/game_icons/icon_remix2.bin.o(.rodata*);
        build/graphics/game_select/game_icons/icon_power_calligraphy.bin.o(.rodata*);
        build/graphics/game_select/game_icons/icon_toss_boys_2.bin.o(.rodata*);
        build/graphics/game_select/game_icons/icon_toss_boys.bin.o(.rodata*);
        build/graphics/game_select/game_icons/icon_rat_race.bin.o(.rodata*);
        build/graphics/game_select/game_icons/icon_tram_pauline.bin.o(.rodata*);
        build/graphics/game_select/game_icons/icon_remix3.bin.o(.rodata*);
        build/graphics/game_select/game_icons/icon_remix4.bin.o(.rodata*);
        build/graphics/game_select/game_icons/icon_bon_odori.bin.o(.rodata*);
        build/graphics/game_select/game_icons/icon_showtime.bin.o(.rodata*);
        build/graphics/game_select/game_icons/icon_remix8.bin.o(.rodata*);
        build/graphics/game_select/game_icons/icon_ninja_reincarnate.bin.o(.rodata*);
        build/graphics/game_select/game_icons/icon_remix5.bin.o(.rodata*);
        build/graphics/game_select/game_icons/icon_space_dance.bin.o(.rodata*);
        build/graphics/game_select/game_icons/icon_night_walk_2.bin.o(.rodata*);
        build/graphics/game_select/game_icons/icon_rap_men.bin.o(.rodata*);
        build/graphics/game_select/game_icons/icon_quiz_show.bin.o(.rodata*);
        build/graphics/game_select/game_icons/icon_live_menu.bin.o(.rodata*);
        build/graphics/game_select/game_icons/icon_cafe.bin.o(.rodata*);
        build/graphics/game_select/game_icons/icon_toys_menu.bin.o(.rodata*);
        build/graphics/game_select/game_icons/icon_endless_menu.bin.o(.rodata*);
        build/graphics/game_select/game_icons/icon_lessons_menu.bin.o(.rodata*);
        build/graphics/game_select/game_icons/icon_staff_credit.bin.o(.rodata*);
        build/graphics/game_select/game_icons/icon_bouncy_road_2.bin.o(.rodata*);
        build/graphics/game_select/game_icons/icon_polyrhythm_2.bin.o(.rodata*);
        build/graphics/game_select/game_icons/icon_spaceball_2.bin.o(.rodata*);
        build/graphics/game_select/game_icons/icon_sneaky_spirits_2.bin.o(.rodata*);
        build/graphics/game_select/game_icons/icon_slot54.bin.o(.rodata*);
        build/graphics/game_select/game_icons/icon_slot55.bin.o(.rodata*);
        build/graphics/game_select/game_icons/icon_slot56.bin.o(.rodata*);
        build/graphics/game_select/game_icons/icon_slot57.bin.o(.rodata*);
        build/graphics/game_select/game_icons/icon_slot58.bin.o(.rodata*);
        build/graphics/game_select/game_icons/icon_slot59.bin.o(.rodata*);
        build/graphics/main_menu/main_menu_anim.c.o(.data);
        build/graphics/main_menu/main_menu_pal.c.o(.data);
        build/graphics/perfect/perfect_certificate_pal.c.o(.data);
        build/graphics/gameplay/gameplay_anim.c.o(.data);
        build/graphics/gameplay/gameplay_pal.c.o(.data);
        build/graphics/data_room/data_room_reading_anim.c.o(.data);
        build/graphics/data_room/data_room_reading_pal.c.o(.data);
        build/graphics/data_room/read_error_anim.c.o(.data);
        build/graphics/data_room/read_error_pal.c.o(.data);
        build/graphics/results/results_level_anim.c.o(.data);
        build/graphics/results/results_level_pal.c.o(.data);
        build/graphics/results/results_score_anim.c.o(.data);
        build/graphics/results/results_score_pal.c.o(.data);
        build/graphics/studio/studio_anim.c.o(.data);
        build/graphics/studio/studio_pal.c.o(.data);
        build/graphics/title/title_anim.c.o(.data);
        build/graphics/title/title_pal.c.o(.data);
        build/graphics/medal_corner/rhythm_toys_menu_anim.c.o(.data);
        build/graphics/medal_corner/medal_corner_menus_anim.c.o(.data);
        build/graphics/medal_corner/rhythm_toys_menu_pal.c.o(.data);
        build/games/rhythm_toys/graphics/cat_machine_anim.c.o(.data);
        build/games/rhythm_toys/graphics/cat_machine_pal.c.o(.data);
        build/games/rhythm_toys/graphics/rap_machine_anim.c.o(.data);
        build/games/rhythm_toys/graphics/rap_machine_pal.c.o(.data);
        build/games/rhythm_toys/graphics/love_machine_anim.c.o(.data);
        build/games/rhythm_toys/graphics/love_machine_pal.c.o(.data);
        build/games/ninja_bodyguard/graphics/ninja_bodyguard_anim.c.o(.data);
        build/games/ninja_bodyguard/graphics/ninja_bodyguard_pal.c.o(.data);
        build/games/space_dance/graphics/space_dance_anim.c.o(.data);
        build/games/space_dance/graphics/space_dance_pal.c.o(.data);
        build/games/marching_orders/graphics/marching_orders_remix_7_anim.c.o(.data);
        build/games/marching_orders/graphics/marching_orders_remix_7_pal.c.o(.data);
        build/games/drum_intro/graphics/tanuki_and_monkey_anim.c.o(.data);
        build/games/drum_intro/graphics/tanuki_and_monkey_pal.c.o(.data);
        build/games/tap_trial/graphics/tap_trial_anim.c.o(.data);
        build/games/tap_trial/graphics/tap_trial_pal.c.o(.data);
        build/games/tap_trial/graphics/tap_trial_remix_8_anim.c.o(.data);
        build/games/tap_trial/graphics/tap_trial_remix_8_pal.c.o(.data);
        build/games/tap_trial/graphics/tap_trial_remix_7_anim.c.o(.data);
        build/games/tap_trial/graphics/tap_trial_remix_7_pal.c.o(.data);
        build/games/tap_trial/graphics/tap_trial_remix_5_anim.c.o(.data);
        build/games/tap_trial/graphics/tap_trial_remix_5_pal.c.o(.data);
        build/games/tap_trial/graphics/tap_trial_2_anim.c.o(.data);
        build/games/tap_trial/graphics/tap_trial_2_pal.c.o(.data);
        build/games/toss_boys/graphics/toss_boys_anim.c.o(.data);
        build/games/toss_boys/graphics/toss_boys_pal.c.o(.data);
        build/games/toss_boys/graphics/toss_boys_remix_5_anim.c.o(.data);
        build/games/toss_boys/graphics/toss_boys_remix_5_pal.c.o(.data);
        build/games/toss_boys/graphics/toss_boys_2_anim.c.o(.data);
        build/games/toss_boys/graphics/toss_boys_2_pal.c.o(.data);
        build/games/tram_and_pauline/graphics/tram_pauline_tutorial_anim.c.o(.data);
        build/games/tram_and_pauline/graphics/tram_pauline_tutorial_pal.c.o(.data);
        build/games/tram_and_pauline/graphics/tram_pauline_anim.c.o(.data);
        build/games/tram_and_pauline/graphics/tram_pauline_pal.c.o(.data);
        build/games/mechanical_horse/graphics/mechanical_horse_anim.c.o(.data);
        build/games/mechanical_horse/graphics/mechanical_horse_pal.c.o(.data);
        build/games/sick_beats/graphics/sick_beats_anim.c.o(.data);
        build/games/sick_beats/graphics/sick_beats_pal.c.o(.data);
        build/graphics/warning/warning_anim.c.o(.data);
        build/graphics/warning/warning_pal.c.o(.data);
        build/games/wizards_waltz/graphics/wizards_waltz_anim.c.o(.data);
        build/games/wizards_waltz/graphics/wizards_waltz_pal.c.o(.data);
        build/games/ninja_bodyguard/graphics/ninja_reincarnate_anim.c.o(.data);
        build/games/ninja_bodyguard/graphics/ninja_reincarnate_pal.c.o(.data);
        build/graphics/gameplay/gameplay_unused_warioware_anim.c.o(.data);
        build/graphics/gameplay/gameplay_unused_warioware_pal.c.o(.data);

        build/data/__clz_tab.c.o(.rodata);
        build/data/agb_main_data.c.o(.data);
        build/data/math_tables.c.o(.data);
        build/src/palette.c.o(.data);
        build/src/graphics_table.c.o(.data);
        build/data/data_0893640c.c.o(.data);
        build/bin/karate_face_maps.bin.o(.rodata*);
        build/data/bitmap_font_data.c.o(.data);
        build/data/data_08936b54.c.o(.data);
        build/data/sine_table.c.o(.data);
        build/data/text_printer_data.c.o(.data);
        build/bin/text_small_glyphs.bin.o(.rodata*);
        build/bin/text_small_glyph_sizes.bin.o(.rodata*);
        build/bin/text_medium_glyphs.bin.o(.rodata*);
        build/bin/text_medium_glyph_sizes.bin.o(.rodata*);
        build/bin/text_large_glyphs.bin.o(.rodata*);
        build/bin/text_large_glyph_sizes.bin.o(.rodata*);
        build/data/unknown_anim_data.c.o(.data);
        build/data/beatscript_scene_data.c.o(.data);
        build/data/sound_tempo_table.c.o(.data);

        build/data/scenes/arrival/data.c.o(.data);
        build/data/scenes/arrival/script.bs.o(.scene);
        build/data/scenes/cafe/dialogue.c.o(.data);
        build/src/scenes/cafe.c.o(.data);
        build/data/scenes/cafe/scene.c.o(.data);
        build/data/scenes/cafe/script.bs.o(.scene);
        build/data/scenes/debug/data_check.c.o(.data);
        build/data/scenes/debug/data_check.bs.o(.scene);
        build/data/scenes/data_room/data_room.c.o(.data);
        build/data/scenes/data_room/data_room.bs.o(.scene);
        build/data/scenes/main_menu/data.c.o(.data);
        build/data/scenes/main_menu/scene.bs.o(.scene);
        build/data/scenes/game_select/scene.bs.o(.scene);
        build/data/scenes/game_select/campaigns.c.o(.data);
        build/data/scenes/game_select/level_grid.c.o(.data);
        build/data/scenes/game_select/scene.c.o(.data);
        build/data/scenes/game_select/overlays.c.o(.data);
        build/data/scenes/options/data.c.o(.data);
        build/data/scenes/options/scene.bs.o(.scene);
        build/data/scenes/perfect/data.c.o(.data);
        build/data/scenes/perfect/scene.bs.o(.scene);

        build/data/scenes/gameplay/data.c.o(.data);
        build/games/karate_man/karate_man.bs.o(.script.entry);
        build/games/clappy_trio/snappy_trio_unused.bs.o(.script.entry);
        build/games/clappy_trio/clappy_trio.bs.o(.script.entry);
        build/games/polyrhythm/polyrhythm.bs.o(.script.entry);
        build/games/polyrhythm/polyrhythm_2.bs.o(.script.entry);
        build/games/night_walk/night_walk.bs.o(.script.entry);
        build/games/night_walk/night_walk_2.bs.o(.script.entry);
        build/games/karate_man/karate_man_2.bs.o(.script.entry);
        build/games/rhythm_tweezers/rhythm_tweezers.bs.o(.script.entry);
        build/games/rhythm_tweezers/rhythm_tweezers_2.bs.o(.script.entry);
        build/games/sick_beats/sick_beats.bs.o(.script.entry);
        build/games/bouncy_road/bouncy_road_unused.bs.o(.script.entry);
        build/games/bouncy_road/bouncy_road_unused_2.bs.o(.script.entry);
        build/games/bouncy_road/bouncy_road.bs.o(.script.entry);
        build/games/bouncy_road/bouncy_road_2.bs.o(.script.entry);
        build/games/ninja_bodyguard/ninja_bodyguard.bs.o(.script.entry);
        build/games/ninja_bodyguard/ninja_reincarnate.bs.o(.script.entry);
        build/games/sneaky_spirits/sneaky_spirits.bs.o(.script.entry);
        build/games/sneaky_spirits/sneaky_spirits_2.bs.o(.script.entry);
        build/games/samurai_slice/samurai_slice.bs.o(.script.entry);
        build/games/spaceball/spaceball_unused.bs.o(.script.entry);
        build/games/spaceball/spaceball_unused_2.bs.o(.script.entry);
        build/games/spaceball/spaceball.bs.o(.script.entry);
        build/games/spaceball/spaceball_2.bs.o(.script.entry);
        build/games/tap_trial/tap_trial_unused.bs.o(.script.entry);
        build/games/tap_trial/tap_trial.bs.o(.script.entry);
        build/games/mechanical_horse/mechanical_horse_unused.bs.o(.script.entry);
        build/games/mechanical_horse/mechanical_horse.bs.o(.script.entry);
        build/games/marching_orders/marching_orders_unused.bs.o(.script.entry);
        build/games/marching_orders/marching_orders.bs.o(.script.entry);
        build/games/marching_orders/marching_orders_2.bs.o(.script.entry);
        build/games/wizards_waltz/wizards_waltz.bs.o(.script.entry);
        build/games/remix_1/remix_1_unused.bs.o(.script.entry);
        build/games/remix_1/remix_1.bs.o(.script.entry);
        build/games/bunny_hop/bunny_hop.bs.o(.script.entry);
        build/games/metronome/metronome.bs.o(.script.entry);
        build/games/fireworks/fireworks.bs.o(.script.entry);
        build/games/rat_race/rat_race.bs.o(.script.entry);
        build/games/power_calligraphy/power_calligraphy.bs.o(.script.entry);
        build/games/drum_live/drum_girls_live_unused.bs.o(.script.entry);
        build/games/drum_intro/drum_intro_unused.bs.o(.script.entry);
        build/games/toss_boys/toss_boys_2.bs.o(.script.entry);
        build/games/toss_boys/toss_boys.bs.o(.script.entry);
        build/games/drum_intro/drum_intro_unused_2.bs.o(.script.entry);
        build/games/tram_and_pauline/tram_and_pauline.bs.o(.script.entry);
        build/games/drum_intro/tanuki_and_monkey.bs.o(.script.entry);
        build/games/drum_intro/drum_samurai_demo_cutscene.bs.o(.script.entry);
        build/games/drum_intro/drum_samurai_opening_cutscene.bs.o(.script.entry);
        build/games/showtime/showtime.bs.o(.script.entry);
        build/games/space_dance/space_dance.bs.o(.script.entry);
        build/games/drum_intro/drum_intro_unused_3.bs.o(.script.entry);
        build/games/rap_men/rap_men.bs.o(.script.entry);
        build/games/quiz_show/quiz_show.bs.o(.script.entry);
        build/games/rhythm_test/rhythm_test.bs.o(.script.entry);
        build/games/drum_studio/drum_studio.bs.o(.script.entry);
        build/games/drum_studio/drum_lesson_short_1.bs.o(.script.entry);
        build/games/drum_studio/drum_lesson_short_4.bs.o(.script.entry);
        build/games/drum_studio/drum_lesson_short_8.bs.o(.script.entry);
        build/games/drum_studio/drum_lesson_short_5.bs.o(.script.entry);
        build/games/drum_studio/drum_lesson_short_7.bs.o(.script.entry);
        build/games/drum_studio/drum_lesson_short_9.bs.o(.script.entry);
        build/games/drum_studio/drum_lesson_short_6.bs.o(.script.entry);
        build/games/drum_studio/drum_lesson_basic_1.bs.o(.script.entry);
        build/games/drum_studio/drum_lesson_basic_2.bs.o(.script.entry);
        build/games/drum_studio/drum_lesson_short_2.bs.o(.script.entry);
        build/games/drum_studio/drum_lesson_short_3.bs.o(.script.entry);
        build/games/drum_studio/drum_lesson_long_4.bs.o(.script.entry);
        build/games/drum_studio/drum_lesson_long_2.bs.o(.script.entry);
        build/games/drum_studio/drum_lesson_long_3.bs.o(.script.entry);
        build/games/drum_studio/drum_lesson_long_1.bs.o(.script.entry);
        build/games/drum_studio/drum_lesson_long_5.bs.o(.script.entry);
        build/games/drum_studio/drum_lesson_long_6.bs.o(.script.entry);
        build/games/drum_studio/drum_lesson_hi_tech_1.bs.o(.script.entry);
        build/games/drum_studio/drum_lesson_hi_tech_2.bs.o(.script.entry);
        build/games/rhythm_toys/rhythm_toys.bs.o(.script.entry);
        build/games/bon_odori/bon_odori.bs.o(.script.entry);
        build/games/tap_trial/tap_trial_2.bs.o(.script.entry);
        build/games/clappy_trio/snappy_trio.bs.o(.script.entry);
        build/games/rap_men/rap_women.bs.o(.script.entry);
        build/games/rap_men/rap_women_unused.bs.o(.script.entry);
        build/games/remix_2/remix_2.bs.o(.script.entry);
        build/games/remix_4/remix_4.bs.o(.script.entry);
        build/games/mr_upbeat/mr_upbeat.bs.o(.script.entry);
        build/games/space_dance/cosmic_dance.bs.o(.script.entry);
        build/games/mannequin_factory/mannequin_factory.bs.o(.script.entry);
        build/games/quiz_show/quiz_show_endless.bs.o(.script.entry);
        build/games/sick_beats/sick_beats_endless.bs.o(.script.entry);
        build/games/staff_credit/staff_credit.bs.o(.script.entry);
        build/games/drum_live/drum_live.bs.o(.script.entry);
        build/games/remix_3/remix_3.bs.o(.script.entry);
        build/games/remix_7/remix_7.bs.o(.script.entry);
        build/games/remix_5/remix_5.bs.o(.script.entry);
        build/games/bon_odori/bon_dance.bs.o(.script.entry);
        build/games/remix_6/remix_6.bs.o(.script.entry);
        build/games/remix_8/remix_8.bs.o(.script.entry);

        build/data/scenes/results/debug_results.c.o(.data);
        build/data/scenes/results/debug_scene.bs.o(.scene);
        build/data/scenes/results/rank_results.c.o(.data);
        build/data/scenes/results/rank_scene.bs.o(.scene);
        build/data/scenes/results/score_results.c.o(.data);
        build/data/scenes/results/score_scene.bs.o(.scene);
        build/src/scenes/results.c.o(.data);
        build/data/scenes/epilogue/data.c.o(.data);
        build/data/scenes/epilogue/scene.bs.o(.scene);
        build/data/scenes/data_room/reading.c.o(.data);
        build/data/scenes/data_room/reading.bs.o(.scene);
        build/data/scenes/data_room/read_error.c.o(.data);
        build/data/scenes/data_room/read_error.bs.o(.scene);
        build/src/scenes/studio_warning.c.o(.data);
        build/src/scenes/studio_songs.c.o(.data);
        build/src/scenes/studio_drums.c.o(.data);
        build/src/scenes/studio_options.c.o(.data);
        build/src/scenes/studio_scene.c.o(.data);
        build/src/scenes/studio_script.c.o(.data);
        build/data/scenes/studio/data.c.o(.data);
        build/data/scenes/studio/scene.bs.o(.scene);
        build/data/scenes/studio/scripts.bs.o(.script);
        build/data/scenes/title/data.c.o(.data);
        build/data/scenes/title/scene.bs.o(.scene);
        build/data/scenes/medal_corner/data.c.o(.data);
        build/data/scenes/medal_corner/scene.bs.o(.scene);
        build/src/scenes/riq_main_scene.c.o(.data);
        build/data/scenes/warning/scene.bs.o(.scene);
        build/data/scenes/warning/data.c.o(.data);
        build/data/scenes/debug/menu.c.o(.data);
        build/data/scenes/debug/menu.bs.o(.scene);
        build/src/scenes/debug_menu.c.o(.data);
        build/src/scenes/debug_menu_table.c.o(.data);
        build/data/scenes/debug/flash_mem_test.c.o(.data);
        build/data/scenes/debug/flash_mem_test.bs.o(.scene);
        build/data/scenes/debug/data_clear.c.o(.data);
        build/data/scenes/debug/data_clear.bs.o(.scene);
        build/data/scenes/debug/asset_test.c.o(.data);
        build/data/scenes/debug/asset_test.bs.o(.scene);
        build/data/scenes/debug/template_scene.c.o(.data);
        build/data/scenes/debug/template_scene.bs.o(.scene);
        build/data/font_definitions.c.o(.data);

        build/games/sneaky_spirits/engine.c.o(.data);
        build/games/spaceball/engine.c.o(.data);
        build/games/bon_odori/engine.c.o(.data);
        build/games/karate_man/engine.c.o(.data);
        build/games/mannequin_factory/engine.c.o(.data);
        build/games/staff_credit/engine.c.o(.data);
        build/games/drum_intro/engine.c.o(.data);
        build/games/drum_live/engine.c.o(.data);
        build/games/drum_studio/engine.c.o(.data);
        build/games/night_walk/engine.c.o(.data);
        build/games/showtime/engine.c.o(.data);
        build/games/bouncy_road/engine.c.o(.data);
        build/games/rhythm_tweezers/engine.c.o(.data);
        build/games/fireworks/engine.c.o(.data);
        build/games/clappy_trio/engine.c.o(.data);
        build/games/samurai_slice/engine.c.o(.data);
        build/games/power_calligraphy/engine.c.o(.data);
        build/games/rhythm_test/engine.c.o(.data);
        build/games/marching_orders/engine.c.o(.data);
        build/games/mr_upbeat/engine.c.o(.data);
        build/games/metronome/engine.c.o(.data);
        build/games/polyrhythm/engine.c.o(.data);
        build/games/drum_live/drum_live_menu_engine.c.o(.data);
        build/games/quiz_show/engine.c.o(.data);
        build/games/bunny_hop/engine.c.o(.data);
        build/games/rap_men/engine.c.o(.data);
        build/games/rat_race/engine.c.o(.data);
        build/games/ninja_bodyguard/engine.c.o(.data);
        build/games/space_dance/engine.c.o(.data);
        build/games/tap_trial/engine.c.o(.data);
        build/games/toss_boys/engine.c.o(.data);
        build/games/tram_and_pauline/engine.c.o(.data);
        build/games/mechanical_horse/engine.c.o(.data);
        build/games/sick_beats/engine.c.o(.data);
        build/games/rhythm_toys/engine.c.o(.data);
        build/games/wizards_waltz/engine.c.o(.data);

        build/games/sneaky_spirits/sneaky_spirits_prologue_engine.c.o(.data);
        build/games/sneaky_spirits/sneaky_spirits.bs.o(.script.prologue);
        build/games/spaceball/spaceball_prologue_engine.c.o(.data);
        build/games/spaceball/spaceball.bs.o(.script.prologue);
        build/games/bon_odori/bon_dance_prologue_engine.c.o(.data);
        build/games/bon_odori/bon_dance.bs.o(.script.prologue);
        build/games/bon_odori/bon_odori_prologue_engine.c.o(.data);
        build/games/bon_odori/bon_odori.bs.o(.script.prologue);
        build/games/karate_man/karate_man_prologue_engine.c.o(.data);
        build/games/karate_man/karate_man.bs.o(.script.prologue);
        build/games/space_dance/cosmic_dance_prologue_engine.c.o(.data);
        build/games/space_dance/cosmic_dance.bs.o(.script.prologue);
        build/games/night_walk/night_walk_prologue_engine.c.o(.data);
        build/games/night_walk/night_walk.bs.o(.script.prologue);
        build/games/showtime/showtime_prologue_engine.c.o(.data);
        build/games/showtime/showtime.bs.o(.script.prologue);
        build/games/bouncy_road/bouncy_road_prologue_engine.c.o(.data);
        build/games/bouncy_road/bouncy_road.bs.o(.script.prologue);
        build/games/rhythm_tweezers/rhythm_tweezers_prologue_engine.c.o(.data);
        build/games/rhythm_tweezers/rhythm_tweezers.bs.o(.script.prologue);
        build/games/fireworks/fireworks_prologue_engine.c.o(.data);
        build/games/fireworks/fireworks.bs.o(.script.prologue);
        build/games/clappy_trio/clappy_trio_prologue_engine.c.o(.data);
        build/games/clappy_trio/clappy_trio.bs.o(.script.prologue);
        build/games/clappy_trio/snappy_trio_prologue_engine.c.o(.data);
        build/games/clappy_trio/snappy_trio.bs.o(.script.prologue);
        build/games/samurai_slice/samurai_slice_prologue_engine.c.o(.data);
        build/games/samurai_slice/samurai_slice.bs.o(.script.prologue);
        build/games/power_calligraphy/power_calligraphy_prologue_engine.c.o(.data);
        build/games/power_calligraphy/power_calligraphy.bs.o(.script.prologue);
        build/games/marching_orders/marching_orders_prologue_engine.c.o(.data);
        build/games/marching_orders/marching_orders.bs.o(.script.prologue);
        build/games/marching_orders/marching_orders_2_prologue_engine.c.o(.data);
        build/games/marching_orders/marching_orders_2.bs.o(.script.prologue);
        build/games/polyrhythm/polyrhythm_prologue_engine.c.o(.data);
        build/games/polyrhythm/polyrhythm.bs.o(.script.prologue);
        build/games/quiz_show/quiz_show_prologue_engine.c.o(.data);
        build/games/quiz_show/quiz_show.bs.o(.script.prologue);
        build/games/remix_1/remix_1_prologue_engine.c.o(.data);
        build/games/remix_1/remix_1.bs.o(.script.prologue);
        build/games/remix_2/remix_2_prologue_engine.c.o(.data);
        build/games/remix_2/remix_2.bs.o(.script.prologue);
        build/games/remix_3/remix_3_prologue_engine.c.o(.data);
        build/games/remix_3/remix_3.bs.o(.script.prologue);
        build/games/remix_4/remix_4_prologue_engine.c.o(.data);
        build/games/remix_4/remix_4.bs.o(.script.prologue);
        build/games/remix_5/remix_5_prologue_engine.c.o(.data);
        build/games/remix_5/remix_5.bs.o(.script.prologue);
        build/games/remix_6/remix_6_prologue_engine.c.o(.data);
        build/games/remix_6/remix_6.bs.o(.script.prologue);
        build/games/remix_7/remix_7_prologue_engine.c.o(.data);
        build/games/remix_7/remix_7.bs.o(.script.prologue);
        build/games/remix_8/remix_8_prologue_engine.c.o(.data);
        build/games/remix_8/remix_8.bs.o(.script.prologue);
        build/games/bunny_hop/bunny_hop_prologue_engine.c.o(.data);
        build/games/bunny_hop/bunny_hop.bs.o(.script.prologue);
        build/games/rap_men/rap_men_prologue_engine.c.o(.data);
        build/games/rap_men/rap_men.bs.o(.script.prologue);
        build/games/rap_men/rap_women_prologue_engine.c.o(.data);
        build/games/rap_men/rap_women.bs.o(.script.prologue);
        build/games/rat_race/rat_race_prologue_engine.c.o(.data);
        build/games/rat_race/rat_race.bs.o(.script.prologue);
        build/games/ninja_bodyguard/ninja_bodyguard_prologue_engine.c.o(.data);
        build/games/ninja_bodyguard/ninja_bodyguard.bs.o(.script.prologue);
        build/games/ninja_bodyguard/ninja_reincarnate_prologue_engine.c.o(.data);
        build/games/ninja_bodyguard/ninja_reincarnate.bs.o(.script.prologue);
        build/games/space_dance/space_dance_prologue_engine.c.o(.data);
        build/games/space_dance/space_dance.bs.o(.script.prologue);
        build/games/tap_trial/tap_trial_prologue_engine.c.o(.data);
        build/games/tap_trial/tap_trial.bs.o(.script.prologue);
        build/games/tap_trial/tap_trial_2_prologue_engine.c.o(.data);
        build/games/tap_trial/tap_trial_2.bs.o(.script.prologue);
        build/games/toss_boys/toss_boys_prologue_engine.c.o(.data);
        build/games/toss_boys/toss_boys.bs.o(.script.prologue);
        build/games/toss_boys/toss_boys_2_prologue_engine.c.o(.data);
        build/games/toss_boys/toss_boys_2.bs.o(.script.prologue);
        build/games/tram_and_pauline/tram_pauline_prologue_engine.c.o(.data);
        build/games/tram_and_pauline/tram_and_pauline.bs.o(.script.prologue);
        build/games/sick_beats/sick_beats_prologue_engine.c.o(.data);
        build/games/sick_beats/sick_beats.bs.o(.script.prologue);
        build/games/wizards_waltz/wizards_waltz_prologue_engine.c.o(.data);
        build/games/wizards_waltz/wizards_waltz.bs.o(.script.prologue);

        build/games/karate_man/karate_man.bs.o(.script.main);
        build/games/clappy_trio/snappy_trio_unused.bs.o(.script.main);
        build/games/clappy_trio/clappy_trio.bs.o(.script.main);
        build/games/polyrhythm/polyrhythm.bs.o(.script.main);
        build/games/polyrhythm/polyrhythm_2.bs.o(.script.main);
        build/games/night_walk/night_walk.bs.o(.script.main);
        build/games/night_walk/night_walk_2.bs.o(.script.main);
        build/games/karate_man/karate_man_2.bs.o(.script.main);
        build/games/rhythm_tweezers/rhythm_tweezers.bs.o(.script.main);
        build/games/rhythm_tweezers/rhythm_tweezers_2.bs.o(.script.main);
        build/games/sick_beats/sick_beats.bs.o(.script.main);
        build/games/bouncy_road/bouncy_road_unused.bs.o(.script.main);
        build/games/bouncy_road/bouncy_road_unused_2.bs.o(.script.main);
        build/games/bouncy_road/bouncy_road.bs.o(.script.main);
        build/games/bouncy_road/bouncy_road_2.bs.o(.script.main);
        build/games/ninja_bodyguard/ninja_bodyguard.bs.o(.script.main);
        build/games/ninja_bodyguard/ninja_reincarnate.bs.o(.script.main);
        build/games/sneaky_spirits/sneaky_spirits.bs.o(.script.main);
        build/games/sneaky_spirits/sneaky_spirits_2.bs.o(.script.main);
        build/games/samurai_slice/samurai_slice.bs.o(.script.main);
        build/games/spaceball/spaceball_unused.bs.o(.script.main);
        build/games/spaceball/spaceball_unused_2.bs.o(.script.main);
        build/games/spaceball/spaceball.bs.o(.script.main);
        build/games/spaceball/spaceball_2.bs.o(.script.main);
        build/games/tap_trial/tap_trial_unused.bs.o(.script.main);
        build/games/tap_trial/tap_trial.bs.o(.script.main);
        build/games/mechanical_horse/mechanical_horse_unused.bs.o(.script.main);
        build/games/mechanical_horse/mechanical_horse.bs.o(.script.main);
        build/games/marching_orders/marching_orders_unused.bs.o(.script.main);
        build/games/marching_orders/marching_orders.bs.o(.script.main);
        build/games/marching_orders/marching_orders_2.bs.o(.script.main);
        build/games/wizards_waltz/wizards_waltz.bs.o(.script.main);
        build/games/remix_1/remix_1_unused.bs.o(.script.main);
        build/games/remix_1/remix_1.bs.o(.script.main);
        build/games/bunny_hop/bunny_hop.bs.o(.script.main);
        build/games/metronome/metronome.bs.o(.script.main);
        build/games/fireworks/fireworks.bs.o(.script.main);
        build/games/rat_race/rat_race.bs.o(.script.main);
        build/games/power_calligraphy/power_calligraphy.bs.o(.script.main);
        build/games/drum_live/drum_girls_live_unused.bs.o(.script.main);
        build/games/drum_intro/drum_intro_unused.bs.o(.script.main);
        build/games/toss_boys/toss_boys_2.bs.o(.script.main);
        build/games/toss_boys/toss_boys.bs.o(.script.main);
        build/games/drum_intro/drum_intro_unused_2.bs.o(.script.main);
        build/games/tram_and_pauline/tram_and_pauline.bs.o(.script.main);
        build/games/drum_intro/tanuki_and_monkey.bs.o(.script.main);
        build/games/drum_intro/drum_samurai_demo_cutscene.bs.o(.script.main);
        build/games/drum_intro/drum_samurai_opening_cutscene.bs.o(.script.main);
        build/games/showtime/showtime.bs.o(.script.main);
        build/games/space_dance/space_dance.bs.o(.script.main);
        build/games/drum_intro/drum_intro_unused_3.bs.o(.script.main);
        build/games/rap_men/rap_men.bs.o(.script.main);
        build/games/quiz_show/quiz_show.bs.o(.script.main);
        build/games/rhythm_test/rhythm_test.bs.o(.script.main);
        build/games/drum_studio/drum_studio.bs.o(.script.main);
        build/games/drum_studio/drum_lesson_short_1.bs.o(.script.main);
        build/games/drum_studio/drum_lesson_short_4.bs.o(.script.main);
        build/games/drum_studio/drum_lesson_short_8.bs.o(.script.main);
        build/games/drum_studio/drum_lesson_short_5.bs.o(.script.main);
        build/games/drum_studio/drum_lesson_short_7.bs.o(.script.main);
        build/games/drum_studio/drum_lesson_short_9.bs.o(.script.main);
        build/games/drum_studio/drum_lesson_short_6.bs.o(.script.main);
        build/games/drum_studio/drum_lesson_basic_1.bs.o(.script.main);
        build/games/drum_studio/drum_lesson_basic_2.bs.o(.script.main);
        build/games/drum_studio/drum_lesson_short_2.bs.o(.script.main);
        build/games/drum_studio/drum_lesson_short_3.bs.o(.script.main);
        build/games/drum_studio/drum_lesson_long_4.bs.o(.script.main);
        build/games/drum_studio/drum_lesson_long_2.bs.o(.script.main);
        build/games/drum_studio/drum_lesson_long_3.bs.o(.script.main);
        build/games/drum_studio/drum_lesson_long_1.bs.o(.script.main);
        build/games/drum_studio/drum_lesson_long_5.bs.o(.script.main);
        build/games/drum_studio/drum_lesson_long_6.bs.o(.script.main);
        build/games/drum_studio/drum_lesson_hi_tech_1.bs.o(.script.main);
        build/games/drum_studio/drum_lesson_hi_tech_2.bs.o(.script.main);
        build/games/rhythm_toys/rhythm_toys.bs.o(.script.main);
        build/games/bon_odori/bon_odori.bs.o(.script.main);
        build/games/tap_trial/tap_trial_2.bs.o(.script.main);
        build/games/clappy_trio/snappy_trio.bs.o(.script.main);
        build/games/rap_men/rap_women.bs.o(.script.main);
        build/games/rap_men/rap_women_unused.bs.o(.script.main);
        build/games/remix_2/remix_2.bs.o(.script.main);
        build/games/remix_4/remix_4.bs.o(.script.main);
        build/games/mr_upbeat/mr_upbeat.bs.o(.script.main);
        build/games/space_dance/cosmic_dance.bs.o(.script.main);
        build/games/mannequin_factory/mannequin_factory.bs.o(.script.main);
        build/games/quiz_show/quiz_show_endless.bs.o(.script.main);
        build/games/sick_beats/sick_beats_endless.bs.o(.script.main);
        build/games/staff_credit/staff_credit_gfx_tables.c.o(.data);
        build/games/staff_credit/staff_credit.bs.o(.script.main);
        build/games/drum_live/drum_live.bs.o(.script.menu);
        build/games/remix_3/remix_3.bs.o(.script.main);
        build/games/remix_7/remix_7.bs.o(.script.main);
        build/games/remix_5/remix_5.bs.o(.script.main);
        build/games/bon_odori/bon_dance.bs.o(.script.main);
        build/games/remix_6/remix_6.bs.o(.script.main);
        build/games/remix_8/remix_8.bs.o(.script.main);
        build/games/drum_live/drum_girls_space_dance.bs.o(.script.main);
        build/games/drum_live/drum_girls_honey_sweet_angel.bs.o(.script.main);
        build/games/drum_live/drum_girls_night_walk.bs.o(.script.main);
        build/games/drum_live/drum_boys_clappy_trio.bs.o(.script.main);
        build/games/drum_live/drum_boys_tap_trial.bs.o(.script.main);
        build/games/drum_live/drum_boys_wish.bs.o(.script.main);
        build/games/drum_live/drum_band_cosmic_dance.bs.o(.script.main);
        build/games/drum_live/drum_band_snappy_trio.bs.o(.script.main);
        build/games/drum_live/drum_band_tap_trial_2.bs.o(.script.main);
        build/games/sneaky_spirits/subroutines.bs.o(.script.sub);
        build/games/drum_live/subroutines.bs.o(.script.sub);
        build/games/drum_studio/subroutines.bs.o(.script.sub);
        build/games/power_calligraphy/subroutines.bs.o(.script.sub);
        build/games/marching_orders/subroutines.bs.o(.script.sub);
        build/games/space_dance/subroutines.bs.o(.script.sub);
        build/games/tap_trial/subroutines.bs.o(.script.sub);

        build/data/lib_midi_data.c.o(.data);
        build/src/midi/directsound.c.o(.data);
        build/src/midi/channel.c.o(.data);
        build/src/midi/lfo.c.o(.data);
        build/src/midi/random.c.o(.data);
        build/src/midi/psg.c.o(.data);
        build/audio/instruments.c.o(.data);
        build/audio/songs.c.o(.data);
        build/src/midi/player.c.o(.data);
        build/audio/sample_table.json.s.o(.data);

        build/audio/sequences/Lesson1.mid.o(.rodata*);
        build/audio/sequences/Lesson2.mid.o(.rodata*);
        build/audio/sequences/Lesson3.mid.o(.rodata*);
        build/audio/sequences/L1_pat01.mid.o(.rodata*);
        build/audio/sequences/L1_pat02.mid.o(.rodata*);
        build/audio/sequences/L1_pat03.mid.o(.rodata*);
        build/audio/sequences/L1_pat04.mid.o(.rodata*);
        build/audio/sequences/L1_pat05.mid.o(.rodata*);
        build/audio/sequences/L1_pat06.mid.o(.rodata*);
        build/audio/sequences/L1_pat07.mid.o(.rodata*);
        build/audio/sequences/L1_pat08.mid.o(.rodata*);
        build/audio/sequences/L1_pat09.mid.o(.rodata*);
        build/audio/sequences/L1_pat10.mid.o(.rodata*);
        build/audio/sequences/L1_pat11.mid.o(.rodata*);
        build/audio/sequences/L1_pat12.mid.o(.rodata*);
        build/audio/sequences/L1_pat13.mid.o(.rodata*);
        build/audio/sequences/L1_pat14.mid.o(.rodata*);
        build/audio/sequences/L1_pat15.mid.o(.rodata*);
        build/audio/sequences/L1_pat16.mid.o(.rodata*);
        build/audio/sequences/L2_pat00.mid.o(.rodata*);
        build/audio/sequences/L2_pat01.mid.o(.rodata*);
        build/audio/sequences/L2_pat02.mid.o(.rodata*);
        build/audio/sequences/L2_pat03.mid.o(.rodata*);
        build/audio/sequences/L2_pat04.mid.o(.rodata*);
        build/audio/sequences/L2_pat05.mid.o(.rodata*);
        build/audio/sequences/L2_pat06.mid.o(.rodata*);
        build/audio/sequences/L2_pat07.mid.o(.rodata*);
        build/audio/sequences/L2_pat08.mid.o(.rodata*);
        build/audio/sequences/L2_pat09.mid.o(.rodata*);
        build/audio/sequences/L2_pat10.mid.o(.rodata*);
        build/audio/sequences/L2_pat11.mid.o(.rodata*);
        build/audio/sequences/L2_pat12.mid.o(.rodata*);
        build/audio/sequences/L2_pat13.mid.o(.rodata*);
        build/audio/sequences/L2_pat14.mid.o(.rodata*);
        build/audio/sequences/L2_pat15.mid.o(.rodata*);
        build/audio/sequences/L2_pat16.mid.o(.rodata*);
        build/audio/sequences/L3_intro.mid.o(.rodata*);
        build/audio/sequences/L3_C32.mid.o(.rodata*);
        build/audio/sequences/L3_C32_no_swing.mid.o(.rodata*);
        build/audio/sequences/L3_C33.mid.o(.rodata*);
        build/audio/sequences/L3_C34.mid.o(.rodata*);
        build/audio/sequences/L3_C35.mid.o(.rodata*);
        build/audio/sequences/L3_C36.mid.o(.rodata*);
        build/audio/sequences/L3_C37.mid.o(.rodata*);
        build/audio/sequences/L3_C38.mid.o(.rodata*);
        build/audio/sequences/L3_C39.mid.o(.rodata*);
        build/audio/sequences/L3_C40.mid.o(.rodata*);
        build/audio/sequences/L3_C41_end.mid.o(.rodata*);
        build/audio/sequences/s_aimu_bgm.mid.o(.rodata*);
        build/audio/sequences/s_menu_bgm.mid.o(.rodata*);
        build/audio/sequences/s_shibafu1_bgm.mid.o(.rodata*);
        build/audio/sequences/s_shibafu2_bgm.mid.o(.rodata*);
        build/audio/sequences/s_tebyoushi_bgm.mid.o(.rodata*);
        build/audio/sequences/s_tebyoushi_dexy_bgm.mid.o(.rodata*);
        build/audio/sequences/s_tapdance_bgm.mid.o(.rodata*);
        build/audio/sequences/s_tapdance_ska_bgm.mid.o(.rodata*);
        build/audio/sequences/s_trex_bgm.mid.o(.rodata*);
        build/audio/sequences/s_trexnew_bgm1.mid.o(.rodata*);
        build/audio/sequences/s_trexnew_bgm2.mid.o(.rodata*);
        build/audio/sequences/s_poly_bgm.mid.o(.rodata*);
        build/audio/sequences/s_shuji_bgm1.mid.o(.rodata*);
        build/audio/sequences/s_shuji_bgm2.mid.o(.rodata*);
        build/audio/sequences/s_shuji_bgm3.mid.o(.rodata*);
        build/audio/sequences/s_shuji_bgm_end.mid.o(.rodata*);
        build/audio/sequences/s_puipui_bgm.mid.o(.rodata*);
        build/audio/sequences/s_puipui_intro_bgm.mid.o(.rodata*);
        build/audio/sequences/s_naniwa_bgm.mid.o(.rodata*);
        build/audio/sequences/s_emanikanto_bgm.mid.o(.rodata*);
        build/audio/sequences/s_emanikanto_bgm_loop.mid.o(.rodata*);
        build/audio/sequences/s_manza_bgm.mid.o(.rodata*);
        build/audio/sequences/s_hitmegeton1_bgm.mid.o(.rodata*);
        build/audio/sequences/s_hitmegeton2_bgm.mid.o(.rodata*);
        build/audio/sequences/s_bon_odori_bgm.mid.o(.rodata*);
        build/audio/sequences/s_bon_dance_bgm.mid.o(.rodata*);
        build/audio/sequences/s_4beat_bgm.mid.o(.rodata*);
        build/audio/sequences/s_toss_bgm.mid.o(.rodata*);
        build/audio/sequences/s_toss_bgm_end.mid.o(.rodata*);
        build/audio/sequences/s_toss_bgm_loop.mid.o(.rodata*);
        build/audio/sequences/s_title_bgm.mid.o(.rodata*);
        build/audio/sequences/s_koihoney_bgm.mid.o(.rodata*);
        build/audio/sequences/s_wish_bgm.mid.o(.rodata*);
        build/audio/sequences/L8_pat_intro.mid.o(.rodata*);
        build/audio/sequences/L8_pat01.mid.o(.rodata*);
        build/audio/sequences/L8_pat02.mid.o(.rodata*);
        build/audio/sequences/L8_pat03.mid.o(.rodata*);
        build/audio/sequences/L8_pat04.mid.o(.rodata*);
        build/audio/sequences/L8_pat05.mid.o(.rodata*);
        build/audio/sequences/L8_pat06.mid.o(.rodata*);
        build/audio/sequences/L8_pat07.mid.o(.rodata*);
        build/audio/sequences/L8_pat08.mid.o(.rodata*);
        build/audio/sequences/L8_pat09.mid.o(.rodata*);
        build/audio/sequences/L8_pat10.mid.o(.rodata*);
        build/audio/sequences/L8_pat11.mid.o(.rodata*);
        build/audio/sequences/L8_pat12.mid.o(.rodata*);
        build/audio/sequences/L8_pat_end.mid.o(.rodata*);
        build/audio/sequences/L8_pat_honki.mid.o(.rodata*);
        build/audio/sequences/s_menu_kettei0.mid.o(.rodata*);
        build/audio/sequences/s_menu_kettei1.mid.o(.rodata*);
        build/audio/sequences/s_menu_kettei2.mid.o(.rodata*);
        build/audio/sequences/s_menu_kettei3.mid.o(.rodata*);
        build/audio/sequences/s_menu_cancel1.mid.o(.rodata*);
        build/audio/sequences/s_menu_cancel2.mid.o(.rodata*);
        build/audio/sequences/s_menu_cancel3.mid.o(.rodata*);
        build/audio/sequences/s_menu_cursor1.mid.o(.rodata*);
        build/audio/sequences/s_menu_cursor2.mid.o(.rodata*);
        build/audio/sequences/s_menu_error.mid.o(.rodata*);
        build/audio/sequences/s_kansei.mid.o(.rodata*);
        build/audio/sequences/s_kansei_solo.mid.o(.rodata*);
        build/audio/sequences/s_warai.mid.o(.rodata*);
        build/audio/sequences/s_warai_little.mid.o(.rodata*);
        build/audio/sequences/s_warai_solo.mid.o(.rodata*);
        build/audio/sequences/s_hakushu_solo.mid.o(.rodata*);
        build/audio/sequences/s_BD1.mid.o(.rodata*);
        build/audio/sequences/s_BD2.mid.o(.rodata*);
        build/audio/sequences/s_BD3.mid.o(.rodata*);
        build/audio/sequences/s_BD4.mid.o(.rodata*);
        build/audio/sequences/s_BD5.mid.o(.rodata*);
        build/audio/sequences/s_BD6.mid.o(.rodata*);
        build/audio/sequences/s_BD7.mid.o(.rodata*);
        build/audio/sequences/s_BD8.mid.o(.rodata*);
        build/audio/sequences/s_BD9.mid.o(.rodata*);
        build/audio/sequences/s_SD1.mid.o(.rodata*);
        build/audio/sequences/s_SD2.mid.o(.rodata*);
        build/audio/sequences/s_SD3.mid.o(.rodata*);
        build/audio/sequences/s_SD4.mid.o(.rodata*);
        build/audio/sequences/s_SD5.mid.o(.rodata*);
        build/audio/sequences/s_SD6.mid.o(.rodata*);
        build/audio/sequences/s_SD7.mid.o(.rodata*);
        build/audio/sequences/s_SD8.mid.o(.rodata*);
        build/audio/sequences/s_SD9.mid.o(.rodata*);
        build/audio/sequences/s_tom_H.mid.o(.rodata*);
        build/audio/sequences/s_tom_M.mid.o(.rodata*);
        build/audio/sequences/s_tom_L.mid.o(.rodata*);
        build/audio/sequences/s_close_HH.mid.o(.rodata*);
        build/audio/sequences/s_open_HH.mid.o(.rodata*);
        build/audio/sequences/s_CC1.mid.o(.rodata*);
        build/audio/sequences/s_CC2.mid.o(.rodata*);
        build/audio/sequences/s_CC3.mid.o(.rodata*);
        build/audio/sequences/s_CC4.mid.o(.rodata*);
        build/audio/sequences/s_RC.mid.o(.rodata*);
        build/audio/sequences/s_HC.mid.o(.rodata*);
        build/audio/sequences/s_CC5.mid.o(.rodata*);
        build/audio/sequences/s_CC6.mid.o(.rodata*);
        build/audio/sequences/s_KN.mid.o(.rodata*);
        build/audio/sequences/s_HG.mid.o(.rodata*);
        build/audio/sequences/s_tran_jump.mid.o(.rodata*);
        build/audio/sequences/s_tran_henge.mid.o(.rodata*);
        build/audio/sequences/s_tran_seino.mid.o(.rodata*);
        build/audio/sequences/s_tran_hensin.mid.o(.rodata*);
        build/audio/sequences/s_tran_jump_se.mid.o(.rodata*);
        build/audio/sequences/s_toss_red_blue1.mid.o(.rodata*);
        build/audio/sequences/s_toss_red_blue2.mid.o(.rodata*);
        build/audio/sequences/s_toss_red_blue3.mid.o(.rodata*);
        build/audio/sequences/s_toss_red_yelw1.mid.o(.rodata*);
        build/audio/sequences/s_toss_red_yelw2.mid.o(.rodata*);
        build/audio/sequences/s_toss_red_yelw3.mid.o(.rodata*);
        build/audio/sequences/s_toss_red_red.mid.o(.rodata*);
        build/audio/sequences/s_toss_red_before.mid.o(.rodata*);
        build/audio/sequences/s_toss_red_break.mid.o(.rodata*);
        build/audio/sequences/s_toss_blue_red1.mid.o(.rodata*);
        build/audio/sequences/s_toss_blue_red2.mid.o(.rodata*);
        build/audio/sequences/s_toss_blue_red3.mid.o(.rodata*);
        build/audio/sequences/s_toss_blue_yelw1.mid.o(.rodata*);
        build/audio/sequences/s_toss_blue_yelw2.mid.o(.rodata*);
        build/audio/sequences/s_toss_blue_yelw3.mid.o(.rodata*);
        build/audio/sequences/s_toss_blue_blue.mid.o(.rodata*);
        build/audio/sequences/s_toss_blue_before.mid.o(.rodata*);
        build/audio/sequences/s_toss_blue_break.mid.o(.rodata*);
        build/audio/sequences/s_toss_yelw_red1.mid.o(.rodata*);
        build/audio/sequences/s_toss_yelw_red2.mid.o(.rodata*);
        build/audio/sequences/s_toss_yelw_red3.mid.o(.rodata*);
        build/audio/sequences/s_toss_yelw_blue1.mid.o(.rodata*);
        build/audio/sequences/s_toss_yelw_blue2.mid.o(.rodata*);
        build/audio/sequences/s_toss_yelw_blue3.mid.o(.rodata*);
        build/audio/sequences/s_toss_yelw_yelw.mid.o(.rodata*);
        build/audio/sequences/s_toss_yelw_before.mid.o(.rodata*);
        build/audio/sequences/s_toss_yelw_break.mid.o(.rodata*);
        build/audio/sequences/s_toss_ball_red.mid.o(.rodata*);
        build/audio/sequences/s_toss_ball_blue.mid.o(.rodata*);
        build/audio/sequences/s_toss_ball_yelw.mid.o(.rodata*);
        build/audio/sequences/s_toss_ball_haretu.mid.o(.rodata*);
        build/audio/sequences/s_shuji_ho.mid.o(.rodata*);
        build/audio/sequences/s_shuji_tame.mid.o(.rodata*);
        build/audio/sequences/s_iai_yarare.mid.o(.rodata*);
        build/audio/sequences/s_iai_miss.mid.o(.rodata*);
        build/audio/sequences/s_mario1.mid.o(.rodata*);
        build/audio/sequences/s_mario2.mid.o(.rodata*);
        build/audio/sequences/s_mario1_2.mid.o(.rodata*);
        build/audio/sequences/s_mario2_4.mid.o(.rodata*);
        build/audio/sequences/s_mario_melo1.mid.o(.rodata*);
        build/audio/sequences/s_mario_melo2.mid.o(.rodata*);
        build/audio/sequences/s_sword_orya.mid.o(.rodata*);
        build/audio/sequences/s_furi.mid.o(.rodata*);
        build/audio/sequences/s_sword_hi.mid.o(.rodata*);
        build/audio/sequences/s_sword_ho.mid.o(.rodata*);
        build/audio/sequences/s_iai_result.mid.o(.rodata*);
        build/audio/sequences/s_iai_bgm1.mid.o(.rodata*);
        build/audio/sequences/s_iai_bgm2.mid.o(.rodata*);
        build/audio/sequences/s_iai_bgm3.mid.o(.rodata*);
        build/audio/sequences/s_iai_frase1a.mid.o(.rodata*);
        build/audio/sequences/s_iai_frase2a.mid.o(.rodata*);
        build/audio/sequences/s_iai_frase3a.mid.o(.rodata*);
        build/audio/sequences/s_iai_frase1b.mid.o(.rodata*);
        build/audio/sequences/s_iai_frase2b.mid.o(.rodata*);
        build/audio/sequences/s_iai_frase3b.mid.o(.rodata*);
        build/audio/sequences/s_ninja_wind.mid.o(.rodata*);
        build/audio/sequences/s_ninja_chakuti.mid.o(.rodata*);
        build/audio/sequences/s_ninja_kamae.mid.o(.rodata*);
        build/audio/sequences/s_ninja_furu.mid.o(.rodata*);
        build/audio/sequences/s_ninja_kin.mid.o(.rodata*);
        build/audio/sequences/s_ninja_hit.mid.o(.rodata*);
        build/audio/sequences/s_ninja_yumi.mid.o(.rodata*);
        build/audio/sequences/s_ninja_kabe.mid.o(.rodata*);
        build/audio/sequences/s_ninja_bgm1.mid.o(.rodata*);
        build/audio/sequences/s_ninja_bgm2.mid.o(.rodata*);
        build/audio/sequences/s_rat_bgm1.mid.o(.rodata*);
        build/audio/sequences/s_rat_bgm2.mid.o(.rodata*);
        build/audio/sequences/s_rat_cat.mid.o(.rodata*);
        build/audio/sequences/s_rat_crush_R.mid.o(.rodata*);
        build/audio/sequences/s_rat_crush_L.mid.o(.rodata*);
        build/audio/sequences/s_rat_signal.mid.o(.rodata*);
        build/audio/sequences/s_rat_dash.mid.o(.rodata*);
        build/audio/sequences/s_rat_stop.mid.o(.rodata*);
        build/audio/sequences/s_tebyoushi_pati.mid.o(.rodata*);
        build/audio/sequences/s_bon_dondon1.mid.o(.rodata*);
        build/audio/sequences/s_bon_dondon1_1.mid.o(.rodata*);
        build/audio/sequences/s_bon_dondon1_2.mid.o(.rodata*);
        build/audio/sequences/s_bon_dondon2.mid.o(.rodata*);
        build/audio/sequences/s_hanabi_hyu.mid.o(.rodata*);
        build/audio/sequences/s_hanabi_don.mid.o(.rodata*);
        build/audio/sequences/s_hanabi_pon.mid.o(.rodata*);
        build/audio/sequences/s_hanabi_utiage.mid.o(.rodata*);
        build/audio/sequences/s_hanabi_utiage_v.mid.o(.rodata*);
        build/audio/sequences/s_hanabi_bgm.mid.o(.rodata*);
        build/audio/sequences/s_hanabi_1.mid.o(.rodata*);
        build/audio/sequences/s_hanabi_2.mid.o(.rodata*);
        build/audio/sequences/s_hanabi_3.mid.o(.rodata*);
        build/audio/sequences/s_hanabi_hai.mid.o(.rodata*);
        build/audio/sequences/s_hanabi_ah.mid.o(.rodata*);
        build/audio/sequences/s_hanabi_wish1.mid.o(.rodata*);
        build/audio/sequences/s_hanabi_wish2.mid.o(.rodata*);
        build/audio/sequences/s_hanabi_wish3.mid.o(.rodata*);
        build/audio/sequences/s_hanabi_wish4.mid.o(.rodata*);
        build/audio/sequences/s_intro_stick.mid.o(.rodata*);
        build/audio/sequences/s_intro_a.mid.o(.rodata*);
        build/audio/sequences/s_intro_one.mid.o(.rodata*);
        build/audio/sequences/s_intro_two.mid.o(.rodata*);
        build/audio/sequences/s_intro_three.mid.o(.rodata*);
        build/audio/sequences/s_intro_four.mid.o(.rodata*);
        build/audio/sequences/s_intro_uh.mid.o(.rodata*);
        build/audio/sequences/s_intro_comeon.mid.o(.rodata*);
        build/audio/sequences/s_intro_pat1.mid.o(.rodata*);
        build/audio/sequences/s_intro_pat2.mid.o(.rodata*);
        build/audio/sequences/s_intro_pat3.mid.o(.rodata*);
        build/audio/sequences/s_ghost_walk.mid.o(.rodata*);
        build/audio/sequences/s_ghost_just_hit.mid.o(.rodata*);
        build/audio/sequences/s_ghost_miss_hit.mid.o(.rodata*);
        build/audio/sequences/s_ghost_dash.mid.o(.rodata*);
        build/audio/sequences/s_ghost_warai.mid.o(.rodata*);
        build/audio/sequences/s_ghost_gosha.mid.o(.rodata*);
        build/audio/sequences/s_ghost_rain.mid.o(.rodata*);
        build/audio/sequences/s_space_ikeo_turn.mid.o(.rodata*);
        build/audio/sequences/s_space_ikeo_right.mid.o(.rodata*);
        build/audio/sequences/s_space_ikeo_lets.mid.o(.rodata*);
        build/audio/sequences/s_space_ikeo_sit.mid.o(.rodata*);
        build/audio/sequences/s_space_ikeo_down.mid.o(.rodata*);
        build/audio/sequences/s_space_ikeo_pa.mid.o(.rodata*);
        build/audio/sequences/s_space_ikeo_punch.mid.o(.rodata*);
        build/audio/sequences/s_space_kou_turn.mid.o(.rodata*);
        build/audio/sequences/s_space_kou_right.mid.o(.rodata*);
        build/audio/sequences/s_space_kou_lets.mid.o(.rodata*);
        build/audio/sequences/s_space_kou_sit.mid.o(.rodata*);
        build/audio/sequences/s_space_kou_down.mid.o(.rodata*);
        build/audio/sequences/s_space_kou_pa.mid.o(.rodata*);
        build/audio/sequences/s_space_kou_punch.mid.o(.rodata*);
        build/audio/sequences/s_space_miss.mid.o(.rodata*);
        build/audio/sequences/s_space_ikeo_turn_swing.mid.o(.rodata*);
        build/audio/sequences/s_space_kou_turn_swing.mid.o(.rodata*);
        build/audio/sequences/s_guntai1.mid.o(.rodata*);
        build/audio/sequences/s_guntai2.mid.o(.rodata*);
        build/audio/sequences/s_guntai_foot1.mid.o(.rodata*);
        build/audio/sequences/s_guntai_foot2.mid.o(.rodata*);
        build/audio/sequences/s_guntai_v_zentai1.mid.o(.rodata*);
        build/audio/sequences/s_guntai_v_zentai2.mid.o(.rodata*);
        build/audio/sequences/s_guntai_v_susume.mid.o(.rodata*);
        build/audio/sequences/s_guntai_v_tomare.mid.o(.rodata*);
        build/audio/sequences/s_guntai_v_migi_muke1.mid.o(.rodata*);
        build/audio/sequences/s_guntai_v_migi_muke2.mid.o(.rodata*);
        build/audio/sequences/s_guntai_v_hidari_muke1.mid.o(.rodata*);
        build/audio/sequences/s_guntai_v_hidari_muke2.mid.o(.rodata*);
        build/audio/sequences/s_guntai_v_migi.mid.o(.rodata*);
        build/audio/sequences/s_guntai_v_hidari.mid.o(.rodata*);
        build/audio/sequences/s_guntai_v_yoh.mid.o(.rodata*);
        build/audio/sequences/s_guntai_v_es.mid.o(.rodata*);
        build/audio/sequences/s_guntai_v_ka.mid.o(.rodata*);
        build/audio/sequences/s_guntai_ikari.mid.o(.rodata*);
        build/audio/sequences/s_block_gotin.mid.o(.rodata*);
        build/audio/sequences/s_block_hit.mid.o(.rodata*);
        build/audio/sequences/s_block_walk.mid.o(.rodata*);
        build/audio/sequences/s_kawasemi_bgm.mid.o(.rodata*);
        build/audio/sequences/s_kawasemi_frase.mid.o(.rodata*);
        build/audio/sequences/s_heat_v_jituhane.mid.o(.rodata*);
        build/audio/sequences/s_heat_v_watasine.mid.o(.rodata*);
        build/audio/sequences/s_heat_v_watasitara.mid.o(.rodata*);
        build/audio/sequences/s_heat_v_anataga.mid.o(.rodata*);
        build/audio/sequences/s_heat_v_anatatara.mid.o(.rodata*);
        build/audio/sequences/s_heat_v_kimiga.mid.o(.rodata*);
        build/audio/sequences/s_heat_v_doji.mid.o(.rodata*);
        build/audio/sequences/s_heat_v_sugoi.mid.o(.rodata*);
        build/audio/sequences/s_heat_v_koumietemo.mid.o(.rodata*);
        build/audio/sequences/s_heat_v_okubyo.mid.o(.rodata*);
        build/audio/sequences/s_heat_v_majime.mid.o(.rodata*);
        build/audio/sequences/s_heat_v_kouitta.mid.o(.rodata*);
        build/audio/sequences/s_heat_v_demo.mid.o(.rodata*);
        build/audio/sequences/s_heat_v_yappari.mid.o(.rodata*);
        build/audio/sequences/s_heat_v_dakedo.mid.o(.rodata*);
        build/audio/sequences/s_heat_v_suki.mid.o(.rodata*);
        build/audio/sequences/s_heat_v_kirai.mid.o(.rodata*);
        build/audio/sequences/s_heat_v_seki.mid.o(.rodata*);
        build/audio/sequences/s_heat_machine_bgm.mid.o(.rodata*);
        build/audio/sequences/s_metro_tin.mid.o(.rodata*);
        build/audio/sequences/s_metro_count1.mid.o(.rodata*);
        build/audio/sequences/s_metro_count2.mid.o(.rodata*);
        build/audio/sequences/s_metro_hato.mid.o(.rodata*);
        build/audio/sequences/s_metro_hit.mid.o(.rodata*);
        build/audio/sequences/s_batter_hit.mid.o(.rodata*);
        build/audio/sequences/s_batter_mit.mid.o(.rodata*);
        build/audio/sequences/s_keytoy_count1.mid.o(.rodata*);
        build/audio/sequences/s_keytoy_count2.mid.o(.rodata*);
        build/audio/sequences/s_mitubati.mid.o(.rodata*);
        build/audio/sequences/s_witch_candy.mid.o(.rodata*);
        build/audio/sequences/s_witch_furu.mid.o(.rodata*);
        build/audio/sequences/s_witch_cake.mid.o(.rodata*);
        build/audio/sequences/s_witch_donats.mid.o(.rodata*);
        build/audio/sequences/s_rabbit_jet.mid.o(.rodata*);
        build/audio/sequences/s_rabbit_break2.mid.o(.rodata*);
        build/audio/sequences/s_rabbit_c7_brass.mid.o(.rodata*);
        build/audio/sequences/s_rabbit_break.mid.o(.rodata*);
        build/audio/sequences/s_rabbit_HC.mid.o(.rodata*);
        build/audio/sequences/s_rabbit_bgm.mid.o(.rodata*);
        build/audio/sequences/s_rabbit_c7.mid.o(.rodata*);
        build/audio/sequences/s_rabbit_f7.mid.o(.rodata*);
        build/audio/sequences/s_rabbit_g7f7_1.mid.o(.rodata*);
        build/audio/sequences/s_rabbit_g7f7_2.mid.o(.rodata*);
        build/audio/sequences/s_rabbit_c7g7.mid.o(.rodata*);
        build/audio/sequences/s_rabbit_fill_1.mid.o(.rodata*);
        build/audio/sequences/s_rabbit_fill_2.mid.o(.rodata*);
        build/audio/sequences/s_rabbit_fill_3.mid.o(.rodata*);
        build/audio/sequences/s_rabbit_fill_4.mid.o(.rodata*);
        build/audio/sequences/s_rabbit_atama.mid.o(.rodata*);
        build/audio/sequences/s_rabbit_moon.mid.o(.rodata*);
        build/audio/sequences/s_tap_monky1.mid.o(.rodata*);
        build/audio/sequences/s_tap_monky2.mid.o(.rodata*);
        build/audio/sequences/s_tap_monky3_1.mid.o(.rodata*);
        build/audio/sequences/s_tap_monky3_2.mid.o(.rodata*);
        build/audio/sequences/s_tap_monky4.mid.o(.rodata*);
        build/audio/sequences/s_tap_kick_monky.mid.o(.rodata*);
        build/audio/sequences/s_tap_kick_lady.mid.o(.rodata*);
        build/audio/sequences/s_uma_walk1.mid.o(.rodata*);
        build/audio/sequences/s_uma_walk2.mid.o(.rodata*);
        build/audio/sequences/s_uma_walk3.mid.o(.rodata*);
        build/audio/sequences/s_uma_walk4.mid.o(.rodata*);
        build/audio/sequences/s_uma_trot1.mid.o(.rodata*);
        build/audio/sequences/s_uma_trot2.mid.o(.rodata*);
        build/audio/sequences/s_uma_canter1.mid.o(.rodata*);
        build/audio/sequences/s_uma_canter2.mid.o(.rodata*);
        build/audio/sequences/s_uma_canter3.mid.o(.rodata*);
        build/audio/sequences/s_uma_galop1.mid.o(.rodata*);
        build/audio/sequences/s_uma_galop2.mid.o(.rodata*);
        build/audio/sequences/s_uma_galop3.mid.o(.rodata*);
        build/audio/sequences/s_uma_galop4.mid.o(.rodata*);
        build/audio/sequences/s_uma_hihin.mid.o(.rodata*);
        build/audio/sequences/s_uma_bulu.mid.o(.rodata*);
        build/audio/sequences/s_uma_hi_muti.mid.o(.rodata*);
        build/audio/sequences/s_uma_ng.mid.o(.rodata*);
        build/audio/sequences/s_uma_walk1_t.mid.o(.rodata*);
        build/audio/sequences/s_uma_walk2_t.mid.o(.rodata*);
        build/audio/sequences/s_uma_walk3_t.mid.o(.rodata*);
        build/audio/sequences/s_uma_walk4_t.mid.o(.rodata*);
        build/audio/sequences/s_uma_trot1_t.mid.o(.rodata*);
        build/audio/sequences/s_uma_trot2_t.mid.o(.rodata*);
        build/audio/sequences/s_uma_canter1_t.mid.o(.rodata*);
        build/audio/sequences/s_uma_canter2_t.mid.o(.rodata*);
        build/audio/sequences/s_uma_canter3_t.mid.o(.rodata*);
        build/audio/sequences/s_uma_galop1_t.mid.o(.rodata*);
        build/audio/sequences/s_uma_galop2_t.mid.o(.rodata*);
        build/audio/sequences/s_uma_galop3_t.mid.o(.rodata*);
        build/audio/sequences/s_uma_galop4_t.mid.o(.rodata*);
        build/audio/sequences/s_uma_bgm1.mid.o(.rodata*);
        build/audio/sequences/s_uma_bgm2.mid.o(.rodata*);
        build/audio/sequences/s_uma_bgm3.mid.o(.rodata*);
        build/audio/sequences/s_uma_bgm4.mid.o(.rodata*);
        build/audio/sequences/s_karate_bgm.mid.o(.rodata*);
        build/audio/sequences/s_karate_fan.mid.o(.rodata*);
        build/audio/sequences/s_datumo_nuki.mid.o(.rodata*);
        build/audio/sequences/s_datumo_kegire.mid.o(.rodata*);
        build/audio/sequences/s_datumo_bgm.mid.o(.rodata*);
        build/audio/sequences/s_rap_bgm_renshu.mid.o(.rodata*);
        build/audio/sequences/s_rap_bgm.mid.o(.rodata*);
        build/audio/sequences/s_rap_jazz_bgm.mid.o(.rodata*);
        build/audio/sequences/s_rap_15ji_desuka.mid.o(.rodata*);
        build/audio/sequences/s_rap_oyatu_desuka.mid.o(.rodata*);
        build/audio/sequences/s_rap_honto_desuka.mid.o(.rodata*);
        build/audio/sequences/s_rap_wakari_desuka.mid.o(.rodata*);
        build/audio/sequences/s_rap_oisi_kamone.mid.o(.rodata*);
        build/audio/sequences/s_rap_herusi_kamone.mid.o(.rodata*);
        build/audio/sequences/s_rap_orenosei_kamone.mid.o(.rodata*);
        build/audio/sequences/s_rap_soremoso_kamone.mid.o(.rodata*);
        build/audio/sequences/s_rap_tanosi_kamone.mid.o(.rodata*);
        build/audio/sequences/s_rap_oyatuha_saiko.mid.o(.rodata*);
        build/audio/sequences/s_rap_kibunha_saiko.mid.o(.rodata*);
        build/audio/sequences/s_rap_orette_saiko.mid.o(.rodata*);
        build/audio/sequences/s_rap_kimitte_saiko.mid.o(.rodata*);
        build/audio/sequences/s_rap_oyatuga_naiyo.mid.o(.rodata*);
        build/audio/sequences/s_rap_oresira_naiyo.mid.o(.rodata*);
        build/audio/sequences/s_rap_un.mid.o(.rodata*);
        build/audio/sequences/s_rap_uun.mid.o(.rodata*);
        build/audio/sequences/s_rap_yeah.mid.o(.rodata*);
        build/audio/sequences/s_sindan_manzai.mid.o(.rodata*);
        build/audio/sequences/s_sindan_mail.mid.o(.rodata*);
        build/audio/sequences/s_esa_pengin1_1.mid.o(.rodata*);
        build/audio/sequences/s_esa_pengin1_2.mid.o(.rodata*);
        build/audio/sequences/s_esa_pengin1_3.mid.o(.rodata*);
        build/audio/sequences/s_esa_pengin2_1.mid.o(.rodata*);
        build/audio/sequences/s_esa_pengin2_2.mid.o(.rodata*);
        build/audio/sequences/s_esa_pengin2_3.mid.o(.rodata*);
        build/audio/sequences/s_esa_pengin3_1.mid.o(.rodata*);
        build/audio/sequences/s_esa_pengin3_2.mid.o(.rodata*);
        build/audio/sequences/s_esa_pengin3_3.mid.o(.rodata*);
        build/audio/sequences/s_esa_catch.mid.o(.rodata*);
        build/audio/sequences/s_quiz_bgm.mid.o(.rodata*);
        build/audio/sequences/s_quiz_fan_good.mid.o(.rodata*);
        build/audio/sequences/s_quiz_fan_bad.mid.o(.rodata*);
        build/audio/sequences/s_virus_fork.mid.o(.rodata*);
        build/audio/sequences/s_virus_dash.mid.o(.rodata*);
        build/audio/sequences/s_virus_miss.mid.o(.rodata*);
        build/audio/sequences/s_virus_hit.mid.o(.rodata*);
        build/audio/sequences/s_virus_osii.mid.o(.rodata*);
        build/audio/sequences/s_check_result_bgm.mid.o(.rodata*);
        build/audio/sequences/s_lesson_sel_bgm.mid.o(.rodata*);
        build/audio/sequences/s_toys_bgm.mid.o(.rodata*);
        build/audio/sequences/s_rap_machine_bgm.mid.o(.rodata*);
        build/audio/sequences/s_mini_game_bgm.mid.o(.rodata*);
        build/audio/sequences/s_remix_all_bgm.mid.o(.rodata*);
        build/audio/sequences/s_sindan_sea.mid.o(.rodata*);
        build/audio/sequences/s_drum_lesson_bgm.mid.o(.rodata*);
        build/audio/sequences/s_counseling_bgm.mid.o(.rodata*);
        build/audio/sequences/s_gameover_fan.mid.o(.rodata*);
        build/audio/sequences/s_studio_bgm.mid.o(.rodata*);
        build/audio/sequences/s_nyuka_fan.mid.o(.rodata*);
        build/audio/sequences/s_siryo_bgm.mid.o(.rodata*);
        build/audio/sequences/s_dr_sam_bgm.mid.o(.rodata*);
        build/audio/sequences/s_renshu_bgm1.mid.o(.rodata*);
        build/audio/sequences/s_renshu_bgm2.mid.o(.rodata*);
        build/audio/sequences/s_renshu_bgm3.mid.o(.rodata*);
        build/audio/sequences/s_kekka_bgm_good.mid.o(.rodata*);
        build/audio/sequences/s_kekka_bgm_common.mid.o(.rodata*);
        build/audio/sequences/s_kekka_bgm_bad.mid.o(.rodata*);
        build/audio/sequences/s_epilogue_fan1.mid.o(.rodata*);
        build/audio/sequences/s_epilogue_fan2.mid.o(.rodata*);
        build/audio/sequences/s_perfect_fan.mid.o(.rodata*);
        build/audio/sequences/s_poly_rakka.mid.o(.rodata*);
        build/audio/sequences/s_poly_shototu.mid.o(.rodata*);
        build/audio/sequences/s_block2_block.mid.o(.rodata*);
        build/audio/sequences/s_block2_fast.mid.o(.rodata*);
        build/audio/sequences/s_uki_water1.mid.o(.rodata*);
        build/audio/sequences/s_uki_water2.mid.o(.rodata*);
        build/audio/sequences/s_uki_water3.mid.o(.rodata*);
        build/audio/sequences/s_kuma_hit.mid.o(.rodata*);
        build/audio/sequences/s_kuma_miss.mid.o(.rodata*);
        build/audio/sequences/s_kuma_sakana.mid.o(.rodata*);
        build/audio/sequences/s_yuri_naki.mid.o(.rodata*);
        build/audio/sequences/s_yuri_yurasi.mid.o(.rodata*);
        build/audio/sequences/s_4beat_open.mid.o(.rodata*);
        build/audio/sequences/s_4beat_jiban.mid.o(.rodata*);
        build/audio/sequences/s_rythm_bat_miss.mid.o(.rodata*);
        build/audio/sequences/s_dontan_count.mid.o(.rodata*);
        build/audio/sequences/s_dontan_water.mid.o(.rodata*);
        build/audio/sequences/s_change_a.mid.o(.rodata*);
        build/audio/sequences/s_change_b.mid.o(.rodata*);
        build/audio/sequences/s_change_ball.mid.o(.rodata*);
        build/audio/sequences/s_change_hit_a.mid.o(.rodata*);
        build/audio/sequences/s_change_hit_b.mid.o(.rodata*);
        build/audio/sequences/s_change_goal.mid.o(.rodata*);
        build/audio/sequences/s_check_machine.mid.o(.rodata*);
        build/audio/sequences/s_check_trick1.mid.o(.rodata*);
        build/audio/sequences/s_check_trick2.mid.o(.rodata*);
        build/audio/sequences/s_check_trick3.mid.o(.rodata*);
        build/audio/sequences/s_menu_se1.mid.o(.rodata*);
        build/audio/sequences/s_menu_se2.mid.o(.rodata*);
        build/audio/sequences/s_menu_se3.mid.o(.rodata*);
        build/audio/sequences/s_menu_se5.mid.o(.rodata*);
        build/audio/sequences/s_menu_se6.mid.o(.rodata*);
        build/audio/sequences/s_menu_se7.mid.o(.rodata*);
        build/audio/sequences/s_menu_se8.mid.o(.rodata*);
        build/audio/sequences/s_menu_se9.mid.o(.rodata*);
        build/audio/sequences/s_menu_se10.mid.o(.rodata*);
        build/audio/sequences/s_menu_se11.mid.o(.rodata*);
        build/audio/sequences/s_menu_se12.mid.o(.rodata*);
        build/audio/sequences/s_menu_se13.mid.o(.rodata*);
        build/audio/sequences/s_menu_se14.mid.o(.rodata*);
        build/audio/sequences/s_menu_se15.mid.o(.rodata*);
        build/audio/sequences/s_menu_se16.mid.o(.rodata*);
        build/audio/sequences/s_menu_se17.mid.o(.rodata*);
        build/audio/sequences/s_menu_woodblock.mid.o(.rodata*);
        build/audio/sequences/s_menu_se19.mid.o(.rodata*);
        build/audio/sequences/s_menu_se20.mid.o(.rodata*);
        build/audio/sequences/s_menu_se22.mid.o(.rodata*);
        build/audio/sequences/s_menu_se23.mid.o(.rodata*);
        build/audio/sequences/s_menu_se24.mid.o(.rodata*);
        build/audio/sequences/s_menu_se25.mid.o(.rodata*);
        build/audio/sequences/s_jingle_rat.mid.o(.rodata*);
        build/audio/sequences/s_jingle_march.mid.o(.rodata*);
        build/audio/sequences/s_jingle_iai.mid.o(.rodata*);
        build/audio/sequences/s_jingle_ghost.mid.o(.rodata*);
        build/audio/sequences/s_jingle_poli.mid.o(.rodata*);
        build/audio/sequences/s_jingle_handclap.mid.o(.rodata*);
        build/audio/sequences/s_jingle_tap.mid.o(.rodata*);
        build/audio/sequences/s_jingle_baseball.mid.o(.rodata*);
        build/audio/sequences/s_jingle_toss.mid.o(.rodata*);
        build/audio/sequences/s_jingle_karate.mid.o(.rodata*);
        build/audio/sequences/s_jingle_witch.mid.o(.rodata*);
        build/audio/sequences/s_jingle_datumo.mid.o(.rodata*);
        build/audio/sequences/s_jingle_quiz.mid.o(.rodata*);
        build/audio/sequences/s_jingle_bon.mid.o(.rodata*);
        build/audio/sequences/s_jingle_rap.mid.o(.rodata*);
        build/audio/sequences/s_jingle_remix.mid.o(.rodata*);
        build/audio/sequences/s_fanfare_drum1.mid.o(.rodata*);
        build/audio/sequences/s_fanfare_drum2.mid.o(.rodata*);
        build/audio/sequences/s_fanfare_drum3.mid.o(.rodata*);
        build/audio/sequences/s_jingle_hi_level.mid.o(.rodata*);
        build/audio/sequences/s_ending_bgm.mid.o(.rodata*);
        build/audio/sequences/s_iai_bgm_studio.mid.o(.rodata*);
        build/audio/sequences/s_rabbit_bgm_studio.mid.o(.rodata*);
        build/audio/sequences/s_rat_bgm_studio.mid.o(.rodata*);
        build/audio/sequences/s_f_dummy.mid.o(.rodata*);
        build/audio/sequences/s_f_dummy_vol0.mid.o(.rodata*);
        build/audio/sequences/s_f_result_bad.mid.o(.rodata*);
        build/audio/sequences/s_f_result_normal.mid.o(.rodata*);
        build/audio/sequences/s_f_result_mes_step1.mid.o(.rodata*);
        build/audio/sequences/s_f_result_mes_step2.mid.o(.rodata*);
        build/audio/sequences/s_f_nyuuka.mid.o(.rodata*);
        build/audio/sequences/s_f_campaign_notice.mid.o(.rodata*);
        build/audio/sequences/s_f_open_game.mid.o(.rodata*);
        build/audio/sequences/s_f_clear_game.mid.o(.rodata*);
        build/audio/sequences/s_f_get_medal.mid.o(.rodata*);
        build/audio/sequences/s_f_point_roll.mid.o(.rodata*);
        build/audio/sequences/s_f_point_stop.mid.o(.rodata*);
        build/audio/sequences/s_f_appear_game.mid.o(.rodata*);
        build/audio/sequences/s_f_fail_perfect.mid.o(.rodata*);
        build/audio/sequences/s_f_result_mes_add.mid.o(.rodata*);
        build/audio/sequences/s_f_send_mes.mid.o(.rodata*);
        build/audio/sequences/s_f_pause_on.mid.o(.rodata*);
        build/audio/sequences/s_f_pause_cursor.mid.o(.rodata*);
        build/audio/sequences/s_f_pause_continue.mid.o(.rodata*);
        build/audio/sequences/s_f_pause_quit.mid.o(.rodata*);
        build/audio/sequences/s_f_scratch.mid.o(.rodata*);
        build/audio/sequences/s_f_env_train.mid.o(.rodata*);
        build/audio/sequences/s_f_env_cherry.mid.o(.rodata*);
        build/audio/sequences/s_f_env_haiku.mid.o(.rodata*);
        build/audio/sequences/s_f_env_class_room.mid.o(.rodata*);
        build/audio/sequences/s_f_env_paper.mid.o(.rodata*);
        build/audio/sequences/s_f_env_paper_rev.mid.o(.rodata*);
        build/audio/sequences/s_f_cafe_send_mes.mid.o(.rodata*);
        build/audio/sequences/s_f_drum_BD_1.mid.o(.rodata*);
        build/audio/sequences/s_f_drum_SD_1.mid.o(.rodata*);
        build/audio/sequences/s_f_drum_SD_Rim_Open.mid.o(.rodata*);
        build/audio/sequences/s_f_drum_Sym_Crash.mid.o(.rodata*);
        build/audio/sequences/s_f_test_drum_BD_A.mid.o(.rodata*);
        build/audio/sequences/s_f_test_drum_BD_B.mid.o(.rodata*);
        build/audio/sequences/s_f_test_drum_SD_A.mid.o(.rodata*);
        build/audio/sequences/s_f_test_drum_SD_B.mid.o(.rodata*);
        build/audio/sequences/s_f_toss_miss1.mid.o(.rodata*);
        build/audio/sequences/s_f_toss_miss2.mid.o(.rodata*);
        build/audio/sequences/s_f_toss_miss3.mid.o(.rodata*);
        build/audio/sequences/s_f_toss_ball.mid.o(.rodata*);
        build/audio/sequences/s_f_toss_swing.mid.o(.rodata*);
        build/audio/sequences/s_f_shuji_v_nuaa.mid.o(.rodata*);
        build/audio/sequences/s_f_shuji_v_unuu.mid.o(.rodata*);
        build/audio/sequences/s_f_shuji_v_ouch.mid.o(.rodata*);
        build/audio/sequences/s_f_shuji_swing1.mid.o(.rodata*);
        build/audio/sequences/s_f_shuji_swing2.mid.o(.rodata*);
        build/audio/sequences/s_f_shuji_start.mid.o(.rodata*);
        build/audio/sequences/s_f_shuji_v_ha1.mid.o(.rodata*);
        build/audio/sequences/s_f_shuji_v_ha2.mid.o(.rodata*);
        build/audio/sequences/s_f_shuji_v_ha3.mid.o(.rodata*);
        build/audio/sequences/s_f_shuji_v_funuue.mid.o(.rodata*);
        build/audio/sequences/s_f_shuji_v_nuahaha.mid.o(.rodata*);
        build/audio/sequences/s_f_rat_goal.mid.o(.rodata*);
        build/audio/sequences/s_f_rat_error.mid.o(.rodata*);
        build/audio/sequences/s_f_rat_slip.mid.o(.rodata*);
        build/audio/sequences/s_f_hanabi_v_tamaya.mid.o(.rodata*);
        build/audio/sequences/s_f_hanabi_v_nuei.mid.o(.rodata*);
        build/audio/sequences/s_f_hanabi_kansei.mid.o(.rodata*);
        build/audio/sequences/s_f_iai_cut.mid.o(.rodata*);
        build/audio/sequences/s_f_iai_cut2.mid.o(.rodata*);
        build/audio/sequences/s_f_iai_title.mid.o(.rodata*);
        build/audio/sequences/s_f_virus_in.mid.o(.rodata*);
        build/audio/sequences/s_f_virus_uhihi.mid.o(.rodata*);
        build/audio/sequences/s_f_virus_hit.mid.o(.rodata*);
        build/audio/sequences/s_f_virus_osii.mid.o(.rodata*);
        build/audio/sequences/s_f_virus_face_fadeout.mid.o(.rodata*);
        build/audio/sequences/s_f_virus_note_land.mid.o(.rodata*);
        build/audio/sequences/s_f_hair_kegire.mid.o(.rodata*);
        build/audio/sequences/s_f_hair_next.mid.o(.rodata*);
        build/audio/sequences/s_f_hair_nuki_long.mid.o(.rodata*);
        build/audio/sequences/s_f_hair_tuneru.mid.o(.rodata*);
        build/audio/sequences/s_f_hair_appear_long.mid.o(.rodata*);
        build/audio/sequences/s_f_poly_blast.mid.o(.rodata*);
        build/audio/sequences/s_f_poly_withdraw.mid.o(.rodata*);
        build/audio/sequences/s_f_poly_close.mid.o(.rodata*);
        build/audio/sequences/s_f_poly_appear_upside.mid.o(.rodata*);
        build/audio/sequences/s_f_poly_appear_downside.mid.o(.rodata*);
        build/audio/sequences/s_f_poly_open_upside.mid.o(.rodata*);
        build/audio/sequences/s_f_poly_open_downside.mid.o(.rodata*);
        build/audio/sequences/s_f_boxing_punch.mid.o(.rodata*);
        build/audio/sequences/s_f_boxing_just_hati.mid.o(.rodata*);
        build/audio/sequences/s_f_boxing_just_hati_nc.mid.o(.rodata*);
        build/audio/sequences/s_f_boxing_just_light.mid.o(.rodata*);
        build/audio/sequences/s_f_boxing_just_light_nc.mid.o(.rodata*);
        build/audio/sequences/s_f_boxing_just_ball.mid.o(.rodata*);
        build/audio/sequences/s_f_boxing_just_ball_nc.mid.o(.rodata*);
        build/audio/sequences/s_f_boxing_just_rock.mid.o(.rodata*);
        build/audio/sequences/s_f_boxing_just_rock_nc.mid.o(.rodata*);
        build/audio/sequences/s_f_boxing_just_bomb.mid.o(.rodata*);
        build/audio/sequences/s_f_boxing_normal.mid.o(.rodata*);
        build/audio/sequences/s_f_boxing_land.mid.o(.rodata*);
        build/audio/sequences/s_f_boxing_fly_nml.mid.o(.rodata*);
        build/audio/sequences/s_f_boxing_v_nua.mid.o(.rodata*);
        build/audio/sequences/s_f_boxing_hard.mid.o(.rodata*);
        build/audio/sequences/s_f_boxing_score_reset.mid.o(.rodata*);
        build/audio/sequences/s_f_boxing_score_up.mid.o(.rodata*);
        build/audio/sequences/s_f_boxing_score_down.mid.o(.rodata*);
        build/audio/sequences/s_f_boxing_kansei.mid.o(.rodata*);
        build/audio/sequences/s_f_boxing_v_fresh.mid.o(.rodata*);
        build/audio/sequences/s_f_boxing_title_hit.mid.o(.rodata*);
        build/audio/sequences/s_f_boxing_honki.mid.o(.rodata*);
        build/audio/sequences/s_f_boxing_fly_ext.mid.o(.rodata*);
        build/audio/sequences/s_f_quiz_hit_ply.mid.o(.rodata*);
        build/audio/sequences/s_f_quiz_hit_com.mid.o(.rodata*);
        build/audio/sequences/s_f_quiz_blast_ply.mid.o(.rodata*);
        build/audio/sequences/s_f_quiz_blast_com.mid.o(.rodata*);
        build/audio/sequences/s_f_quiz_blast_plate.mid.o(.rodata*);
        build/audio/sequences/s_f_quiz_miss.mid.o(.rodata*);
        build/audio/sequences/s_f_quiz_stop.mid.o(.rodata*);
        build/audio/sequences/s_f_quiz_answer.mid.o(.rodata*);
        build/audio/sequences/s_f_quiz_ok.mid.o(.rodata*);
        build/audio/sequences/s_f_ninja_kabe.mid.o(.rodata*);
        build/audio/sequences/s_f_ninja_demo.mid.o(.rodata*);
        build/audio/sequences/s_f_ninja_v_nanu.mid.o(.rodata*);
        build/audio/sequences/s_f_rapW_v_YoOyatuDesuka.mid.o(.rodata*);
        build/audio/sequences/s_f_rapW_v_Yo10JiDesuka.mid.o(.rodata*);
        build/audio/sequences/s_f_rapW_v_Naishodesuka.mid.o(.rodata*);
        build/audio/sequences/s_f_rapW_v_KarenoOyatudane.mid.o(.rodata*);
        build/audio/sequences/s_f_rapW_v_TabeteIikamone.mid.o(.rodata*);
        build/audio/sequences/s_f_rapW_v_AketeIikamone.mid.o(.rodata*);
        build/audio/sequences/s_f_rapW_v_OyatuwaSaiko.mid.o(.rodata*);
        build/audio/sequences/s_f_rapW_v_KibunnwaSaiko.mid.o(.rodata*);
        build/audio/sequences/s_f_rapW_v_AmakuteSaiko.mid.o(.rodata*);
        build/audio/sequences/s_f_rapW_v_BetubaraSaiko.mid.o(.rodata*);
        build/audio/sequences/s_f_rapW_v_KareniwaNaisho.mid.o(.rodata*);
        build/audio/sequences/s_f_rapW_v_DarenimoNaisho.mid.o(.rodata*);
        build/audio/sequences/s_f_rapW_v_Yeah.mid.o(.rodata*);
        build/audio/sequences/s_f_rapW_v_Un.mid.o(.rodata*);
        build/audio/sequences/s_f_rapW_v_Uun.mid.o(.rodata*);
        build/audio/sequences/s_f_rapW_v_CheckIt.mid.o(.rodata*);
        build/audio/sequences/s_f_rapW_v_OyatuwaSaiko_d.mid.o(.rodata*);
        build/audio/sequences/s_f_rapW_v_KibunnwaSaiko_d.mid.o(.rodata*);
        build/audio/sequences/s_f_rapW_v_AmakuteSaiko_d.mid.o(.rodata*);
        build/audio/sequences/s_f_rapW_v_BetubaraSaiko_d.mid.o(.rodata*);
        build/audio/sequences/s_f_batter_ball_land.mid.o(.rodata*);
        build/audio/sequences/s_f_batter_ball_high.mid.o(.rodata*);
        build/audio/sequences/s_f_handclap_pi_G4.mid.o(.rodata*);
        build/audio/sequences/s_f_handclap_pi_E5.mid.o(.rodata*);
        build/audio/sequences/s_f_handclap_ready.mid.o(.rodata*);
        build/audio/sequences/s_f_aim_just_hit.mid.o(.rodata*);
        build/audio/sequences/s_f_aim_just_hit_voice.mid.o(.rodata*);
        build/audio/sequences/s_f_space_hit.mid.o(.rodata*);
        build/audio/sequences/s_f_space_dancer.mid.o(.rodata*);
        build/audio/sequences/s_f_space_dancer_swing.mid.o(.rodata*);
        build/audio/sequences/s_f_space_dancer_sit.mid.o(.rodata*);
        build/audio/sequences/s_f_space_dancer_pa.mid.o(.rodata*);
        build/audio/sequences/s_f_esa_jump.mid.o(.rodata*);
        build/audio/sequences/s_f_esa_splash_penguin.mid.o(.rodata*);
        build/audio/sequences/s_f_esa_splash_ball.mid.o(.rodata*);
        build/audio/sequences/s_f_rabbit_ready.mid.o(.rodata*);
        build/audio/sequences/s_f_rabbit_miss.mid.o(.rodata*);
        build/audio/sequences/s_f_even_splash.mid.o(.rodata*);
        build/audio/sequences/s_f_even_road.mid.o(.rodata*);
        build/audio/sequences/s_f_drumdr_miss.mid.o(.rodata*);
        build/audio/sequences/s_f_drumdr_ok.mid.o(.rodata*);
        build/audio/sequences/s_f_machine_click.mid.o(.rodata*);
        build/audio/sequences/s_f_tap_miss1.mid.o(.rodata*);
        build/audio/sequences/s_f_tap_miss2.mid.o(.rodata*);
        build/audio/sequences/s_f_tap_jump_ready.mid.o(.rodata*);
        build/audio/sequences/s_f_tap_tap.mid.o(.rodata*);
        build/audio/sequences/s_f_tap_pig1.mid.o(.rodata*);
        build/audio/sequences/s_f_tap_pig2.mid.o(.rodata*);
        build/audio/sequences/s_f_conveyer_hit.mid.o(.rodata*);
        build/audio/sequences/s_f_lesson_s.mid.o(.rodata*);
        build/audio/sequences/s_f_lesson_a.mid.o(.rodata*);
        build/audio/sequences/s_f_lesson_b.mid.o(.rodata*);
        build/audio/sequences/s_f_lesson_c.mid.o(.rodata*);
        build/audio/sequences/s_f_base_1note.mid.o(.rodata*);
        build/audio/sequences/s_f_drumtech_miss.mid.o(.rodata*);
        build/audio/sequences/s_f_drumtech_fall.mid.o(.rodata*);
        build/audio/sequences/s_f_drumtech_damage.mid.o(.rodata*);
        build/audio/sequences/s_f_neko1.mid.o(.rodata*);
        build/audio/sequences/s_f_neko2.mid.o(.rodata*);
        build/audio/sequences/s_f_neko3.mid.o(.rodata*);
        build/audio/sequences/s_f_neko4.mid.o(.rodata*);
        build/audio/sequences/s_f_neko5.mid.o(.rodata*);
        build/audio/sequences/s_f_neko6.mid.o(.rodata*);
        build/audio/sequences/s_f_marcher2_v_zentai.mid.o(.rodata*);
        build/audio/sequences/s_f_marcher2_v_susume.mid.o(.rodata*);
        build/audio/sequences/s_f_marcher2_v_tomare.mid.o(.rodata*);
        build/audio/sequences/s_f_marcher2_v_migimukeL.mid.o(.rodata*);
        build/audio/sequences/s_f_marcher2_v_migimukeS.mid.o(.rodata*);
        build/audio/sequences/s_f_marcher2_v_migi.mid.o(.rodata*);
        build/audio/sequences/s_f_marcher2_v_hidarimukeL.mid.o(.rodata*);
        build/audio/sequences/s_f_marcher2_v_hidarimukeS.mid.o(.rodata*);
        build/audio/sequences/s_f_marcher2_v_hidari.mid.o(.rodata*);
        
        build/graphics/gameplay/gameplay_unused_warioware_graphics.c.o(.data*);
        build/games/sneaky_spirits/graphics/sneaky_spirits_obj.4bpp.s.o(.data*);
        build/games/sneaky_spirits/graphics/sneaky_spirits_bg_tiles.4bpp.s.o(.data*);
        build/games/sneaky_spirits/graphics/sneaky_spirits_bg_map_foreground.tilemap.s.o(.data*);
        build/games/sneaky_spirits/graphics/sneaky_spirits_bg_map.tilemap.s.o(.data*);
        build/games/spaceball/graphics/spaceball_obj.4bpp.s.o(.data*);
        build/games/spaceball/graphics/spaceball_bg_tiles.4bpp.s.o(.data*);
        build/games/spaceball/graphics/spaceball_bg_map.tilemap.s.o(.data*);
        build/games/drum_live/graphics/drum_samurai_live_obj.4bpp.s.o(.data*);
        build/games/drum_live/graphics/drum_samurai_live_bg_tiles.4bpp.s.o(.data*);
        build/games/drum_live/graphics/drum_samurai_live_bg_map.tilemap.s.o(.data*);
        build/games/bon_odori/graphics/bon_dance_obj.4bpp.s.o(.data*);
        build/games/bon_odori/graphics/bon_dance_bg_tiles.4bpp.s.o(.data*);
        build/games/bon_odori/graphics/bon_dance_bg_map.tilemap.s.o(.data*);
        build/games/bon_odori/graphics/bon_dance_bg_map_lanterns.tilemap.s.o(.data*);
        build/games/bon_odori/graphics/bon_odori_obj.4bpp.s.o(.data*);
        build/games/bon_odori/graphics/bon_odori_bg_tiles.4bpp.s.o(.data*);
        build/games/bon_odori/graphics/bon_odori_bg_tiles_blank.4bpp.s.o(.data*);
        build/games/bon_odori/graphics/bon_odori_bg_map.tilemap.s.o(.data*);
        build/games/bon_odori/graphics/bon_odori_bg_map_lanterns.tilemap.s.o(.data*);
        build/games/bon_odori/graphics/bon_odori_bg_map_blank.tilemap.s.o(.data*);
        build/games/karate_man/graphics/karate_man_bg_tiles.4bpp.s.o(.data*);
        build/games/karate_man/graphics/karate_man_bg_tiles_serious_unused.4bpp.s.o(.data*);
        build/games/karate_man/graphics/karate_man_bg_tiles_serious.4bpp.s.o(.data*);
        build/games/karate_man/graphics/karate_man_bg_tiles_unused_face_1.4bpp.s.o(.data*);
        build/games/karate_man/graphics/karate_man_bg_tiles_unused_face_2.4bpp.s.o(.data*);
        build/games/karate_man/graphics/karate_man_bg_tiles_unused_face_3.4bpp.s.o(.data*);
        build/games/karate_man/graphics/karate_man_obj.4bpp.s.o(.data*);
        build/games/karate_man/graphics/karate_man_bg_map.tilemap.s.o(.data*);
        build/games/karate_man/graphics/karate_man_bg_map_serious_unused.tilemap.s.o(.data*);
        build/games/karate_man/graphics/karate_man_bg_map_serious.tilemap.s.o(.data*);
        build/games/sneaky_spirits/graphics/sneaky_spirits_prologue_obj.4bpp.s.o(.data*);
        build/games/sneaky_spirits/graphics/sneaky_spirits_prologue_bg_tiles.4bpp.s.o(.data*);
        build/games/sneaky_spirits/graphics/sneaky_spirits_prologue_bg_map.tilemap.s.o(.data*);
        build/games/spaceball/graphics/spaceball_prologue_obj.4bpp.s.o(.data*);
        build/games/spaceball/graphics/spaceball_prologue_bg_tiles.4bpp.s.o(.data*);
        build/games/spaceball/graphics/spaceball_prologue_bg_map.tilemap.s.o(.data*);
        build/games/bon_odori/graphics/bon_dance_prologue_obj.4bpp.s.o(.data*);
        build/games/bon_odori/graphics/bon_dance_prologue_bg_tiles.4bpp.s.o(.data*);
        build/games/bon_odori/graphics/bon_dance_prologue_bg_map.tilemap.s.o(.data*);
        build/games/bon_odori/graphics/bon_odori_prologue_obj.4bpp.s.o(.data*);
        build/games/bon_odori/graphics/bon_odori_prologue_bg_tiles.4bpp.s.o(.data*);
        build/games/bon_odori/graphics/bon_odori_prologue_bg_map.tilemap.s.o(.data*);
        build/games/karate_man/graphics/karate_man_prologue_obj.4bpp.s.o(.data*);
        build/games/karate_man/graphics/karate_man_prologue_bg_tiles.4bpp.s.o(.data*);
        build/games/karate_man/graphics/karate_man_prologue_bg_map.tilemap.s.o(.data*);
        build/games/space_dance/graphics/cosmic_dance_prologue_obj.4bpp.s.o(.data*);
        build/games/space_dance/graphics/cosmic_dance_prologue_bg_tiles.4bpp.s.o(.data*);
        build/games/space_dance/graphics/cosmic_dance_prologue_bg_map.tilemap.s.o(.data*);
        build/games/night_walk/graphics/night_walk_prologue_obj.4bpp.s.o(.data*);
        build/games/night_walk/graphics/night_walk_prologue_bg_tiles.4bpp.s.o(.data*);
        build/games/night_walk/graphics/night_walk_prologue_bg_map.tilemap.s.o(.data*);
        build/games/showtime/graphics/showtime_prologue_obj.4bpp.s.o(.data*);
        build/games/showtime/graphics/showtime_prologue_bg_tiles.4bpp.s.o(.data*);
        build/games/showtime/graphics/showtime_prologue_bg_map.tilemap.s.o(.data*);
        build/games/bouncy_road/graphics/bouncy_road_prologue_obj.4bpp.s.o(.data*);
        build/games/bouncy_road/graphics/bouncy_road_prologue_bg_tiles.4bpp.s.o(.data*);
        build/games/bouncy_road/graphics/bouncy_road_prologue_bg_map.tilemap.s.o(.data*);
        build/games/rhythm_tweezers/graphics/rhythm_tweezers_prologue_obj.4bpp.s.o(.data*);
        build/games/rhythm_tweezers/graphics/rhythm_tweezers_prologue_bg_tiles.4bpp.s.o(.data*);
        build/games/rhythm_tweezers/graphics/rhythm_tweezers_prologue_bg_map.tilemap.s.o(.data*);
        build/games/fireworks/graphics/fireworks_prologue_obj.4bpp.s.o(.data*);
        build/games/fireworks/graphics/fireworks_prologue_bg_tiles.4bpp.s.o(.data*);
        build/games/fireworks/graphics/fireworks_prologue_bg_map.tilemap.s.o(.data*);
        build/games/clappy_trio/graphics/clappy_trio_prologue_obj.4bpp.s.o(.data*);
        build/games/clappy_trio/graphics/clappy_trio_prologue_bg_tiles.4bpp.s.o(.data*);
        build/games/clappy_trio/graphics/clappy_trio_prologue_bg_map.tilemap.s.o(.data*);
        build/games/clappy_trio/graphics/snappy_trio_prologue_obj.4bpp.s.o(.data*);
        build/games/clappy_trio/graphics/snappy_trio_prologue_bg_tiles.4bpp.s.o(.data*);
        build/games/clappy_trio/graphics/snappy_trio_prologue_bg_map.tilemap.s.o(.data*);
#if REV < 1
        build/games/samurai_slice/graphics/samurai_slice_prologue_obj.4bpp.s.o(.data*);
#else
        build/games/samurai_slice/graphics/samurai_slice_prologue_obj_rev1.4bpp.s.o(.data*);
#endif
        build/games/samurai_slice/graphics/samurai_slice_prologue_bg_tiles.4bpp.s.o(.data*);
        build/games/samurai_slice/graphics/samurai_slice_prologue_bg_map_slice.tilemap.s.o(.data*);
        build/games/samurai_slice/graphics/samurai_slice_prologue_bg_map.tilemap.s.o(.data*);
        build/games/power_calligraphy/graphics/power_calligraphy_prologue_obj.4bpp.s.o(.data*);
        build/games/power_calligraphy/graphics/power_calligraphy_prologue_bg_tiles.4bpp.s.o(.data*);
        build/games/power_calligraphy/graphics/power_calligraphy_prologue_bg_map.tilemap.s.o(.data*);
        build/games/marching_orders/graphics/marching_orders_prologue_obj.4bpp.s.o(.data*);
        build/games/marching_orders/graphics/marching_orders_prologue_bg_tiles.4bpp.s.o(.data*);
        build/games/marching_orders/graphics/marching_orders_prologue_bg_map.tilemap.s.o(.data*);
        build/games/marching_orders/graphics/marching_orders_2_prologue_obj.4bpp.s.o(.data*);
        build/games/marching_orders/graphics/marching_orders_2_prologue_bg_tiles.4bpp.s.o(.data*);
        build/games/marching_orders/graphics/marching_orders_2_prologue_bg_map.tilemap.s.o(.data*);
        build/games/polyrhythm/graphics/polyrhythm_prologue_obj.4bpp.s.o(.data*);
        build/games/polyrhythm/graphics/polyrhythm_prologue_bg_tiles.4bpp.s.o(.data*);
        build/games/polyrhythm/graphics/polyrhythm_prologue_bg_map.tilemap.s.o(.data*);
        build/games/quiz_show/graphics/quiz_show_prologue_obj.4bpp.s.o(.data*);
        build/games/quiz_show/graphics/quiz_show_prologue_bg_tiles.4bpp.s.o(.data*);
        build/games/quiz_show/graphics/quiz_show_prologue_bg_map.tilemap.s.o(.data*);
        build/games/remix_1/graphics/remix_1_prologue_obj.4bpp.s.o(.data*);
        build/games/remix_1/graphics/remix_1_prologue_bg_tiles.4bpp.s.o(.data*);
        build/games/remix_1/graphics/remix_1_prologue_bg_map.tilemap.s.o(.data*);
        build/games/remix_2/graphics/remix_2_prologue_obj.4bpp.s.o(.data*);
        build/games/remix_2/graphics/remix_2_prologue_bg_tiles.4bpp.s.o(.data*);
        build/games/remix_2/graphics/remix_2_prologue_bg_map.tilemap.s.o(.data*);
        build/games/remix_3/graphics/remix_3_prologue_obj.4bpp.s.o(.data*);
        build/games/remix_3/graphics/remix_3_prologue_bg_tiles.4bpp.s.o(.data*);
        build/games/remix_3/graphics/remix_3_prologue_bg_map.tilemap.s.o(.data*);
        build/games/remix_4/graphics/remix_4_prologue_obj.4bpp.s.o(.data*);
        build/games/remix_4/graphics/remix_4_prologue_bg_tiles.4bpp.s.o(.data*);
        build/games/remix_4/graphics/remix_4_prologue_bg_map.tilemap.s.o(.data*);
        build/games/remix_5/graphics/remix_5_prologue_obj.4bpp.s.o(.data*);
        build/games/remix_5/graphics/remix_5_prologue_bg_tiles.4bpp.s.o(.data*);
        build/games/remix_5/graphics/remix_5_prologue_bg_map.tilemap.s.o(.data*);
        build/games/remix_6/graphics/remix_6_prologue_obj.4bpp.s.o(.data*);
        build/games/remix_6/graphics/remix_6_prologue_bg_tiles.4bpp.s.o(.data*);
        build/games/remix_6/graphics/remix_6_prologue_bg_map.tilemap.s.o(.data*);
        build/games/remix_7/graphics/remix_7_prologue_obj.4bpp.s.o(.data*);
        build/games/remix_7/graphics/remix_7_prologue_bg_tiles.4bpp.s.o(.data*);
        build/games/remix_7/graphics/remix_7_prologue_bg_map.tilemap.s.o(.data*);
        build/games/remix_8/graphics/remix_8_prologue_obj.4bpp.s.o(.data*);
        build/games/remix_8/graphics/remix_8_prologue_bg_tiles.4bpp.s.o(.data*);
        build/games/remix_8/graphics/remix_8_prologue_bg_map.tilemap.s.o(.data*);
        build/games/bunny_hop/graphics/bunny_hop_prologue_obj.4bpp.s.o(.data*);
        build/games/bunny_hop/graphics/bunny_hop_prologue_bg_tiles.4bpp.s.o(.data*);
        build/games/bunny_hop/graphics/bunny_hop_prologue_bg_map.tilemap.s.o(.data*);
        build/games/rap_men/graphics/rap_men_prologue_obj.4bpp.s.o(.data*);
        build/games/rap_men/graphics/rap_men_prologue_bg_tiles.4bpp.s.o(.data*);
        build/games/rap_men/graphics/rap_men_prologue_bg_map.tilemap.s.o(.data*);
        build/games/rap_men/graphics/rap_women_prologue_obj.4bpp.s.o(.data*);
        build/games/rap_men/graphics/rap_women_prologue_bg_tiles.4bpp.s.o(.data*);
        build/games/rap_men/graphics/rap_women_prologue_bg_map.tilemap.s.o(.data*);
        build/games/rat_race/graphics/rat_race_prologue_obj.4bpp.s.o(.data*);
        build/games/rat_race/graphics/rat_race_prologue_bg_tiles.4bpp.s.o(.data*);
        build/games/rat_race/graphics/rat_race_prologue_bg_map.tilemap.s.o(.data*);
        build/games/ninja_bodyguard/graphics/ninja_bodyguard_prologue_obj.4bpp.s.o(.data*);
        build/games/ninja_bodyguard/graphics/ninja_bodyguard_prologue_bg_tiles.4bpp.s.o(.data*);
        build/games/ninja_bodyguard/graphics/ninja_bodyguard_prologue_bg_map.tilemap.s.o(.data*);
        build/games/ninja_bodyguard/graphics/ninja_reincarnate_prologue_obj.4bpp.s.o(.data*);
        build/games/ninja_bodyguard/graphics/ninja_reincarnate_prologue_bg_tiles.4bpp.s.o(.data*);
        build/games/ninja_bodyguard/graphics/ninja_reincarnate_prologue_bg_map.tilemap.s.o(.data*);
        build/games/space_dance/graphics/space_dance_prologue_obj.4bpp.s.o(.data*);
        build/games/space_dance/graphics/space_dance_prologue_bg_tiles.4bpp.s.o(.data*);
        build/games/space_dance/graphics/space_dance_prologue_bg_map.tilemap.s.o(.data*);
        build/games/tap_trial/graphics/tap_trial_prologue_obj.4bpp.s.o(.data*);
        build/games/tap_trial/graphics/tap_trial_prologue_bg_tiles.4bpp.s.o(.data*);
        build/games/tap_trial/graphics/tap_trial_prologue_bg_map.tilemap.s.o(.data*);
        build/games/tap_trial/graphics/tap_trial_2_prologue_obj.4bpp.s.o(.data*);
        build/games/tap_trial/graphics/tap_trial_2_prologue_bg_tiles.4bpp.s.o(.data*);
        build/games/tap_trial/graphics/tap_trial_2_prologue_bg_map.tilemap.s.o(.data*);
        build/games/toss_boys/graphics/toss_boys_prologue_obj.4bpp.s.o(.data*);
        build/games/toss_boys/graphics/toss_boys_prologue_bg_tiles.4bpp.s.o(.data*);
        build/games/toss_boys/graphics/toss_boys_prologue_bg_map.tilemap.s.o(.data*);
        build/games/toss_boys/graphics/toss_boys_2_prologue_obj.4bpp.s.o(.data*);
        build/games/toss_boys/graphics/toss_boys_2_prologue_bg_tiles.4bpp.s.o(.data*);
        build/games/toss_boys/graphics/toss_boys_2_prologue_bg_map.tilemap.s.o(.data*);
        build/games/tram_and_pauline/graphics/tram_pauline_prologue_obj.4bpp.s.o(.data*);
        build/games/tram_and_pauline/graphics/tram_pauline_prologue_bg_tiles.4bpp.s.o(.data*);
        build/games/tram_and_pauline/graphics/tram_pauline_prologue_bg_map.tilemap.s.o(.data*);
        build/games/sick_beats/graphics/sick_beats_prologue_obj.4bpp.s.o(.data*);
        build/games/sick_beats/graphics/sick_beats_prologue_bg_tiles.4bpp.s.o(.data*);
        build/games/sick_beats/graphics/sick_beats_prologue_bg_map.tilemap.s.o(.data*);
        build/games/wizards_waltz/graphics/wizards_waltz_prologue_obj.4bpp.s.o(.data*);
        build/games/wizards_waltz/graphics/wizards_waltz_prologue_bg_tiles.4bpp.s.o(.data*);
        build/games/wizards_waltz/graphics/wizards_waltz_prologue_bg_map.tilemap.s.o(.data*);
        build/graphics/placeholder_prologue/placeholder_prologue_obj.4bpp.s.o(.data*);
        build/games/mannequin_factory/graphics/mannequin_factory_bg_tiles.4bpp.s.o(.data*);
        build/games/mannequin_factory/graphics/mannequin_factory_obj.4bpp.s.o(.data*);
        build/games/mannequin_factory/graphics/mannequin_factory_bg_map.tilemap.s.o(.data*);
        build/games/mannequin_factory/graphics/mannequin_factory_bg_map_practice.tilemap.s.o(.data*);
        build/games/space_dance/graphics/cosmic_dance_obj.4bpp.s.o(.data*);
        build/games/space_dance/graphics/cosmic_dance_bg_tiles.4bpp.s.o(.data*);
        build/games/space_dance/graphics/cosmic_dance_bg_map_1.tilemap.s.o(.data*);
        build/games/space_dance/graphics/cosmic_dance_bg_map_2.tilemap.s.o(.data*);
        build/games/staff_credit/graphics/staff_credit_karate_man_bg_tiles.4bpp.s.o(.data*);
        build/games/staff_credit/graphics/staff_credit_clappy_trio_bg_tiles.4bpp.s.o(.data*);
        build/games/staff_credit/graphics/staff_credit_spaceball_bg_tiles.4bpp.s.o(.data*);
        build/games/staff_credit/graphics/staff_credit_toss_boys_bg_tiles.4bpp.s.o(.data*);
        build/games/staff_credit/graphics/staff_credit_tap_trial_bg_tiles.4bpp.s.o(.data*);
        build/games/staff_credit/graphics/staff_credit_bon_odori_bg_tiles.4bpp.s.o(.data*);
        build/games/staff_credit/graphics/staff_credit_drums_bg_tiles.4bpp.s.o(.data*);
        build/games/staff_credit/graphics/staff_credit_drums_2_bg_tiles.4bpp.s.o(.data*);
        build/games/staff_credit/graphics/staff_credit_karate_man_bg_map.tilemap.s.o(.data*);
        build/games/staff_credit/graphics/staff_credit_clappy_trio_bg_map.tilemap.s.o(.data*);
        build/games/staff_credit/graphics/staff_credit_spaceball_bg_map.tilemap.s.o(.data*);
        build/games/staff_credit/graphics/staff_credit_toss_boys_bg_map.tilemap.s.o(.data*);
        build/games/staff_credit/graphics/staff_credit_tap_trial_bg_map.tilemap.s.o(.data*);
        build/games/staff_credit/graphics/staff_credit_bon_odori_bg_map.tilemap.s.o(.data*);
        build/games/staff_credit/graphics/staff_credit_drums_bg_map.tilemap.s.o(.data*);
        build/games/staff_credit/graphics/staff_credit_drums_2_bg_map.tilemap.s.o(.data*);
        build/games/drum_live/graphics/drum_boys_live_obj.4bpp.s.o(.data*);
        build/games/drum_live/graphics/drum_boys_bg_tiles.4bpp.s.o(.data*);
        build/games/drum_live/graphics/drum_boys_live_bg_map.tilemap.s.o(.data*);
        build/games/drum_live/graphics/drum_girls_live_obj.4bpp.s.o(.data*);
        build/games/drum_live/graphics/drum_girls_live_bg_tiles.4bpp.s.o(.data*);
        build/games/drum_live/graphics/drum_live_bg_tiles.4bpp.s.o(.data*);
        build/games/drum_live/graphics/drum_girls_live_bg_map.tilemap.s.o(.data*);
        build/games/drum_live/graphics/drum_live_bg_map.tilemap.s.o(.data*);
        build/games/drum_live/graphics/drum_live_crowd_bg_map_1.tilemap.s.o(.data*);
        build/games/drum_live/graphics/drum_live_crowd_bg_map_2.tilemap.s.o(.data*);
        build/games/drum_live/graphics/drum_live_crowd_bg_map_3.tilemap.s.o(.data*);
        build/games/drum_live/graphics/drum_live_crowd_bg_map_4.tilemap.s.o(.data*);
        build/games/drum_live/graphics/drum_live_crowd_bg_map_5.tilemap.s.o(.data*);
        build/games/drum_live/graphics/drum_live_crowd_bg_map_6.tilemap.s.o(.data*);
        build/games/drum_live/graphics/drum_live_crowd_bg_map_7.tilemap.s.o(.data*);
        build/games/drum_live/graphics/drum_live_crowd_bg_map_8.tilemap.s.o(.data*);
        build/games/drum_live/graphics/drum_live_crowd_bg_map_9.tilemap.s.o(.data*);
        build/games/drum_live/graphics/drum_live_crowd_bg_map_10.tilemap.s.o(.data*);
        build/games/drum_live/graphics/drum_live_crowd_bg_map_11.tilemap.s.o(.data*);
        build/games/drum_intro/graphics/drum_intro_play_obj.4bpp.s.o(.data*);
        build/games/drum_intro/graphics/drum_intro_play_bg_tiles.4bpp.s.o(.data*);
        build/games/drum_intro/graphics/drum_intro_unused_bg_tiles.4bpp.s.o(.data*);
        build/games/drum_intro/graphics/drum_intro_play_bg_map.tilemap.s.o(.data*);
        build/games/drum_intro/graphics/drum_intro_unused_bg_map.tilemap.s.o(.data*);
        build/games/drum_intro/graphics/drum_intro_talk_obj.4bpp.s.o(.data*);
        build/games/drum_intro/graphics/drum_intro_talk_bg_tiles.4bpp.s.o(.data*);
        build/games/drum_intro/graphics/drum_intro_talk_bg_map.tilemap.s.o(.data*);
        build/games/drum_studio/graphics/drum_studio_obj.4bpp.s.o(.data*);
        build/games/drum_studio/graphics/drum_lessons_bg_tiles.4bpp.s.o(.data*);
        build/games/drum_studio/graphics/drum_studio_bg_tiles.4bpp.s.o(.data*);
        build/games/drum_studio/graphics/drum_studio_unused_bg_tiles.4bpp.s.o(.data*);
        build/games/drum_studio/graphics/drum_lessons_obj.4bpp.s.o(.data*);
        build/games/drum_studio/graphics/drum_lessons_bg_map.tilemap.s.o(.data*);
        build/games/drum_studio/graphics/drum_lessons_bg_map_level_up.tilemap.s.o(.data*);
        build/games/drum_studio/graphics/drum_studio_bg_map.tilemap.s.o(.data*);
        build/games/drum_studio/graphics/drum_studio_bg_map_lessons.tilemap.s.o(.data*);
        build/games/night_walk/graphics/night_walk_obj.4bpp.s.o(.data*);
        build/games/night_walk/graphics/night_walk_bg_map.tilemap.s.o(.data*);
        build/games/showtime/graphics/showtime_obj.4bpp.s.o(.data*);
        build/games/showtime/graphics/showtime_bg_tiles.4bpp.s.o(.data*);
        build/games/showtime/graphics/showtime_remix_3_bg_tiles.4bpp.s.o(.data*);
        build/games/showtime/graphics/showtime_bg_map.tilemap.s.o(.data*);
        build/games/showtime/graphics/showtime_bg_map_water.tilemap.s.o(.data*);
        build/games/showtime/graphics/showtime_remix_3_bg_map.tilemap.s.o(.data*);
        build/games/showtime/graphics/showtime_remix_3_bg_map_water.tilemap.s.o(.data*);
        build/games/bouncy_road/graphics/bouncy_road_obj.4bpp.s.o(.data*);
        build/games/bouncy_road/graphics/bouncy_road_remix_5_bg_tiles.4bpp.s.o(.data*);
        build/games/bouncy_road/graphics/bouncy_road_remix_5_bg_map_1.tilemap.s.o(.data*);
        build/games/bouncy_road/graphics/bouncy_road_remix_5_bg_map_2.tilemap.s.o(.data*);
        build/games/bouncy_road/graphics/bouncy_road_remix_5_bg_map_3.tilemap.s.o(.data*);
        build/games/rhythm_tweezers/graphics/rhythm_tweezers_obj.4bpp.s.o(.data*);
        build/games/rhythm_tweezers/graphics/rhythm_tweezers_bg_tiles.4bpp.s.o(.data*);
        build/games/rhythm_tweezers/graphics/rhythm_tweezers_no_peeking_sign_bg_tiles.4bpp.s.o(.data*);
        build/games/rhythm_tweezers/graphics/rhythm_tweezers_bg_map_onion.tilemap.s.o(.data*);
        build/games/rhythm_tweezers/graphics/rhythm_tweezers_bg_map_turnip.tilemap.s.o(.data*);
        build/games/rhythm_tweezers/graphics/rhythm_tweezers_bg_map_potato.tilemap.s.o(.data*);
        build/games/rhythm_tweezers/graphics/rhythm_tweezers_no_peeking_sign_bg_map.tilemap.s.o(.data*);
        build/games/fireworks/graphics/fireworks_obj.4bpp.s.o(.data*);
        build/games/fireworks/graphics/fireworks_remix_5_bg_tiles_1.4bpp.s.o(.data*);
        build/games/fireworks/graphics/fireworks_remix_5_bg_tiles_2.4bpp.s.o(.data*);
        build/games/fireworks/graphics/fireworks_remix_5_bg_tiles_3.4bpp.s.o(.data*);
        build/games/fireworks/graphics/fireworks_remix_5_bg_tiles_4.4bpp.s.o(.data*);
        build/games/fireworks/graphics/fireworks_bg_map.tilemap.s.o(.data*);
        build/games/fireworks/graphics/fireworks_remix_5_bg_map_1.tilemap.s.o(.data*);
        build/games/fireworks/graphics/fireworks_remix_5_bg_map_2.tilemap.s.o(.data*);
        build/games/fireworks/graphics/fireworks_remix_5_bg_map_3.tilemap.s.o(.data*);
        build/games/fireworks/graphics/fireworks_remix_5_bg_map_4.tilemap.s.o(.data*);
        build/games/clappy_trio/graphics/clappy_trio_obj.4bpp.s.o(.data*);
        build/games/clappy_trio/graphics/clappy_trio_bg_tiles.4bpp.s.o(.data*);
        build/games/clappy_trio/graphics/clappy_trio_bg_map.tilemap.s.o(.data*);
        build/games/clappy_trio/graphics/snappy_trio_obj.4bpp.s.o(.data*);
        build/games/clappy_trio/graphics/snappy_trio_bg_tiles.4bpp.s.o(.data*);
        build/games/clappy_trio/graphics/snappy_trio_bg_map.tilemap.s.o(.data*);
        build/games/samurai_slice/graphics/samurai_slice_obj.4bpp.s.o(.data*);
        build/games/samurai_slice/graphics/samurai_slice_bg_tiles.4bpp.s.o(.data*);
        build/games/samurai_slice/graphics/samurai_slice_bg_map_fog_top.tilemap.s.o(.data*);
        build/games/samurai_slice/graphics/samurai_slice_bg_map_fog_bottom.tilemap.s.o(.data*);
        build/games/samurai_slice/graphics/samurai_slice_bg_map.tilemap.s.o(.data*);
        build/games/power_calligraphy/graphics/power_calligraphy_obj.4bpp.s.o(.data*);
        build/games/power_calligraphy/graphics/power_calligraphy_bg_tiles.4bpp.s.o(.data*);
        build/games/power_calligraphy/graphics/power_calligraphy_obj_dancers.4bpp.s.o(.data*);
        build/games/power_calligraphy/graphics/power_calligraphy_bg_map.tilemap.s.o(.data*);
        build/games/rhythm_test/graphics/rhythm_test_obj.4bpp.s.o(.data*);
        build/games/rhythm_test/graphics/rhythm_test_bg_tiles.4bpp.s.o(.data*);
        build/games/rhythm_test/graphics/rhythm_test_bg_map_chart.tilemap.s.o(.data*);
        build/games/rhythm_test/graphics/rhythm_test_bg_map_foreground.tilemap.s.o(.data*);
        build/games/rhythm_test/graphics/rhythm_test_bg_map.tilemap.s.o(.data*);
        build/games/marching_orders/graphics/marching_orders_obj.4bpp.s.o(.data*);
        build/games/marching_orders/graphics/marching_orders_bg_tiles.4bpp.s.o(.data*);
        build/games/marching_orders/graphics/marching_orders_bg_map.tilemap.s.o(.data*);
        build/games/marching_orders/graphics/marching_orders_bg_map_floor.tilemap.s.o(.data*);
        build/games/marching_orders/graphics/marching_orders_bg_map_text_bubble.tilemap.s.o(.data*);
        build/games/marching_orders/graphics/marching_orders_2_obj.4bpp.s.o(.data*);
        build/games/marching_orders/graphics/marching_orders_2_bg_tiles.4bpp.s.o(.data*);
        build/games/marching_orders/graphics/marching_orders_2_bg_map.tilemap.s.o(.data*);
        build/games/marching_orders/graphics/marching_orders_2_bg_map_floor.tilemap.s.o(.data*);
        build/games/metronome/graphics/metronome_obj.4bpp.s.o(.data*);
        build/games/drum_studio/graphics/drum_studio_squares_bg_tiles.4bpp.s.o(.data*);
        build/games/drum_studio/graphics/drum_studio_city_bg_tiles.4bpp.s.o(.data*);
        build/games/drum_studio/graphics/drum_studio_checkerboard_bg_tiles.4bpp.s.o(.data*);
        build/games/drum_studio/graphics/drum_studio_circles_bg_tiles.4bpp.s.o(.data*);
        build/games/drum_studio/graphics/drum_studio_clouds_bg_tiles.4bpp.s.o(.data*);
        build/games/drum_studio/graphics/drum_studio_hearts_bg_tiles.4bpp.s.o(.data*);
        build/games/drum_studio/graphics/drum_studio_sparkles_bg_tiles.4bpp.s.o(.data*);
        build/games/drum_studio/graphics/drum_studio_japan_bg_tiles.4bpp.s.o(.data*);
        build/games/drum_studio/graphics/drum_studio_stars_bg_tiles.4bpp.s.o(.data*);
        build/games/drum_studio/graphics/drum_studio_fish_bg_tiles.4bpp.s.o(.data*);
        build/games/drum_studio/graphics/drum_studio_flowers_bg_tiles.4bpp.s.o(.data*);
        build/games/drum_studio/graphics/drum_studio_fruit_bg_tiles.4bpp.s.o(.data*);
        build/games/drum_studio/graphics/drum_studio_stationery_bg_tiles.4bpp.s.o(.data*);
        build/games/drum_studio/graphics/drum_studio_beach_bg_tiles.4bpp.s.o(.data*);
        build/games/drum_studio/graphics/drum_studio_lines_bg_tiles.4bpp.s.o(.data*);
        build/games/drum_studio/graphics/drum_studio_squares_bg_map_1.tilemap.s.o(.data*);
        build/games/drum_studio/graphics/drum_studio_squares_bg_map_2.tilemap.s.o(.data*);
        build/games/drum_studio/graphics/drum_studio_city_bg_map_1.tilemap.s.o(.data*);
        build/games/drum_studio/graphics/drum_studio_city_bg_map_2.tilemap.s.o(.data*);
        build/games/drum_studio/graphics/drum_studio_checkerboard_bg_map_1.tilemap.s.o(.data*);
        build/games/drum_studio/graphics/drum_studio_checkerboard_bg_map_2.tilemap.s.o(.data*);
        build/games/drum_studio/graphics/drum_studio_circles_bg_map_1.tilemap.s.o(.data*);
        build/games/drum_studio/graphics/drum_studio_circles_bg_map_2.tilemap.s.o(.data*);
        build/games/drum_studio/graphics/drum_studio_clouds_bg_map_1.tilemap.s.o(.data*);
        build/games/drum_studio/graphics/drum_studio_clouds_bg_map_2.tilemap.s.o(.data*);
        build/games/drum_studio/graphics/drum_studio_hearts_bg_map_1.tilemap.s.o(.data*);
        build/games/drum_studio/graphics/drum_studio_hearts_bg_map_2.tilemap.s.o(.data*);
        build/games/drum_studio/graphics/drum_studio_sparkles_bg_map_1.tilemap.s.o(.data*);
        build/games/drum_studio/graphics/drum_studio_sparkles_bg_map_2.tilemap.s.o(.data*);
        build/games/drum_studio/graphics/drum_studio_japan_bg_map_1.tilemap.s.o(.data*);
        build/games/drum_studio/graphics/drum_studio_japan_bg_map_2.tilemap.s.o(.data*);
        build/games/drum_studio/graphics/drum_studio_stars_bg_map_1.tilemap.s.o(.data*);
        build/games/drum_studio/graphics/drum_studio_stars_bg_map_2.tilemap.s.o(.data*);
        build/games/drum_studio/graphics/drum_studio_fish_bg_map_1.tilemap.s.o(.data*);
        build/games/drum_studio/graphics/drum_studio_fish_bg_map_2.tilemap.s.o(.data*);
        build/games/drum_studio/graphics/drum_studio_flowers_bg_map_1.tilemap.s.o(.data*);
        build/games/drum_studio/graphics/drum_studio_flowers_bg_map_2.tilemap.s.o(.data*);
        build/games/drum_studio/graphics/drum_studio_fruit_bg_map_1.tilemap.s.o(.data*);
        build/games/drum_studio/graphics/drum_studio_fruit_bg_map_2.tilemap.s.o(.data*);
        build/games/drum_studio/graphics/drum_studio_stationery_bg_map_1.tilemap.s.o(.data*);
        build/games/drum_studio/graphics/drum_studio_stationery_bg_map_2.tilemap.s.o(.data*);
        build/games/drum_studio/graphics/drum_studio_beach_bg_map_1.tilemap.s.o(.data*);
        build/games/drum_studio/graphics/drum_studio_beach_bg_map_2.tilemap.s.o(.data*);
        build/games/drum_studio/graphics/drum_studio_lines_bg_map_1.tilemap.s.o(.data*);
        build/games/drum_studio/graphics/drum_studio_lines_bg_map_2.tilemap.s.o(.data*);
        build/graphics/options/options_obj.4bpp.s.o(.data*);
        build/graphics/options/options_bg_tiles.4bpp.s.o(.data*);
        build/graphics/options/options_bg_map.tilemap.s.o(.data*);
        build/games/polyrhythm/graphics/polyrhythm_obj.4bpp.s.o(.data*);
        build/games/polyrhythm/graphics/polyrhythm_bg_map.tilemap.s.o(.data*);
        build/games/drum_live/graphics/drum_live_menu_obj.4bpp.s.o(.data*);
        build/games/quiz_show/graphics/quiz_show_obj.4bpp.s.o(.data*);
        build/games/quiz_show/graphics/quiz_show_bg_tiles.4bpp.s.o(.data*);
        build/games/quiz_show/graphics/quiz_show_bg_map_stands.tilemap.s.o(.data*);
        build/games/quiz_show/graphics/quiz_show_bg_map.tilemap.s.o(.data*);
        build/games/quiz_show/graphics/quiz_show_bg_map_text_bubble.tilemap.s.o(.data*);
        build/games/quiz_show/graphics/quiz_show_bg_map_spotlight.tilemap.s.o(.data*);
        build/games/bunny_hop/graphics/bunny_hop_obj.4bpp.s.o(.data*);
        build/games/bunny_hop/graphics/bunny_hop_bg_tiles.4bpp.s.o(.data*);
        build/games/bunny_hop/graphics/bunny_hop_bg_map_water.tilemap.s.o(.data*);
        build/games/bunny_hop/graphics/bunny_hop_bg_map_ground.tilemap.s.o(.data*);
        build/games/bunny_hop/graphics/bunny_hop_bg_map.tilemap.s.o(.data*);
        build/games/rap_men/graphics/rap_men_obj.4bpp.s.o(.data*);
        build/games/rap_men/graphics/rap_men_bg_tiles.4bpp.s.o(.data*);
        build/games/rap_men/graphics/rap_men_bg_map.tilemap.s.o(.data*);
        build/games/rap_men/graphics/rap_women_obj.4bpp.s.o(.data*);
        build/games/rap_men/graphics/rap_women_bg_tiles.4bpp.s.o(.data*);
        build/games/rap_men/graphics/rap_women_bg_map.tilemap.s.o(.data*);
        build/games/rat_race/graphics/rat_race_obj.4bpp.s.o(.data*);
        build/games/rat_race/graphics/rat_race_bg_tiles.4bpp.s.o(.data*);
        build/games/rat_race/graphics/rat_race_bg_map_near.tilemap.s.o(.data*);
        build/games/rat_race/graphics/rat_race_bg_map_middle.tilemap.s.o(.data*);
        build/games/rat_race/graphics/rat_race_bg_map_far.tilemap.s.o(.data*);
        build/games/rat_race/graphics/rat_race_bg_map_cheese.tilemap.s.o(.data*);
        build/games/rat_race/graphics/rat_race_bg_map_cat.tilemap.s.o(.data*);
        build/games/sneaky_spirits/graphics/sneaky_spirits_epilogue_bg_tiles.4bpp.s.o(.data*);
        build/games/sneaky_spirits/graphics/sneaky_spirits_epilogue_bg_map_try_again.tilemap.s.o(.data*);
        build/games/sneaky_spirits/graphics/sneaky_spirits_epilogue_bg_map_ok.tilemap.s.o(.data*);
        build/games/sneaky_spirits/graphics/sneaky_spirits_epilogue_bg_map_superb.tilemap.s.o(.data*);
        build/games/spaceball/graphics/spaceball_epilogue_bg_tiles.4bpp.s.o(.data*);
        build/games/spaceball/graphics/spaceball_epilogue_bg_map_try_again.tilemap.s.o(.data*);
        build/games/spaceball/graphics/spaceball_epilogue_bg_map_ok.tilemap.s.o(.data*);
        build/games/spaceball/graphics/spaceball_epilogue_bg_map_superb.tilemap.s.o(.data*);
        build/games/bon_odori/graphics/bon_dance_epilogue_bg_tiles.4bpp.s.o(.data*);
        build/games/bon_odori/graphics/bon_dance_epilogue_bg_map_try_again.tilemap.s.o(.data*);
        build/games/bon_odori/graphics/bon_dance_epilogue_bg_map_ok.tilemap.s.o(.data*);
        build/games/bon_odori/graphics/bon_dance_epilogue_bg_map_superb.tilemap.s.o(.data*);
        build/games/bon_odori/graphics/bon_odori_epilogue_bg_tiles.4bpp.s.o(.data*);
        build/games/bon_odori/graphics/bon_odori_epilogue_bg_map_try_again.tilemap.s.o(.data*);
        build/games/bon_odori/graphics/bon_odori_epilogue_bg_map_ok.tilemap.s.o(.data*);
        build/games/bon_odori/graphics/bon_odori_epilogue_bg_map_superb.tilemap.s.o(.data*);
        build/games/karate_man/graphics/karate_man_epilogue_bg_tiles.4bpp.s.o(.data*);
        build/games/karate_man/graphics/karate_man_epilogue_bg_map_try_again.tilemap.s.o(.data*);
        build/games/karate_man/graphics/karate_man_epilogue_bg_map_ok.tilemap.s.o(.data*);
        build/games/karate_man/graphics/karate_man_epilogue_bg_map_superb.tilemap.s.o(.data*);
        build/games/space_dance/graphics/cosmic_dance_epilogue_bg_tiles.4bpp.s.o(.data*);
        build/games/space_dance/graphics/cosmic_dance_epilogue_bg_map_try_again.tilemap.s.o(.data*);
        build/games/space_dance/graphics/cosmic_dance_epilogue_bg_map_ok.tilemap.s.o(.data*);
        build/games/space_dance/graphics/cosmic_dance_epilogue_bg_map_superb.tilemap.s.o(.data*);
        build/games/drum_live/graphics/drum_live_epilogue_bg_tiles.4bpp.s.o(.data*);
        build/games/drum_live/graphics/drum_live_epilogue_bg_map_try_again.tilemap.s.o(.data*);
        build/games/drum_live/graphics/drum_live_epilogue_bg_map_ok.tilemap.s.o(.data*);
        build/games/drum_live/graphics/drum_live_epilogue_bg_map_superb.tilemap.s.o(.data*);
        build/games/night_walk/graphics/night_walk_epilogue_bg_tiles.4bpp.s.o(.data*);
        build/games/night_walk/graphics/night_walk_epilogue_bg_map_try_again.tilemap.s.o(.data*);
        build/games/night_walk/graphics/night_walk_epilogue_bg_map_ok.tilemap.s.o(.data*);
        build/games/night_walk/graphics/night_walk_epilogue_bg_map_superb.tilemap.s.o(.data*);
        build/games/showtime/graphics/showtime_epilogue_bg_tiles.4bpp.s.o(.data*);
        build/games/showtime/graphics/showtime_epilogue_bg_map_try_again.tilemap.s.o(.data*);
        build/games/showtime/graphics/showtime_epilogue_bg_map_ok.tilemap.s.o(.data*);
        build/games/showtime/graphics/showtime_epilogue_bg_map_superb.tilemap.s.o(.data*);
        build/games/bouncy_road/graphics/bouncy_road_epilogue_bg_tiles.4bpp.s.o(.data*);
        build/games/bouncy_road/graphics/bouncy_road_epilogue_bg_map_try_again.tilemap.s.o(.data*);
        build/games/bouncy_road/graphics/bouncy_road_epilogue_bg_map_ok.tilemap.s.o(.data*);
        build/games/bouncy_road/graphics/bouncy_road_epilogue_bg_map_superb.tilemap.s.o(.data*);
        build/games/rhythm_tweezers/graphics/rhythm_tweezers_epilogue_bg_tiles.4bpp.s.o(.data*);
        build/games/rhythm_tweezers/graphics/rhythm_tweezers_epilogue_bg_map_try_again.tilemap.s.o(.data*);
        build/games/rhythm_tweezers/graphics/rhythm_tweezers_epilogue_bg_map_ok.tilemap.s.o(.data*);
        build/games/rhythm_tweezers/graphics/rhythm_tweezers_epilogue_bg_map_superb.tilemap.s.o(.data*);
        build/games/fireworks/graphics/fireworks_epilogue_bg_tiles.4bpp.s.o(.data*);
        build/games/fireworks/graphics/fireworks_epilogue_bg_map_try_again.tilemap.s.o(.data*);
        build/games/fireworks/graphics/fireworks_epilogue_bg_map_ok.tilemap.s.o(.data*);
        build/games/fireworks/graphics/fireworks_epilogue_bg_map_superb.tilemap.s.o(.data*);
        build/games/clappy_trio/graphics/clappy_trio_epilogue_bg_tiles.4bpp.s.o(.data*);
        build/games/clappy_trio/graphics/clappy_trio_epilogue_bg_map_try_again.tilemap.s.o(.data*);
        build/games/clappy_trio/graphics/clappy_trio_epilogue_bg_map_ok.tilemap.s.o(.data*);
        build/games/clappy_trio/graphics/clappy_trio_epilogue_bg_map_superb.tilemap.s.o(.data*);
        build/games/clappy_trio/graphics/snappy_trio_epilogue_bg_tiles.4bpp.s.o(.data*);
        build/games/clappy_trio/graphics/snappy_trio_epilogue_bg_map_try_again.tilemap.s.o(.data*);
        build/games/clappy_trio/graphics/snappy_trio_epilogue_bg_map_ok.tilemap.s.o(.data*);
        build/games/clappy_trio/graphics/snappy_trio_epilogue_bg_map_superb.tilemap.s.o(.data*);
        build/games/samurai_slice/graphics/samurai_slice_epilogue_bg_tiles.4bpp.s.o(.data*);
        build/games/samurai_slice/graphics/samurai_slice_epilogue_bg_map_try_again.tilemap.s.o(.data*);
        build/games/samurai_slice/graphics/samurai_slice_epilogue_bg_map_ok.tilemap.s.o(.data*);
        build/games/samurai_slice/graphics/samurai_slice_epilogue_bg_map_superb.tilemap.s.o(.data*);
        build/games/power_calligraphy/graphics/power_calligraphy_epilogue_bg_tiles.4bpp.s.o(.data*);
        build/games/power_calligraphy/graphics/power_calligraphy_epilogue_bg_map_try_again.tilemap.s.o(.data*);
        build/games/power_calligraphy/graphics/power_calligraphy_epilogue_bg_map_ok.tilemap.s.o(.data*);
        build/games/power_calligraphy/graphics/power_calligraphy_epilogue_bg_map_superb.tilemap.s.o(.data*);
        build/games/marching_orders/graphics/marching_orders_epilogue_bg_tiles.4bpp.s.o(.data*);
        build/games/marching_orders/graphics/marching_orders_epilogue_bg_map_try_again.tilemap.s.o(.data*);
        build/games/marching_orders/graphics/marching_orders_epilogue_bg_map_ok.tilemap.s.o(.data*);
        build/games/marching_orders/graphics/marching_orders_epilogue_bg_map_superb.tilemap.s.o(.data*);
        build/games/marching_orders/graphics/marching_orders_2_epilogue_bg_tiles.4bpp.s.o(.data*);
        build/games/marching_orders/graphics/marching_orders_2_epilogue_bg_map_try_again.tilemap.s.o(.data*);
        build/games/marching_orders/graphics/marching_orders_2_epilogue_bg_map_ok.tilemap.s.o(.data*);
        build/games/marching_orders/graphics/marching_orders_2_epilogue_bg_map_superb.tilemap.s.o(.data*);
        build/games/polyrhythm/graphics/polyrhythm_epilogue_bg_tiles.4bpp.s.o(.data*);
        build/games/polyrhythm/graphics/polyrhythm_epilogue_bg_map_try_again.tilemap.s.o(.data*);
        build/games/polyrhythm/graphics/polyrhythm_epilogue_bg_map_ok.tilemap.s.o(.data*);
        build/games/polyrhythm/graphics/polyrhythm_epilogue_bg_map_superb.tilemap.s.o(.data*);
        build/games/quiz_show/graphics/quiz_show_epilogue_bg_tiles.4bpp.s.o(.data*);
        build/games/quiz_show/graphics/quiz_show_epilogue_bg_map_try_again.tilemap.s.o(.data*);
        build/games/quiz_show/graphics/quiz_show_epilogue_bg_map_ok.tilemap.s.o(.data*);
        build/games/quiz_show/graphics/quiz_show_epilogue_bg_map_superb.tilemap.s.o(.data*);
        build/games/bunny_hop/graphics/bunny_hop_epilogue_bg_tiles.4bpp.s.o(.data*);
        build/games/bunny_hop/graphics/bunny_hop_epilogue_bg_map_try_again.tilemap.s.o(.data*);
        build/games/bunny_hop/graphics/bunny_hop_epilogue_bg_map_ok.tilemap.s.o(.data*);
        build/games/bunny_hop/graphics/bunny_hop_epilogue_bg_map_superb.tilemap.s.o(.data*);
        build/games/rap_men/graphics/rap_men_epilogue_bg_tiles.4bpp.s.o(.data*);
        build/games/rap_men/graphics/rap_men_epilogue_bg_map_try_again.tilemap.s.o(.data*);
        build/games/rap_men/graphics/rap_men_epilogue_bg_map_ok.tilemap.s.o(.data*);
        build/games/rap_men/graphics/rap_men_epilogue_bg_map_superb.tilemap.s.o(.data*);
        build/games/rap_men/graphics/rap_women_epilogue_bg_tiles.4bpp.s.o(.data*);
        build/games/rap_men/graphics/rap_women_epilogue_bg_map_try_again.tilemap.s.o(.data*);
        build/games/rap_men/graphics/rap_women_epilogue_bg_map_ok.tilemap.s.o(.data*);
        build/games/rap_men/graphics/rap_women_epilogue_bg_map_superb.tilemap.s.o(.data*);
        build/games/rat_race/graphics/rat_race_epilogue_bg_tiles.4bpp.s.o(.data*);
        build/games/rat_race/graphics/rat_race_epilogue_bg_map_try_again.tilemap.s.o(.data*);
        build/games/rat_race/graphics/rat_race_epilogue_bg_map_ok.tilemap.s.o(.data*);
        build/games/rat_race/graphics/rat_race_epilogue_bg_map_superb.tilemap.s.o(.data*);
        build/games/remix_1/graphics/remix_1_epilogue_bg_tiles.4bpp.s.o(.data*);
        build/games/remix_1/graphics/remix_1_epilogue_bg_map_try_again.tilemap.s.o(.data*);
        build/games/remix_1/graphics/remix_1_epilogue_bg_map_ok.tilemap.s.o(.data*);
        build/games/remix_1/graphics/remix_1_epilogue_bg_map_superb.tilemap.s.o(.data*);
        build/games/remix_2/graphics/remix_2_epilogue_bg_tiles.4bpp.s.o(.data*);
        build/games/remix_2/graphics/remix_2_epilogue_bg_map_try_again.tilemap.s.o(.data*);
        build/games/remix_2/graphics/remix_2_epilogue_bg_map_ok.tilemap.s.o(.data*);
        build/games/remix_2/graphics/remix_2_epilogue_bg_map_superb.tilemap.s.o(.data*);
        build/games/remix_3/graphics/remix_3_epilogue_bg_tiles.4bpp.s.o(.data*);
        build/games/remix_3/graphics/remix_3_epilogue_bg_map_try_again.tilemap.s.o(.data*);
        build/games/remix_3/graphics/remix_3_epilogue_bg_map_ok.tilemap.s.o(.data*);
        build/games/remix_3/graphics/remix_3_epilogue_bg_map_superb.tilemap.s.o(.data*);
        build/games/remix_4/graphics/remix_4_epilogue_bg_tiles.4bpp.s.o(.data*);
        build/games/remix_4/graphics/remix_4_epilogue_bg_map_try_again.tilemap.s.o(.data*);
        build/games/remix_4/graphics/remix_4_epilogue_bg_map_ok.tilemap.s.o(.data*);
        build/games/remix_4/graphics/remix_4_epilogue_bg_map_superb.tilemap.s.o(.data*);
        build/games/remix_5/graphics/remix_5_epilogue_bg_tiles.4bpp.s.o(.data*);
        build/games/remix_5/graphics/remix_5_epilogue_bg_map_try_again.tilemap.s.o(.data*);
        build/games/remix_5/graphics/remix_5_epilogue_bg_map_ok.tilemap.s.o(.data*);
        build/games/remix_5/graphics/remix_5_epilogue_bg_map_superb.tilemap.s.o(.data*);
        build/games/remix_6/graphics/remix_6_epilogue_bg_tiles.4bpp.s.o(.data*);
        build/games/remix_6/graphics/remix_6_epilogue_bg_map_try_again.tilemap.s.o(.data*);
        build/games/remix_6/graphics/remix_6_epilogue_bg_map_ok.tilemap.s.o(.data*);
        build/games/remix_6/graphics/remix_6_epilogue_bg_map_superb.tilemap.s.o(.data*);
        build/games/remix_7/graphics/remix_7_epilogue_bg_tiles.4bpp.s.o(.data*);
        build/games/remix_7/graphics/remix_7_epilogue_bg_map_try_again.tilemap.s.o(.data*);
        build/games/remix_7/graphics/remix_7_epilogue_bg_map_ok.tilemap.s.o(.data*);
        build/games/remix_7/graphics/remix_7_epilogue_bg_map_superb.tilemap.s.o(.data*);
        build/games/remix_8/graphics/remix_8_epilogue_bg_tiles.4bpp.s.o(.data*);
        build/games/remix_8/graphics/remix_8_epilogue_bg_map_try_again.tilemap.s.o(.data*);
        build/games/remix_8/graphics/remix_8_epilogue_bg_map_ok.tilemap.s.o(.data*);
        build/games/remix_8/graphics/remix_8_epilogue_bg_map_superb.tilemap.s.o(.data*);
        build/games/ninja_bodyguard/graphics/ninja_bodyguard_epilogue_bg_tiles.4bpp.s.o(.data*);
        build/games/ninja_bodyguard/graphics/ninja_bodyguard_epilogue_bg_map_try_again.tilemap.s.o(.data*);
        build/games/ninja_bodyguard/graphics/ninja_bodyguard_epilogue_bg_map_ok.tilemap.s.o(.data*);
        build/games/ninja_bodyguard/graphics/ninja_bodyguard_epilogue_bg_map_superb.tilemap.s.o(.data*);
        build/games/ninja_bodyguard/graphics/ninja_reincarnate_epilogue_bg_tiles.4bpp.s.o(.data*);
        build/games/ninja_bodyguard/graphics/ninja_reincarnate_epilogue_bg_map_try_again.tilemap.s.o(.data*);
        build/games/ninja_bodyguard/graphics/ninja_reincarnate_epilogue_bg_map_ok.tilemap.s.o(.data*);
        build/games/ninja_bodyguard/graphics/ninja_reincarnate_epilogue_bg_map_superb.tilemap.s.o(.data*);
        build/games/space_dance/graphics/space_dance_epilogue_bg_tiles.4bpp.s.o(.data*);
        build/games/space_dance/graphics/space_dance_epilogue_bg_map_try_again.tilemap.s.o(.data*);
        build/games/space_dance/graphics/space_dance_epilogue_bg_map_ok.tilemap.s.o(.data*);
        build/games/space_dance/graphics/space_dance_epilogue_bg_map_superb.tilemap.s.o(.data*);
        build/games/tap_trial/graphics/tap_trial_epilogue_bg_tiles.4bpp.s.o(.data*);
        build/games/tap_trial/graphics/tap_trial_epilogue_bg_map_try_again.tilemap.s.o(.data*);
        build/games/tap_trial/graphics/tap_trial_epilogue_bg_map_ok.tilemap.s.o(.data*);
        build/games/tap_trial/graphics/tap_trial_epilogue_bg_map_superb.tilemap.s.o(.data*);
        build/games/tap_trial/graphics/tap_trial_2_epilogue_bg_tiles.4bpp.s.o(.data*);
        build/games/tap_trial/graphics/tap_trial_2_epilogue_bg_map_try_again.tilemap.s.o(.data*);
        build/games/tap_trial/graphics/tap_trial_2_epilogue_bg_map_ok.tilemap.s.o(.data*);
        build/games/tap_trial/graphics/tap_trial_2_epilogue_bg_map_superb.tilemap.s.o(.data*);
        build/games/toss_boys/graphics/toss_boys_epilogue_bg_tiles.4bpp.s.o(.data*);
        build/games/toss_boys/graphics/toss_boys_epilogue_bg_map_try_again.tilemap.s.o(.data*);
        build/games/toss_boys/graphics/toss_boys_epilogue_bg_map_ok.tilemap.s.o(.data*);
        build/games/toss_boys/graphics/toss_boys_epilogue_bg_map_superb.tilemap.s.o(.data*);
        build/games/toss_boys/graphics/toss_boys_2_epilogue_bg_tiles.4bpp.s.o(.data*);
        build/games/toss_boys/graphics/toss_boys_2_epilogue_bg_map_try_again.tilemap.s.o(.data*);
        build/games/toss_boys/graphics/toss_boys_2_epilogue_bg_map_ok.tilemap.s.o(.data*);
        build/games/toss_boys/graphics/toss_boys_2_epilogue_bg_map_superb.tilemap.s.o(.data*);
        build/games/tram_and_pauline/graphics/tram_pauline_epilogue_bg_tiles.4bpp.s.o(.data*);
        build/games/tram_and_pauline/graphics/tram_pauline_epilogue_bg_map_try_again.tilemap.s.o(.data*);
        build/games/tram_and_pauline/graphics/tram_pauline_epilogue_bg_map_ok.tilemap.s.o(.data*);
        build/games/tram_and_pauline/graphics/tram_pauline_epilogue_bg_map_superb.tilemap.s.o(.data*);
        build/games/sick_beats/graphics/sick_beats_epilogue_bg_tiles.4bpp.s.o(.data*);
        build/games/sick_beats/graphics/sick_beats_epilogue_bg_map_try_again.tilemap.s.o(.data*);
        build/games/sick_beats/graphics/sick_beats_epilogue_bg_map_ok.tilemap.s.o(.data*);
        build/games/sick_beats/graphics/sick_beats_epilogue_bg_map_superb.tilemap.s.o(.data*);
        build/games/wizards_waltz/graphics/wizards_waltz_epilogue_bg_tiles.4bpp.s.o(.data*);
        build/games/wizards_waltz/graphics/wizards_waltz_epilogue_bg_map_try_again.tilemap.s.o(.data*);
        build/games/wizards_waltz/graphics/wizards_waltz_epilogue_bg_map_ok.tilemap.s.o(.data*);
        build/games/wizards_waltz/graphics/wizards_waltz_epilogue_bg_map_superb.tilemap.s.o(.data*);
        build/graphics/epilogues/placeholder_epilogue_bg_tiles.4bpp.s.o(.data*);
        build/graphics/epilogues/placeholder_epilogue_bg_map_try_again.tilemap.s.o(.data*);
        build/graphics/epilogues/placeholder_epilogue_bg_map_ok.tilemap.s.o(.data*);
        build/graphics/epilogues/placeholder_epilogue_bg_map_superb.tilemap.s.o(.data*);
        build/graphics/arrival/arrival_bg_tiles.4bpp.s.o(.data*);
        build/graphics/arrival/arrival_bg_map.tilemap.s.o(.data*);
        build/graphics/cafe/cafe_obj.4bpp.s.o(.data*);
        build/graphics/cafe/cafe_bg_tiles.4bpp.s.o(.data*);
        build/graphics/cafe/cafe_bg_map_text_bubble.tilemap.s.o(.data*);
        build/graphics/cafe/cafe_bg_map.tilemap.s.o(.data*);
        build/graphics/cafe/cafe_bg_map_clap_1.tilemap.s.o(.data*);
        build/graphics/cafe/cafe_bg_map_clap_2.tilemap.s.o(.data*);
        build/graphics/cafe/cafe_bg_map_cheer_1.tilemap.s.o(.data*);
        build/graphics/cafe/cafe_bg_map_cheer_2.tilemap.s.o(.data*);
        build/graphics/cafe/cafe_bg_map_helping_2.tilemap.s.o(.data*);
        build/graphics/cafe/cafe_bg_map_helping_1.tilemap.s.o(.data*);
        build/graphics/cafe/cafe_bg_map_helping_3.tilemap.s.o(.data*);
        build/graphics/medal_corner/endless_games_menu_obj.4bpp.s.o(.data*);
        build/graphics/medal_corner/endless_games_menu_bg_tiles.4bpp.s.o(.data*);
        build/graphics/medal_corner/endless_games_menu_bg_map.tilemap.s.o(.data*);
        build/graphics/studio/studio_memory_usage_graph_bg_map.tilemap.s.o(.data*);
        build/graphics/medal_corner/drum_lessons_menu_obj.4bpp.s.o(.data*);
        build/graphics/medal_corner/drum_lessons_menu_bg_tiles.4bpp.s.o(.data*);
        build/graphics/medal_corner/drum_lessons_menu_bg_map.tilemap.s.o(.data*);
        build/graphics/data_room/data_room_obj.4bpp.s.o(.data*);
        build/graphics/data_room/data_room_bg_tiles.4bpp.s.o(.data*);
        build/graphics/data_room/data_room_bg_map.tilemap.s.o(.data*);
        build/graphics/game_select/game_select_obj.4bpp.s.o(.data*);
        build/graphics/game_select/game_select_bg_tiles.4bpp.s.o(.data*);
        build/graphics/game_select/game_select_bg_map_description_unused_rgames.tilemap.s.o(.data*);
        build/graphics/game_select/game_select_bg_map_description_unused_riq.tilemap.s.o(.data*);
        build/graphics/game_select/game_select_bg_map_description.tilemap.s.o(.data*);
        build/graphics/game_select/game_select_bg_map_perfect_notice.tilemap.s.o(.data*);
        build/graphics/game_select/game_select_bg_map_blank_unused.tilemap.s.o(.data*);
        build/graphics/main_menu/main_menu_obj.4bpp.s.o(.data*);
        build/graphics/main_menu/main_menu_bg_tiles.4bpp.s.o(.data*);
        build/graphics/main_menu/main_menu_bg_map.tilemap.s.o(.data*);
        build/graphics/perfect/perfect_certificate_bg_tiles.4bpp.s.o(.data*);
        build/graphics/perfect/perfect_certificate_bg_map.tilemap.s.o(.data*);
        build/graphics/gameplay/gameplay_obj.rle.4bpp.s.o(.data*);
        build/graphics/data_room/reading_obj.4bpp.s.o(.data*);
        build/graphics/data_room/reading_style_bulletin_bg_tiles.4bpp.s.o(.data*);
        build/graphics/data_room/reading_style_bulletin_bg_map.tilemap.s.o(.data*);
        build/graphics/data_room/reading_style_manzai_bg_tiles.4bpp.s.o(.data*);
        build/graphics/data_room/reading_style_manzai_bg_map.tilemap.s.o(.data*);
        build/graphics/data_room/reading_style_cooking_bg_tiles.4bpp.s.o(.data*);
        build/graphics/data_room/reading_style_cooking_bg_map.tilemap.s.o(.data*);
        build/graphics/data_room/reading_style_mail_bg_tiles.4bpp.s.o(.data*);
        build/graphics/data_room/reading_style_mail_bg_map.tilemap.s.o(.data*);
        build/graphics/data_room/reading_style_haiku_bg_tiles.4bpp.s.o(.data*);
        build/graphics/data_room/reading_style_haiku_bg_map.tilemap.s.o(.data*);
        build/graphics/data_room/reading_style_classroom_bg_tiles.4bpp.s.o(.data*);
        build/graphics/data_room/reading_style_classroom_bg_map.tilemap.s.o(.data*);
        build/graphics/data_room/reading_style_train_bg_tiles.4bpp.s.o(.data*);
        build/graphics/data_room/reading_style_train_bg_map.tilemap.s.o(.data*);
        build/graphics/data_room/reading_style_cherry_bg_tiles.4bpp.s.o(.data*);
        build/graphics/data_room/reading_style_cherry_bg_map.tilemap.s.o(.data*);
        build/graphics/data_room/data_room_unused_bg_map.tilemap.s.o(.data*);
        build/graphics/data_room/reading_style_sea_bg_tiles.4bpp.s.o(.data*);
        build/graphics/data_room/reading_style_sea_bg_map.tilemap.s.o(.data*);
        build/graphics/results/rank_results_obj.4bpp.s.o(.data*);
        build/graphics/results/score_results_obj.4bpp.s.o(.data*);
        build/graphics/studio/studio_obj.4bpp.s.o(.data*);
        build/graphics/studio/studio_bg_tiles.4bpp.s.o(.data*);
        build/graphics/studio/studio_bg_map.tilemap.s.o(.data*);
        build/graphics/studio/studio_bg_map_warning.tilemap.s.o(.data*);
        build/graphics/title/title_bg_tiles.4bpp.s.o(.data*);
        build/graphics/title/title_obj.4bpp.s.o(.data*);
        build/graphics/title/title_bg_map.tilemap.s.o(.data*);
        build/graphics/medal_corner/rhythm_toys_menu_obj.4bpp.s.o(.data*);
        build/graphics/medal_corner/rhythm_toys_menu_bg_tiles.4bpp.s.o(.data*);
        build/graphics/medal_corner/medal_corner_obj.4bpp.s.o(.data*);
        build/graphics/medal_corner/rhythm_toys_menu_bg_map.tilemap.s.o(.data*);
        build/games/rhythm_toys/graphics/cat_machine_obj.4bpp.s.o(.data*);
        build/games/rhythm_toys/graphics/cat_machine_bg_tiles.4bpp.s.o(.data*);
        build/games/rhythm_toys/graphics/rhythm_toys_unk_08cda128.c.o(.data*);
        build/games/rhythm_toys/graphics/cat_machine_bg_map.tilemap.s.o(.data*);
        build/games/rhythm_toys/graphics/rap_machine_obj.4bpp.s.o(.data*);
        build/games/rhythm_toys/graphics/rap_machine_bg_tiles.4bpp.s.o(.data*);
        build/games/rhythm_toys/graphics/rhythm_toys_unk_08cdbadc.c.o(.data*);
        build/games/rhythm_toys/graphics/rap_machine_bg_map.tilemap.s.o(.data*);
        build/games/rhythm_toys/graphics/love_machine_obj.4bpp.s.o(.data*);
        build/games/rhythm_toys/graphics/love_machine_bg_tiles.4bpp.s.o(.data*);
        build/games/rhythm_toys/graphics/rhythm_toys_unk_08cdd0e4.c.o(.data*);
        build/games/rhythm_toys/graphics/love_machine_bg_map.tilemap.s.o(.data*);
        build/games/ninja_bodyguard/graphics/ninja_bodyguard_bg_tiles.4bpp.s.o(.data*);
        build/games/ninja_bodyguard/graphics/ninja_bodyguard_intro_bg_tiles.4bpp.s.o(.data*);
        build/games/ninja_bodyguard/graphics/ninja_bodyguard_obj.4bpp.s.o(.data*);
        build/games/ninja_bodyguard/graphics/ninja_bodyguard_bg_map_r.tilemap.s.o(.data*);
        build/games/ninja_bodyguard/graphics/ninja_bodyguard_bg_map_l.tilemap.s.o(.data*);
        build/games/ninja_bodyguard/graphics/ninja_bodyguard_bg_map_unused.tilemap.s.o(.data*);
        build/games/ninja_bodyguard/graphics/ninja_bodyguard_intro_bg_map.tilemap.s.o(.data*);
        build/games/space_dance/graphics/space_dance_obj.4bpp.s.o(.data*);
        build/games/space_dance/graphics/space_dance_bg_tiles.4bpp.s.o(.data*);
        build/games/space_dance/graphics/space_dance_remix_3_bg_tiles.4bpp.s.o(.data*);
        build/games/space_dance/graphics/space_dance_bg_map.tilemap.s.o(.data*);
        build/games/space_dance/graphics/space_dance_remix_3_bg_map.tilemap.s.o(.data*);
        build/games/marching_orders/graphics/marching_orders_remix_7_obj.4bpp.s.o(.data*);
        build/games/marching_orders/graphics/marching_orders_remix_7_bg_tiles.4bpp.s.o(.data*);
        build/games/marching_orders/graphics/marching_orders_remix_7_bg_map.tilemap.s.o(.data*);
        build/games/marching_orders/graphics/marching_orders_remix_7_bg_map_floor.tilemap.s.o(.data*);
        build/games/drum_intro/graphics/tanuki_and_monkey_obj.4bpp.s.o(.data*);
        build/games/drum_intro/graphics/tanuki_and_monkey_bg_tiles.4bpp.s.o(.data*);
        build/games/drum_intro/graphics/tanuki_and_monkey_bg_map.tilemap.s.o(.data*);
        build/games/drum_intro/graphics/tanuki_and_monkey_bg_map_blank.tilemap.s.o(.data*);
        build/games/tap_trial/graphics/tap_trial_obj.4bpp.s.o(.data*);
        build/games/tap_trial/graphics/tap_trial_bg_tiles.4bpp.s.o(.data*);
        build/games/tap_trial/graphics/tap_trial_bg_map.tilemap.s.o(.data*);
        build/games/tap_trial/graphics/tap_trial_bg_map_text_bubble.tilemap.s.o(.data*);
        build/games/tap_trial/graphics/tap_trial_remix_8_obj.4bpp.s.o(.data*);
        build/games/tap_trial/graphics/tap_trial_remix_8_bg_tiles.4bpp.s.o(.data*);
        build/games/tap_trial/graphics/tap_trial_remix_8_bg_map.tilemap.s.o(.data*);
        build/games/tap_trial/graphics/tap_trial_remix_8_bg_map_text_bubble.tilemap.s.o(.data*);
        build/games/tap_trial/graphics/tap_trial_remix_7_obj.4bpp.s.o(.data*);
        build/games/tap_trial/graphics/tap_trial_remix_7_bg_tiles.4bpp.s.o(.data*);
        build/games/tap_trial/graphics/tap_trial_remix_7_bg_map.tilemap.s.o(.data*);
        build/games/tap_trial/graphics/tap_trial_remix_7_bg_map_text_bubble.tilemap.s.o(.data*);
        build/games/tap_trial/graphics/tap_trial_remix_5_bg_tiles.4bpp.s.o(.data*);
        build/games/tap_trial/graphics/tap_trial_remix_5_obj.4bpp.s.o(.data*);
        build/games/tap_trial/graphics/tap_trial_remix_5_bg_map.tilemap.s.o(.data*);
        build/games/tap_trial/graphics/tap_trial_2_obj.4bpp.s.o(.data*);
        build/games/tap_trial/graphics/tap_trial_2_bg_tiles.4bpp.s.o(.data*);
        build/games/tap_trial/graphics/tap_trial_2_bg_map_stage.tilemap.s.o(.data*);
        build/games/tap_trial/graphics/tap_trial_2_bg_map.tilemap.s.o(.data*);
        build/games/tap_trial/graphics/tap_trial_2_bg_map_2.tilemap.s.o(.data*);
        build/games/tap_trial/graphics/tap_trial_2_bg_map_text_bubble.tilemap.s.o(.data*);
        build/games/toss_boys/graphics/toss_boys_obj.4bpp.s.o(.data*);
        build/games/toss_boys/graphics/toss_boys_bg_tiles.4bpp.s.o(.data*);
        build/games/toss_boys/graphics/toss_boys_action_lines_bg_tiles.4bpp.s.o(.data*);
        build/games/toss_boys/graphics/toss_boys_bg_map.tilemap.s.o(.data*);
        build/games/toss_boys/graphics/toss_boys_action_lines_bg_map.tilemap.s.o(.data*);
        build/games/toss_boys/graphics/toss_boys_remix_5_bg_tiles.4bpp.s.o(.data*);
#if REV < 1
        build/games/toss_boys/graphics/toss_boys_remix_5_obj.4bpp.s.o(.data*);
#else
        build/games/toss_boys/graphics/toss_boys_remix_5_obj_rev1.4bpp.s.o(.data*);
#endif
        build/games/toss_boys/graphics/toss_boys_remix_5_bg_map.tilemap.s.o(.data*);
        build/games/toss_boys/graphics/toss_boys_2_obj.4bpp.s.o(.data*);
        build/games/toss_boys/graphics/toss_boys_2_bg_tiles.4bpp.s.o(.data*);
        build/games/toss_boys/graphics/toss_boys_2_action_lines_bg_tiles.4bpp.s.o(.data*);
        build/games/toss_boys/graphics/toss_boys_2_bg_map.tilemap.s.o(.data*);
        build/games/toss_boys/graphics/toss_boys_2_action_lines_bg_map.tilemap.s.o(.data*);
        build/games/tram_and_pauline/graphics/tram_pauline_remix_3_obj.4bpp.s.o(.data*);
        build/games/tram_and_pauline/graphics/tram_pauline_remix_3_bg_tiles.4bpp.s.o(.data*);
        build/games/tram_and_pauline/graphics/tram_pauline_unused_bg_tiles.4bpp.s.o(.data*);
        build/games/tram_and_pauline/graphics/tram_pauline_unused_bg_map.tilemap.s.o(.data*);
        build/games/tram_and_pauline/graphics/tram_pauline_remix_3_bg_map.tilemap.s.o(.data*);
        build/games/tram_and_pauline/graphics/tram_pauline_obj.4bpp.s.o(.data*);
        build/games/tram_and_pauline/graphics/tram_pauline_bg_tiles.4bpp.s.o(.data*);
        build/games/tram_and_pauline/graphics/tram_pauline_bg_map_curtain.tilemap.s.o(.data*);
        build/games/tram_and_pauline/graphics/tram_pauline_bg_map.tilemap.s.o(.data*);
        build/games/mechanical_horse/graphics/mechanical_horse_obj.4bpp.s.o(.data*);
        build/games/mechanical_horse/graphics/mechanical_horse_trees_bg_tiles.4bpp.s.o(.data*);
        build/games/mechanical_horse/graphics/mechanical_horse_road_bg_tiles.4bpp.s.o(.data*);
        build/games/mechanical_horse/graphics/mechanical_horse_city_bg_tiles.4bpp.s.o(.data*);
        build/games/mechanical_horse/graphics/mechanical_horse_blur_bg_tiles.4bpp.s.o(.data*);
        build/games/mechanical_horse/graphics/mechanical_horse_space_bg_tiles.4bpp.s.o(.data*);
        build/games/mechanical_horse/graphics/mechanical_horse_photo_bg_tiles.4bpp.s.o(.data*);
        build/games/mechanical_horse/graphics/mechanical_horse_bg_tiles.4bpp.s.o(.data*);
        build/games/mechanical_horse/graphics/mechanical_horse_trees_bg_map.tilemap.s.o(.data*);
        build/games/mechanical_horse/graphics/mechanical_horse_road_bg_map.tilemap.s.o(.data*);
        build/games/mechanical_horse/graphics/mechanical_horse_city_bg_map.tilemap.s.o(.data*);
        build/games/mechanical_horse/graphics/mechanical_horse_blur_bg_map.tilemap.s.o(.data*);
        build/games/mechanical_horse/graphics/mechanical_horse_space_bg_map.tilemap.s.o(.data*);
        build/games/mechanical_horse/graphics/mechanical_horse_photo_bg_map.tilemap.s.o(.data*);
        build/games/mechanical_horse/graphics/mechanical_horse_bg_map.tilemap.s.o(.data*);
        build/games/mechanical_horse/graphics/mechanical_horse_bg_map_ground.tilemap.s.o(.data*);
        build/games/mechanical_horse/graphics/mechanical_horse_bg_map_speedometer.tilemap.s.o(.data*);
        build/games/sick_beats/graphics/sick_beats_obj.4bpp.s.o(.data*);
        build/games/sick_beats/graphics/sick_beats_bg_tiles.4bpp.s.o(.data*);
        build/games/sick_beats/graphics/sick_beats_bg_map.tilemap.s.o(.data*);
        build/games/sick_beats/graphics/sick_beats_bg_map_foreground.tilemap.s.o(.data*);
        build/graphics/warning/warning_bg_tiles.4bpp.s.o(.data*);
        build/graphics/warning/warning_bg_map.tilemap.s.o(.data*);
        build/games/wizards_waltz/graphics/wizards_waltz_obj.4bpp.s.o(.data*);
        build/games/wizards_waltz/graphics/wizards_waltz_bg_tiles.4bpp.s.o(.data*);
        build/games/wizards_waltz/graphics/wizards_waltz_bg_map.tilemap.s.o(.data*);
        build/games/ninja_bodyguard/graphics/ninja_reincarnate_bg_tiles.4bpp.s.o(.data*);
        build/games/ninja_bodyguard/graphics/ninja_reincarnate_obj.4bpp.s.o(.data*);
        build/games/ninja_bodyguard/graphics/ninja_reincarnate_bg_map_r.tilemap.s.o(.data*);
        build/games/ninja_bodyguard/graphics/ninja_reincarnate_bg_map_l.tilemap.s.o(.data*);
        build/graphics/gameplay/gameplay_unused_warioware_obj.rle.4bpp.s.o(.data*);
    }

    _end = . ;
     /DISCARD/ : {*(*);}
}